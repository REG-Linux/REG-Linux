## package/emulationstation/reglinux-emulationstation/Config.in
```kconfig
config BR2_PACKAGE_REGLINUX_EMULATIONSTATION
        bool "REG-Linux Emulationstation"
	depends on BR2_INSTALL_LIBSTDCPP
	select BR2_PACKAGE_SDL3
	select BR2_PACKAGE_SDL3_MIXER
	select BR2_PACKAGE_ALSA_LIB
	select BR2_PACKAGE_ALSA_UTILS_AMIXER
	select BR2_PACKAGE_GAMECONTROLLERDB
	depends on (BR2_PACKAGE_HAS_LIBGLES || BR2_PACKAGE_HAS_LIBGL)
	select BR2_PACKAGE_LIBFREEIMAGE
	select BR2_PACKAGE_FREETYPE
	select BR2_PACKAGE_DEJAVU
	select BR2_PACKAGE_OPENSSL
	select BR2_PACKAGE_LIBCURL
	select BR2_PACKAGE_NANUM_FONT
	select BR2_PACKAGE_FPING
	select BR2_PACKAGE_RAPIDJSON
	select BR2_PACKAGE_POPPLER
	select BR2_PACKAGE_POPPLER_UTILS
	select BR2_PACKAGE_OPENJPEG # for poppler
	select BR2_PACKAGE_JPEG     # for poppler
	select BR2_PACKAGE_ES_SYSTEM
	select BR2_PACKAGE_LIBYUV
	select BR2_PACKAGE_LUNASVG
	select BR2_PACKAGE_PUGIXML
	select BR2_PACKAGE_X264			if !BR2_PACKAGE_SYSTEM_TARGET_BCM2835 && !BR2_PACKAGE_SYSTEM_TARGET_JZ4770 && !BR2_PACKAGE_SYSTEM_TARGET_MINI
	select BR2_PACKAGE_FFMPEG		if !BR2_PACKAGE_SYSTEM_TARGET_BCM2835 && !BR2_PACKAGE_SYSTEM_TARGET_JZ4770 && !BR2_PACKAGE_SYSTEM_TARGET_MINI
	select BR2_PACKAGE_FFMPEG_GPL		if BR2_PACKAGE_FFMPEG
	select BR2_PACKAGE_FFMPEG_FFPROBE	if BR2_PACKAGE_FFMPEG
	select BR2_PACKAGE_FFMPEG_SWSCALE	if BR2_PACKAGE_FFMPEG
	select BR2_PACKAGE_FFMPEG_POSTPROC	if BR2_PACKAGE_FFMPEG
	select BR2_PACKAGE_FFMPEG_PLAY		if BR2_PACKAGE_FFMPEG

        help
          A multi emulator frontend.

	  https://github.com/Aloshi/EmulationStation

comment "Emulation station 2 needs a toolchain w/ C++"
```

## package/emulationstation/regstation/Config.in
```kconfig
config BR2_PACKAGE_REGSTATION
        bool "REG-Linux REG-Station"
	depends on BR2_INSTALL_LIBSTDCPP
	depends on (BR2_PACKAGE_HAS_LIBGLES || BR2_PACKAGE_HAS_LIBGL)
	select BR2_PACKAGE_SDL3
	select BR2_PACKAGE_SDL3_MIXER
	select BR2_PACKAGE_ALSA_LIB
	select BR2_PACKAGE_ALSA_UTILS_AMIXER
	select BR2_PACKAGE_GAMECONTROLLERDB
	select BR2_PACKAGE_LIBFREEIMAGE
	select BR2_PACKAGE_FREETYPE
	select BR2_PACKAGE_DEJAVU
	select BR2_PACKAGE_OPENSSL
	select BR2_PACKAGE_LIBCURL
	select BR2_PACKAGE_LIBARCHIVE
	select BR2_PACKAGE_NANUM_FONT
	select BR2_PACKAGE_FPING
	select BR2_PACKAGE_RAPIDJSON
	select BR2_PACKAGE_ES_SYSTEM
	select BR2_PACKAGE_LIBYUV
	select BR2_PACKAGE_LUNASVG
	select BR2_PACKAGE_PUGIXML
	select BR2_PACKAGE_ES_FFMPEG		if !BR2_PACKAGE_SYSTEM_TARGET_BCM2835 && !BR2_PACKAGE_SYSTEM_TARGET_JZ4770 && !BR2_PACKAGE_SYSTEM_TARGET_MINI
	select BR2_PACKAGE_ES_FFMPEG_SWSCALE	if BR2_PACKAGE_ES_FFMPEG
	select BR2_PACKAGE_PDFIUM		if !BR2_mipsel

        help
          A multi emulator frontend.

	  https://github.com/REG-Linux/REG-ES

comment "REG-Station needs a toolchain w/ C++"
```

## package/emulators/86Box/Config.in
```kconfig
config BR2_PACKAGE_86BOX
    bool "86box"
    select BR2_PACKAGE_RTMIDI
    select BR2_PACKAGE_LIBSNDFILE
    select BR2_PACKAGE_SLIRP
    select BR2_PACKAGE_OPENAL
    select BR2_PACKAGE_SDL2
  
    help
      86Box

      https://86box.net/
```

## package/emulators/applewin/Config.in
```kconfig
config BR2_PACKAGE_APPLEWIN
	bool "applewin"
	select BR2_PACKAGE_SDL3
	select BR2_PACKAGE_SDL3_IMAGE
	select BR2_PACKAGE_BOOST
	select BR2_PACKAGE_BOOST_PROGRAM_OPTIONS
	select BR2_PACKAGE_MINIZIP_ZLIB
	select BR2_PACKAGE_SLIRP
	select BR2_PACKAGE_LIBPCAP
	select BR2_PACKAGE_LIBYAML
	select BR2_PACKAGE_HOST_XXD
	help
		AppleWin linux / libretro port

		https://github.com/audetto/AppleWin
```

## package/emulators/ares/Config.in
```kconfig
config BR2_PACKAGE_ARES
    bool "ares"
    select BR2_PACKAGE_SDL2
    select BR2_PACKAGE_ZLIB
    select BR2_PACKAGE_PANGO
    select BR2_PACKAGE_CAIRO
    select BR2_PACKAGE_LIBGTK3
    select BR2_PACKAGE_LIBRASHADER
    depends on BR2_PACKAGE_HAS_LIBGL && BR2_ARCH_IS_64
    depends on BR2_PACKAGE_XORG7 && BR2_PACKAGE_REGLINUX_XWAYLAND

    help
      ares is a cross-platform, open source, multi-system emulator, focusing on accuracy and preservation.

      https://ares-emu.net/
```

## package/emulators/clk/Config.in
```kconfig
config BR2_PACKAGE_CLK
    bool "clk"
    select BR2_PACKAGE_SDL2
    select BR2_PACKAGE_ZLIB
    depends on BR2_PACKAGE_HAS_LIBGL || BR2_PACKAGE_HAS_GLES3
  
    help
      CLK - Clock Signal multi-system emulator

      https://github.com/TomHarte/CLK
```

## package/emulators/dolphin-triforce/Config.in
```kconfig
config BR2_PACKAGE_DOLPHIN_TRIFORCE
	bool "dolphin-triforce"
	select BR2_PACKAGE_REGLINUX_QT6
	select BR2_PACKAGE_BLUEZ5_UTILS
	select BR2_PACKAGE_FFMPEG
	select BR2_PACKAGE_HIDAPI
	select BR2_PACKAGE_LIBCURL
	select BR2_PACKAGE_LIBEVDEV
	select BR2_PACKAGE_LIBPNG
	select BR2_PACKAGE_LIBUSB
	select BR2_PACKAGE_LZO
	select BR2_PACKAGE_SPEEX
	select BR2_PACKAGE_SPEEXDSP
	select BR2_PACKAGE_XZ
	select BR2_PACKAGE_ZLIB
	select BR2_PACKAGE_MINIZIP_ZLIB
	select BR2_PACKAGE_PUGIXML
	select BR2_PACKAGE_SDL2
	help
	  TriForce (Dolphin-5.0 based) arcade emulator

comment "DOLPHIN_TRIFORCE needs a toolchain w/ C++, OpenGL"
    depends on !BR2_INSTALL_LIBSTDCPP || !BR2_PACKAGE_HAS_LIBGL
```

## package/emulators/duckstation-mini/Config.in
```kconfig
config BR2_PACKAGE_DUCKSTATION_MINI
    bool "duckstation-mini"
    depends on BR2_arm || BR2_aarch64
    depends on BR2_PACKAGE_HAS_GLES3 || BR2_PACKAGE_REGLINUX_VULKAN

    help
      DuckStation - PlayStation 1, aka. PSX Emulator
      DuckStation Mini is only for ARM/AArch64 devices.
      It features a fullscreen/TV UI based on Dear ImGui.

	    https://github.com/stenzek/duckstation
```

## package/emulators/duckstation/Config.in
```kconfig
config BR2_PACKAGE_DUCKSTATION
    bool "duckstation"
    depends on BR2_x86_64 || BR2_arm || BR2_aarch64
    # TODO depends on what else ? Qt ? GL ? Vulkan ?

    help
      DuckStation - PlayStation 1, aka. PSX Emulator
      DuckStation features a fully-featured frontend built using Qt.

	    https://github.com/stenzek/duckstation
```

## package/emulators/felix86/Config.in
```kconfig
config BR2_PACKAGE_FELIX86
    bool "felix86"
    depends on BR2_riscv && BR2_RISCV_64
    depends on BR2_PACKAGE_HAS_LIBGL
    depends on BR2_PACKAGE_VULKAN_HEADERS
    depends on BR2_PACKAGE_VULKAN_LOADER
  
    help
      Felix86

      https://github.com/OFFTKP/felix86
```

## package/emulators/izapple2/Config.in
```kconfig
config BR2_PACKAGE_IZAPPLE2
    	bool "izapple2"
    	depends on BR2_PACKAGE_HOST_GO_TARGET_ARCH_SUPPORTS
	depends on BR2_PACKAGE_HOST_GO_TARGET_CGO_LINKING_SUPPORTS
	depends on BR2_TOOLCHAIN_HAS_THREADS
	select BR2_PACKAGE_HOST_GO

    	help
        Portable emulator of an Apple II+ or //e. Written in Go.
	https://github.com/ivanizag/izapple2

comment "izapple2 needs a toolchain w/ threads"
	depends on BR2_PACKAGE_HOST_GO_TARGET_ARCH_SUPPORTS
```

## package/emulators/libretro/libretro-applewin/Config.in
```kconfig
config BR2_PACKAGE_LIBRETRO_APPLEWIN
	bool "libretro-applewin"
	select BR2_PACKAGE_BOOST
	select BR2_PACKAGE_BOOST_PROGRAM_OPTIONS
	select BR2_PACKAGE_MINIZIP_ZLIB
	select BR2_PACKAGE_SLIRP
	select BR2_PACKAGE_LIBPCAP
	select BR2_PACKAGE_LIBYAML
	select BR2_PACKAGE_HOST_XXD
	help
		AppleWin libretro port

		https://github.com/audetto/AppleWin
```

## package/emulators/libretro/libretro-bsnes-jg/Config.in
```kconfig
config BR2_PACKAGE_LIBRETRO_BSNES_JG
    bool "libretro-bsnes-jg"
	
	depends on BR2_INSTALL_LIBSTDCPP
	depends on BR2_GCC_ENABLE_OPENMP
      help
        A libretro SNES emulator core.

	  http://www.libretro.com

comment "LIBRETRO_BSNES_JG needs a toolchain w/ C++"
	depends on !BR2_INSTALL_LIBSTDCPP
```

## package/emulators/libretro/libretro-clownmdemu/Config.in
```kconfig
config BR2_PACKAGE_LIBRETRO_CLOWNMDEMU
    bool "libretro-clownmdemu"
    
    depends on BR2_INSTALL_LIBSTDCPP
      help
        This is ClownMDEmu, a Sega Mega Drive (a.k.a. Sega Genesis) emulator.
	Some standard features of the Mega Drive are currently unemulated (see common/core/TODO.md for more information).
	This repository contains a frontend that exposes ClownMDEmu as a libretro core.

        https://github.com/Clownacy/clownmdemu-libretro

comment "LIBRETRO_CLOWNMDEMU needs a toolchain w/ C++"
    depends on !BR2_INSTALL_LIBSTDCPP
```

## package/emulators/libretro/libretro-gearboy/Config.in
```kconfig
config BR2_PACKAGE_LIBRETRO_GEARBOY
    bool "libretro-gearboy"
	depends on BR2_INSTALL_LIBSTDCPP

      help
        Gearboy is a cross-platform 
        Game Boy / Game Boy Color emulator 
        written in C++ that runs on Windows, 
        macOS, Linux, BSD and RetroArch.

	  https://github.com/drhelius/Gearboy

comment "LIBRETRO_GEARBOY needs a toolchain w/ C++"
	depends on !BR2_INSTALL_LIBSTDCPP
```

## package/emulators/libretro/libretro-gearcoleco/Config.in
```kconfig
config BR2_PACKAGE_LIBRETRO_GEARCOLECO
    bool "libretro-gearcoleco"
	depends on BR2_INSTALL_LIBSTDCPP

      help
        Gearcoleco is a very accurate cross-platform 
	ColecoVision emulator written in C++ that 
	runs on Windows, macOS, Linux, BSD and RetroArch.

	  https://github.com/drhelius/Gearcoleco

comment "LIBRETRO_GEARSCOLECO needs a toolchain w/ C++"
	depends on !BR2_INSTALL_LIBSTDCPP
```

## package/emulators/libretro/libretro-geargrafx/Config.in
```kconfig
config BR2_PACKAGE_LIBRETRO_GEARGRAFX
    bool "libretro-geargrafx"
	depends on BR2_INSTALL_LIBSTDCPP

      help
        Geargrafx is an accurate cross-platform
	TurboGrafx-16 / PC Engine emulator written 
	in C++ that runs on Windows, macOS, Linux, BSD and RetroArch.

	  https://github.com/drhelius/Geargrafx

comment "LIBRETRO_GEARGRAFX needs a toolchain w/ C++"
	depends on !BR2_INSTALL_LIBSTDCPP
```

## package/emulators/libretro/libretro-gearlynx/Config.in
```kconfig
config BR2_PACKAGE_LIBRETRO_GEARLYNX
    bool "libretro-gearlynx"
	depends on BR2_INSTALL_LIBSTDCPP

      help
        Gearlynx is a cross-platform 
        Atari Lynx emulator 
        written in C++ that runs on Windows, 
        macOS, Linux, BSD and RetroArch.

	  https://github.com/drhelius/Gearlynx

comment "LIBRETRO_GEARLYNX needs a toolchain w/ C++"
	depends on !BR2_INSTALL_LIBSTDCPP
```

## package/emulators/libretro/libretro-holani/Config.in
```kconfig
config BR2_PACKAGE_LIBRETRO_HOLANI
	bool "libretro-holani"
	depends on BR2_PACKAGE_HOST_RUSTC_TARGET_ARCH_SUPPORTS
	select BR2_PACKAGE_HOST_RUSTC
	# Temp workaround for bindgen issue
	depends on BR2_PACKAGE_LLVM
	depends on BR2_PACKAGE_CLANG
	help
	A cycle-stepped libretro Lynx emulator core.

	https://docs.libretro.com/library/holani/
```

## package/emulators/libretro/libretro-kronos/Config.in
```kconfig
config BR2_PACKAGE_LIBRETRO_KRONOS
	bool "libretro-kronos"
	
	depends on BR2_INSTALL_LIBSTDCPP
	depends on BR2_PACKAGE_HAS_LIBGL || BR2_PACKAGE_HAS_LIBGLES
      help
        A libretro saturn emulator core.

	  http://www.libretro.com

comment "LIBRETRO_KRONOS needs a toolchain w/ C++"
	depends on !BR2_INSTALL_LIBSTDCPP
```

## package/emulators/libretro/libretro-morpheuscast-xtreme/Config.in
```kconfig
config BR2_PACKAGE_LIBRETRO_MORPHEUSCAST_XTREME
        bool "libretro-morpheuscast-xtreme"
	
	depends on BR2_INSTALL_LIBSTDCPP
	depends on BR2_PACKAGE_HAS_LIBGLES
        help
          A libretro dreamcast emulator core.

	  http://www.libretro.com

comment "LIBRETRO_MORPHEUSCAST_XTREME needs a toolchain w/ C++ and OpenGL ES or OpenGL"
	depends on !BR2_INSTALL_LIBSTDCPP || !BR2_PACKAGE_HAS_LIBGLES
```

## package/emulators/libretro/libretro-same-cdi/Config.in
```kconfig
config BR2_PACKAGE_LIBRETRO_SAME_CDI
    bool "libretro-same-cdi"

    select BR2_PACKAGE_ZLIB
    select BR2_PACKAGE_ZSTD
    select BR2_PACKAGE_FLAC
    select BR2_PACKAGE_RAPIDJSON
    select BR2_PACKAGE_PUGIXML
    select BR2_PACKAGE_SQLITE
    select BR2_PACKAGE_EXPAT
    select BR2_PACKAGE_JPEG
    
      help
        A libretro CD-i emulator core (branched from MAME)
        
        http://www.libretro.com
```

## package/emulators/libretro/libretro-sameboy/Config.in
```kconfig
config BR2_PACKAGE_LIBRETRO_SAMEBOY
    bool "libretro-sameboy"
	depends on BR2_INSTALL_LIBSTDCPP
	select BR2_PACKAGE_RGBDS

      help
        DMG/CGB GameBoy emulator for libretro
	https://github.com/LIJI32/SameBoy

comment "LIBRETRO_SAMEBOY needs a toolchain w/ C++"
	depends on !BR2_INSTALL_LIBSTDCPP
```

## package/emulators/libretro/libretro-vice/Config.in
```kconfig
config BR2_PACKAGE_LIBRETRO_VICE
    bool "libretro-vice"
	
	depends on BR2_INSTALL_LIBSTDCPP
      help
        Versatile Commodore 8-bit Emulator

	  http://www.libretro.com

comment "LIBRETRO_VICE needs a toolchain w/ C++"
	depends on !BR2_INSTALL_LIBSTDCPP

# Choose which libretro-vice cores we build
config BR2_PACKAGE_LIBRETRO_VICE_X64
    bool "Build x64 (C64 standard)"
    default y
    depends on BR2_PACKAGE_LIBRETRO_VICE
    help
      Build the standard C64 binary (x64).

config BR2_PACKAGE_LIBRETRO_VICE_X128
    bool "Build x128 (C128)"
    default y
    depends on BR2_PACKAGE_LIBRETRO_VICE
    help
      Build the Commodore 128 binary (x128).

config BR2_PACKAGE_LIBRETRO_VICE_XVIC
    bool "Build xvic (VIC-20)"
    default y
    depends on BR2_PACKAGE_LIBRETRO_VICE
    help
      Build the VIC-20 binary (xvic).

config BR2_PACKAGE_LIBRETRO_VICE_XPLUS4
    bool "Build xplus4 (Plus/4)"
    default y
    depends on BR2_PACKAGE_LIBRETRO_VICE
    help
      Build the Commodore Plus/4 binary (xplus4).

config BR2_PACKAGE_LIBRETRO_VICE_XPET
    bool "Build xpet (PET/CBM-II)"
    default y
    depends on BR2_PACKAGE_LIBRETRO_VICE
    help
      Build the PET/CBM-II binary (xpet).

config BR2_PACKAGE_LIBRETRO_VICE_XCBM2
    bool "Build xcbm2 (CBM-II variant)"
    default y
    depends on BR2_PACKAGE_LIBRETRO_VICE
    help
      Build the CBM-II variant binary (xcbm2).

# Those require a fast CPU to run fullspeed
config BR2_PACKAGE_LIBRETRO_VICE_X64SC
    bool "Build x64sc (C64 Single Cycle)"
    depends on BR2_PACKAGE_LIBRETRO_VICE
    help
      Build the C64 Single Cycle binary (x64sc) for precise timing.

config BR2_PACKAGE_LIBRETRO_VICE_XSCPU64
    bool "Build xscpu64 (C64 SuperCPU)"
    depends on BR2_PACKAGE_LIBRETRO_VICE
    help
      Build the C64 SuperCPU binary (xscpu64).
```

## package/emulators/panda3ds/Config.in
```kconfig
config BR2_PACKAGE_PANDA3DS
    bool "panda3ds"
    select BR2_PACKAGE_SDL2
    select BR2_PACKAGE_GLSLANG		if BR2_PACKAGE_REGLINUX_VULKAN
    select BR2_PACKAGE_HOST_GLSLANG	if BR2_PACKAGE_REGLINUX_VULKAN

    help
      Panda3DS is an HLE, red-panda-themed Nintendo 3DS emulator written in C++ which started out as a fun project out of curiosity, but evolved into something that can sort of play games!

      https://github.com/wheremyfoodat/Panda3DS
```
