## package/system/reglinux-zramswap/Config.in
```kconfig
config BR2_PACKAGE_REGLINUX_ZRAMSWAP
        bool "reglinux-zramswap"
        help
          Service to enable swap on zram
```

## package/themes/es-theme-canvas/Config.in
```kconfig
config BR2_PACKAGE_ES_THEME_CANVAS
	bool "EmulationStation theme Canvas (REG Linux version)"
	help
	  https://github.com/REG-Linux/es-theme-canvas
```

## package/themes/es-theme-neutral/Config.in
```kconfig
config BR2_PACKAGE_ES_THEME_NEUTRAL
	bool "EmulationStation theme Neutral (REG Linux version)"
	help
	  https://github.com/REG-Linux/es-theme-neutral
```

## package/toolchain/toolchain-optional-bootlin-aarch64/Config.in
```kconfig
config BR2_TOOLCHAIN_OPTIONAL_BOOTLIN_AARCH64
	bool "toolchain-optional-bootlin-aarch64"
	depends on BR2_HOSTARCH = "x86_64"
	help
	  Toolchain for the AArch64 architecture that can be optionally used by packages at compile time, from
	  https://toolchains.bootlin.com/
```

## package/utils/ampart/Config.in
```kconfig
config BR2_PACKAGE_AMPART
        bool "ampart"
	select BR2_PACKAGE_ZLIB
        help
          Amlogic eMMC Partition Tool

          https://github.com/7Ji/ampart
```

## package/utils/b3sum/Config.in
```kconfig
config BR2_PACKAGE_B3SUM
	bool "b3sum"
	select BR2_PACKAGE_HOST_RUSTC_TARGET_ARCH_SUPPORTS
	select BR2_PACKAGE_HOST_RUSTC

	help
	  A command line utility for calculating BLAKE3 hashes,
	  similar to Coreutils tools like b2sum or md5sum.

	  https://github.com/BLAKE3-team/BLAKE3.git
```

## package/utils/evmapx/Config.in
```kconfig
config BR2_PACKAGE_EVMAPX
	bool "evmapx"
	select BR2_PACKAGE_HOST_RUSTC_TARGET_ARCH_SUPPORTS
	select BR2_PACKAGE_HOST_RUSTC

	help
	  Evmapy modern replacement

	  https://github.com/REG-Linux/evmapx
```

## package/utils/fuse-zar/Config.in
```kconfig
config BR2_PACKAGE_FUSE_ZAR
        bool "fuse-zar"
	select BR2_PACKAGE_ZSTD
	select BR2_PACKAGE_LIBFUSE3
        help
          FUSE ZArchive mounter

          https://github.com/REG-Linux/fuse-zar
```

## package/utils/grim/Config.in
```kconfig
config BR2_PACKAGE_GRIM
    bool "grim"
    depends on BR2_PACKAGE_WAYLAND
    select BR2_PACKAGE_PIXMAN
    select BR2_PACKAGE_LIBPNG

    help
      Grab images from a Wayland compositor.

      https://git.sr.ht/~emersion/grim
```

## package/utils/inputplumber/Config.in
```kconfig
config BR2_PACKAGE_INPUTPLUMBER
	bool "inputplumber"
	depends on BR2_PACKAGE_HOST_RUSTC_TARGET_ARCH_SUPPORTS
	select BR2_PACKAGE_HOST_RUSTC
	select BR2_PACKAGE_EUDEV
	select BR2_PACKAGE_LIBEVDEV
	select BR2_PACKAGE_LIBIIO
	select BR2_PACKAGE_LLVM
	select BR2_PACKAGE_CLANG
	help
	  InputPlumber is an open source input routing and control 
	  daemon for Linux. It can be used to combine any number 
	  of input devices (like gamepads, mice, and keyboards) 
	  and translate their input to a variety of virtual 
	  device formats.

	  https://github.com/ShadowBlip/InputPlumber
```

## package/utils/rgbds/Config.in
```kconfig
config BR2_PACKAGE_RGBDS
	bool "rgbds"

	select BR2_PACKAGE_LIBPNG

	help
	  RGBDS (Rednex Game Boy Development System) is a free 
	  assembler/linker package for the Game Boy / Game Boy Color. 

	  https://github.com/gbdev/rgbds
```

## package/utils/switchfin/Config.in
```kconfig
config BR2_PACKAGE_SWITCHFIN
	bool "switchfin"
	select BR2_PACKAGE_MPV
	select BR2_PACKAGE_LIBCURL
	help
	  Switchfin is third-party PC player for Jellyfin 
	  that provides a native user interface to browse 
	  and play movies and series.

	  https://github.com/dragonflylee/switchfin
```

## package/utils/umtp-responder/Config.in
```kconfig
config BR2_PACKAGE_UMTP_RESPONDER
	bool "umtp-responder"
	select BR2_PACKAGE_LIBGLIB2
	select BR2_PACKAGE_LIBUSB
	select BR2_PACKAGE_INIH

	help
	  Lightweight USB Media Transfer Protocol (MTP) 
	  responder daemon for GNU/Linux

	  https://github.com/viveris/uMTP-Responder
```

## package/utils/uutils-coreutils/Config.in
```kconfig
config BR2_PACKAGE_UUTILS_COREUTILS
	bool "uutils-coreutils"
	depends on BR2_PACKAGE_HOST_RUSTC_TARGET_ARCH_SUPPORTS
	depends on BR2_PACKAGE_HOST_RUSTC
	depends on BR2_PACKAGE_BUSYBOX_SHOW_OTHERS
	help
	  uutils coreutils is a cross-platform reimplementation of the
	  GNU coreutils in Rust.

	  While all programs have been implemented, some options might
	  be missing or different behavior might be experienced.

	  https://github.com/uutils/coreutils

if BR2_PACKAGE_UUTILS_COREUTILS

config BR2_PACKAGE_UUTILS_COREUTILS_MULTICALL
	bool "multicall"
	default y
	help
	  Build coreutils as a single multi-call binary, or as a set
	  of separate utilities.

	  Select 'y' to build coreutils as a single ‘coreutils’ binary.
	  This approach allows to reduce overhead and achieve a minimal
	  image size.

	  Select 'n' to build coreutils as a collection of independent
	  binaries, such as 'cp, mv, df, ...'. This approach produces
	  larger final image, but it manages each application
	  individually.

	  It often comes in handy for testing, as it allows you to
	  replace several specific binaries and see what happens.

config BR2_PACKAGE_UUTILS_COREUTILS_UTILITIES
	string "utilities"
	default "default"
	help
	  This option specifies precisely which utilities will be
	  built.

	  Use 'default' to build all available utilities.

	  Use a space-separated list of utilities, such as 'cp mv df’,
	  to explicitly specify the utilities to build.

endif
```
