## package/reglinux/utils/itstool/Config.in
```kconfig
config BR2_PACKAGE_ITSTOOL
	bool "itstool"
	select BR2_PACKAGE_PYTHON3
	select BR2_PACKAGE_PYTHON_LXML
	select BR2_PACKAGE_LIBXML2

config BR2_PACKAGE_HOST_ITSTOOL
	bool "host-itstool"
	select BR2_PACKAGE_HOST_PYTHON3
	select BR2_PACKAGE_HOST_PYTHON_LXML
	select BR2_PACKAGE_HOST_LIBXML2

	help 
	    Translate XML with PO files using W3C Internationalization Tag Set rules

		https://github.com/itstool/itstool
```

## package/reglinux/utils/kmsvnc/Config.in
```kconfig
config BR2_PACKAGE_KMSVNC
	bool "kmsvnc"

	select BR2_PACKAGE_LIBDRM
	help
	  KMS/DRM VNC server

	  https://github.com/isjerryxiao/kmsvnc
```

## package/retroarch/retroarch-joypad-autoconfig/Config.in
```kconfig
config BR2_PACKAGE_RETROARCH_JOYPAD_AUTOCONFIG
        bool "retroarch-joypad-autoconfig"
	
        help
          Joypad autoconfig files for RetroArch, the reference frontend for the libretro API.

	  https://github.com/libretro/retroarch-joypad-autoconfig/
```

## package/system/reglinux-exfat/Config.in
```kconfig
config BR2_PACKAGE_REGLINUX_EXFAT
        bool "reglinux-exfat"

        # exFAT FUSE implementation
        select BR2_PACKAGE_EXFAT                            if BR2_PACKAGE_HOST_LINUX_HEADERS_CUSTOM_5_4


# To-Do: replace "exFAT FUSE" with kernel driver backport from https://github.com/namjaejeon/linux-exfat-oot/tree/for-kernel-version-from-4.1.0
#        but how to download, extract `exfat` folder into linux kernel folder and setup before compiling kernel 5.4 ?


        # exFAT userspace utilities (for FUSE-based driver)
        select BR2_PACKAGE_EXFAT_UTILS                      if  BR2_PACKAGE_EXFAT
        # exFAT userspace utilities (for 5.7+ kernel-based support)
        select BR2_PACKAGE_EXFATPROGS                       if !BR2_PACKAGE_EXFAT

        help
          exFAT custom implementation using either FUSE or in-kernel exFAT support
```

## package/system/reglinux-gpicase/Config.in
```kconfig
config BR2_PACKAGE_REGLINUX_GPICASE
        bool "reglinux-gpicase"
	depends on BR2_PACKAGE_BATOCERA_RPI_ANY
	depends on BR2_LINUX_KERNEL

	help

	  https://github.com/RetroFlag/retroflag-picase

comment "reglinux-gpicase needs a Linux kernel to be built"
	depends on !BR2_LINUX_KERNEL
```

## package/system/reglinux-msg/Config.in
```kconfig
config BR2_PACKAGE_REGLINUX_MSG_BUILD_FROM_SOURCE
	bool "reglinux-msg-build-from-source"
	default n

config BR2_PACKAGE_REGLINUX_MSG
	bool "reglinux-msg"
	select BR2_PACKAGE_HOST_RUSTC_TARGET_ARCH_SUPPORTS	if BR2_PACKAGE_REGLINUX_MSG_BUILD_FROM_SOURCE
	select BR2_PACKAGE_HOST_RUSTC				if BR2_PACKAGE_REGLINUX_MSG_BUILD_FROM_SOURCE
	select BR2_PACKAGE_LIBDRM
	select BR2_PACKAGE_ZEROMQ
	select BR2_PACKAGE_GRIM					if BR2_PACKAGE_WAYLAND
	select BR2_PACKAGE_WF_RECORDER				if BR2_PACKAGE_WAYLAND && BR2_PACKAGE_PIPEWIRE
	help
	  Manages screen resolution and display settings

	  https://github.com/REG-Linux/regmsg
```

## package/system/reglinux-notice/Config.in
```kconfig
config BR2_PACKAGE_REGLINUX_NOTICE
    bool "reglinux-notice"
    help
      REG-Linux pdf notice
```

## package/system/reglinux-samba/Config.in
```kconfig
config BR2_PACKAGE_REGLINUX_SAMBA
        bool "reglinux-samba"

	select BR2_PACKAGE_KSMBD_TOOLS

        help
          Samba custom implementation using either ksmbd or plain samba4
```

## package/system/reglinux-screen/Config.in
```kconfig
config BR2_PACKAGE_REGLINUX_SCREEN
	bool "reglinux-screen"

	select BR2_PACKAGE_BASH
	select BR2_PACKAGE_PCIUTILS
	select BR2_PACKAGE_GRIM         if BR2_PACKAGE_REGLINUX_SWAY
	select BR2_PACKAGE_WF_RECORDER  if BR2_PACKAGE_REGLINUX_SWAY && BR2_PACKAGE_BATOCERA_AUDIO

	help
	  REGLinux screen configuration
```

## package/system/reglinux-system-settings/Config.in
```kconfig
config BR2_PACKAGE_REGLINUX_SYSTEM_SETTINGS
       bool "reglinux-system-settings"
```
