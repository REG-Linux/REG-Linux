## package/system/reglinux-system/Config.in
```kconfig
# Targets
source "$BR2_EXTERNAL_REGLINUX_PATH/package/system/reglinux-system/Config.in.targets"

# GPU drivers and Vulkan
source "$BR2_EXTERNAL_REGLINUX_PATH/package/system/reglinux-system/Config.in.gpu"

# Networking
source "$BR2_EXTERNAL_REGLINUX_PATH/package/system/reglinux-system/Config.in.network"

# Emulators
source "$BR2_EXTERNAL_REGLINUX_PATH/package/system/reglinux-system/Config.in.emulators"

# Engines
source "$BR2_EXTERNAL_REGLINUX_PATH/package/system/reglinux-system/Config.in.engines"

# Ports
source "$BR2_EXTERNAL_REGLINUX_PATH/package/system/reglinux-system/Config.in.ports"

# Games
source "$BR2_EXTERNAL_REGLINUX_PATH/package/system/reglinux-system/Config.in.games"

# Special file for "mini" systems
source "$BR2_EXTERNAL_REGLINUX_PATH/package/system/reglinux-system/Config.in.mini"

config BR2_PACKAGE_MAME_BUILD_FROM_SOURCE
	bool "mame-build-from-source"
	default n

config BR2_PACKAGE_SCUMMVM_BUILD_FROM_SOURCE
	bool "scummvm-build-from-source"
	default n

##########################################
config BR2_PACKAGE_REGLINUX_MUSIC_SUPPORT
	bool "batocera.linux music formats support"

	# MIDI renderer (CPU hog)
	select BR2_PACKAGE_FLUIDSYNTH		if !BR2_PACKAGE_SYSTEM_TARGET_JZ4770  && \
						   !BR2_PACKAGE_SYSTEM_TARGET_BCM2835 && \
						   !BR2_PACKAGE_SYSTEM_TARGET_BCM2836 && \
						   !BR2_PACKAGE_SYSTEM_TARGET_RK3128  && \
						   !BR2_PACKAGE_SYSTEM_TARGET_H3      && \
						   !BR2_PACKAGE_SYSTEM_TARGET_CHA     && \
						   !BR2_PACKAGE_SYSTEM_TARGET_MINI    && \
						   !BR2_PACKAGE_SYSTEM_TARGET_RK3326  && \
						   !BR2_PACKAGE_SYSTEM_TARGET_H700

	select BR2_PACKAGE_FLUIDSYNTH_ALSA_LIB	if BR2_PACKAGE_FLUIDSYNTH

	# Roland MT-32 emulation (munt)
	select BR2_PACKAGE_LIBMT32EMU		if BR2_PACKAGE_FLUIDSYNTH

	# MIDI tools
	select BR2_PACKAGE_ALSA_UTILS_ACONNECT  if BR2_PACKAGE_ALSA_UTILS
	select BR2_PACKAGE_ALSA_UTILS_APLAYMIDI if BR2_PACKAGE_ALSA_UTILS

	# FLAC, Ogg/Vorbis/Opus, MP3, Modules support
	select BR2_PACKAGE_FLAC		# flac
	select BR2_PACKAGE_LIBMAD	# mp3
	select BR2_PACKAGE_LIBXMP	# modules (mod,xm,s3m,it...)
	select BR2_PACKAGE_LIBOGG	# ogg container
	select BR2_PACKAGE_LIBVORBIS	# vorbis codec
	select BR2_PACKAGE_OPUS		# opus codec

	help
	  Music support packages (MIDI, ALSA, FLAC, Ogg/Vorbis, MP3, modules...)

config BR2_PACKAGE_REGLINUX_SYSTEM
	bool "REG-Linux"

	# Debugging tools
	select BR2_PACKAGE_SYSTEM_DEBUG			if BR2_ENABLE_DEBUG

	# Tools needed to generate images
        select BR2_PACKAGE_HOST_GENIMAGE
        select BR2_PACKAGE_HOST_GENEXT2FS

	# Amlogic eMMC partition tool
	select BR2_PACKAGE_AMPART			if BR2_PACKAGE_SYSTEM_TARGET_AMLOGIC_ANY

	# ZAR support
	select BR2_PACKAGE_FUSE_ZAR			# Custom FUSE mounter for ZAR (ZArchive)

	# minimal system required packages
	select BR2_TARGET_BATOCERA_IMAGES_DEFINITIONS
	select BR2_PACKAGE_BASH				# bash shell, used as the interactive shell
	select BR2_PACKAGE_REGLINUX_EMULATIONSTATION	# emulationstation
	select BR2_PACKAGE_ES_THEME_CANVAS		# emulationstation theme
	select BR2_PACKAGE_ES_BACKGROUND_MUSICS		# emulationstation musics
	select BR2_PACKAGE_BATOCERA_ES_SYSTEM		# emulation station es_systems.cfg generator + default roms
	select BR2_PACKAGE_REGLINUX_CONFIGGEN		# emulation station external command launcher
	select BR2_PACKAGE_BATOCERA_TRIGGERHAPPY	# multimedia/power buttons
	select BR2_PACKAGE_BATOCERA_UDEV_RULES		# extra udev rules for specifics joysticks/devices
	select BR2_PACKAGE_DOSFSTOOLS			# fat
	select BR2_PACKAGE_DOSFSTOOLS_FSCK_FAT		# fat
	select BR2_PACKAGE_DOSFSTOOLS_MKFS_FAT		# fat
	select BR2_PACKAGE_DOSFSTOOLS_FATLABEL		# fat
	select BR2_PACKAGE_E2FSPROGS			# ext4
	select BR2_PACKAGE_REGLINUX_EXFAT		# exfat
	select BR2_PACKAGE_NTFS_3G			# ntfs-3g will only install on kernel 5.4 or 5.10 and will build ntfsprogs, for both NTFS3 and ntfs-3g
	select BR2_PACKAGE_NTFS_3G_NTFSPROGS
	select BR2_PACKAGE_BTRFS_PROGS			# btrfs

	select BR2_PACKAGE_PM_UTILS			# suspend
	select BR2_PACKAGE_INPUTPLUMBER			if BR2_PACKAGE_SYSTEM_TARGET_X86_64_ANY # userspace tool to remap x86 handhelds keyboard to a proper gamepad
	select BR2_PACKAGE_UTIL_LINUX_LIBMOUNT		# for util-linux compilation to work (so, may be removed in the future)
	select BR2_PACKAGE_FBDUMP			# tool to capture snapshots from the Linux kernel framebuffer device and write them out as a PPM file
	select BR2_PACKAGE_FBGRAB			# framebuffer screenshot program, capturing the linux frambuffer and converting it to a png-picture
	select BR2_PACKAGE_EUDEV_RULES_GEN		# fork of systemd-udev with the goal of obtaining better compatibility with existing software such as OpenRC and Upstart
	select BR2_PACKAGE_BOOST			# boost base package, used in many packages
	select BR2_PACKAGE_BOOST_ATOMIC			# library that provides atomic data types and operations on these data types
	select BR2_PACKAGE_UTIL_LINUX_LIBSMARTCOLS	# library is used for smart adaptive formatting of tabular data
	select BR2_PACKAGE_UTIL_LINUX_SETTERM		# Set terminal attributes
	select BR2_PACKAGE_USB_MODESWITCH		# USB modeswitch support
	select BR2_PACKAGE_UMTOOL			if !BR2_PACKAGE_SYSTEM_TARGET_CHA && !BR2_PACKAGE_SYSTEM_TARGET_MINI # command line tool for configuring Ultimarc arcade hardware
	select BR2_PACKAGE_PYTHON_HIDAPI		# Communication with USB HID devices via Python
	#TODO MUSL
	select BR2_PACKAGE_LEDSPICER			if !BR2_TOOLCHAIN_USES_MUSL && !BR2_PACKAGE_SYSTEM_TARGET_JZ4770  && !BR2_PACKAGE_SYSTEM_TARGET_BCM2835 && !BR2_PACKAGE_SYSTEM_TARGET_CHA  && !BR2_PACKAGE_SYSTEM_TARGET_MINI # LED Manager for Linux
	select BR2_PACKAGE_INNOEXTRACT			if !BR2_PACKAGE_REGLINUX_RELEASE && !BR2_PACKAGE_SYSTEM_TARGET_CHA && !BR2_PACKAGE_SYSTEM_TARGET_MINI # Extract InnoSetup files (useful for Wine and GOG games)
	select BR2_PACKAGE_LGOGDOWNLOADER		if !BR2_PACKAGE_REGLINUX_RELEASE && !BR2_PACKAGE_SYSTEM_TARGET_CHA && !BR2_PACKAGE_SYSTEM_TARGET_MINI # Download games from GOG using command line
	select BR2_PACKAGE_TREE				# recursive directory listing (useful for generating documentation on rom directory structure)
	select BR2_PACKAGE_XXD				# hexdump utility

	# Python and SSL
	select BR2_PACKAGE_HOST_PYTHON3
	select BR2_PACKAGE_HOST_PYTHON3_SSL
	select BR2_PACKAGE_PYTHON3
	select BR2_PACKAGE_PYTHON3_SSL
	select BR2_PACKAGE_PYTHON3_XZ
	select BR2_PACKAGE_PYTHON3_PYOPENSSL

	select BR2_PACKAGE_PARTED			# partition management (for the first boot)
	select BR2_PACKAGE_USBMOUNT			# usb key/sd card mounter
	select BR2_PACKAGE_USBUTILS			# usb key/sd card tools
	select BR2_PACKAGE_REGLINUX_SCRIPTS		# REG-Linux scripts
	select BR2_PACKAGE_REGLINUX_MSG			if !BR2_mipsel # reglinux screen configuration
	select BR2_PACKAGE_BATOCERA_SETTINGS		# system-settings-get/set

	# Use ALSA light audio stack for weak platforms
	select BR2_PACKAGE_BATOCERA_AUDIO_ALSA			if BR2_PACKAGE_SYSTEM_TARGET_BCM2835	|| \
								   BR2_PACKAGE_SYSTEM_TARGET_CHA	|| \
								   BR2_PACKAGE_SYSTEM_TARGET_MINI	|| \
								   BR2_PACKAGE_SYSTEM_TARGET_RK3128	|| \
								   BR2_PACKAGE_SYSTEM_TARGET_JZ4770	|| \
								   BR2_PACKAGE_SYSTEM_TARGET_XU4
	# Use PipeWire audio stack for all other platforms
	select BR2_PACKAGE_BATOCERA_AUDIO			if !BR2_PACKAGE_BATOCERA_AUDIO_ALSA
	select BR2_PACKAGE_BATOCERA_BLUETOOTH			# batocera bluetooth
	select BR2_PACKAGE_REGLINUX_NOTICE			# boot pdf notice
	select BR2_PACKAGE_REGLINUX_TEST			# reglinux test script

	select BR2_PACKAGE_LIBDRM
	select BR2_PACKAGE_LIBV4L_UTILS				if BR2_PACKAGE_V4L
	select BR2_PACKAGE_LIBCEC				# libcec
	select BR2_PACKAGE_LIBCEC_LINUX_API			# libcec linux api
	select BR2_PACKAGE_EDID_DECODE				# edid monitor/tv support
	select BR2_PACKAGE_READ_EDID				# edid monitor/tv support
	select BR2_SYSTEM_ENABLE_NLS				# locales
	select BR2_PACKAGE_ACPID				if BR2_PACKAGE_SYSTEM_TARGET_X86_ANY

	select BR2_PACKAGE_KBD					# loadkeys
	select BR2_PACKAGE_XKEYBOARD_CONFIG			if BR2_PACKAGE_LIBXKBCOMMON # requirement for xkb to work, xkb is used by kodi, even without x for the keyboard
	select BR2_PACKAGE_GPTFDISK				# fs resize
	select BR2_PACKAGE_GPTFDISK_SGDISK			# fs resize
	select BR2_PACKAGE_E2FSPROGS				# fs resize
	select BR2_PACKAGE_E2FSPROGS_RESIZE2FS			# fs resize
	select BR2_PACKAGE_PACMAN				# pacman package manager
	select BR2_PACKAGE_FLATPAK				if BR2_PACKAGE_SYSTEM_TARGET_X86_64_ANY # flatpak app packaging system
	select BR2_PACKAGE_RYZENADJ				if BR2_PACKAGE_SYSTEM_TARGET_X86_64_ANY # ryzen apu configuration

	select BR2_PACKAGE_HTOP					# resources monitor
	select BR2_PACKAGE_BTOP					# resources monitor
	select BR2_PACKAGE_MOKUTIL				if BR2_PACKAGE_SYSTEM_TARGET_X86_64_ANY # mokutil machine owner key utility

	# Controllers
	#select BR2_PACKAGE_XONE				if !BR2_mipsel && !BR2_PACKAGE_SYSTEM_TARGET_BCM2835 && !BR2_PACKAGE_SYSTEM_TARGET_BCM2836 && !BR2_PACKAGE_SYSTEM_TARGET_RK3326 && !BR2_PACKAGE_SYSTEM_TARGET_CHA && !BR2_PACKAGE_SYSTEM_TARGET_S812 && !BR2_PACKAGE_SYSTEM_TARGET_H700  && !BR2_PACKAGE_SYSTEM_TARGET_MT8395 # xbox receiver (require linux >= 4.15)
	#select BR2_PACKAGE_XPAD_NOONE				if !BR2_mipsel && !BR2_PACKAGE_SYSTEM_TARGET_BCM2835 && !BR2_PACKAGE_SYSTEM_TARGET_BCM2836 && !BR2_PACKAGE_SYSTEM_TARGET_RK3326 && !BR2_PACKAGE_SYSTEM_TARGET_CHA # xbox receiver (require linux >= 4.15)
	select BR2_PACKAGE_XPADNEO				if !BR2_mipsel && !BR2_PACKAGE_SYSTEM_TARGET_RK3326 && !BR2_PACKAGE_SYSTEM_TARGET_CHA # xbox receiver (require linux >= 4.18)
	select BR2_PACKAGE_WII_U_GC_ADAPTER			if !BR2_mipsel && !BR2_PACKAGE_SYSTEM_TARGET_BCM2835 && !BR2_PACKAGE_SYSTEM_TARGET_BCM2836 && !BR2_PACKAGE_SYSTEM_TARGET_RK3326 && !BR2_PACKAGE_SYSTEM_TARGET_CHA # wii-u-gc-adapter
	select BR2_PACKAGE_WIIMOTES_RULES			if !BR2_mipsel && !BR2_PACKAGE_SYSTEM_TARGET_BCM2835 && !BR2_PACKAGE_SYSTEM_TARGET_BCM2836 && !BR2_PACKAGE_SYSTEM_TARGET_RK3326 && !BR2_PACKAGE_SYSTEM_TARGET_CHA && !BR2_PACKAGE_SYSTEM_TARGET_H700 # wiimotes
	select BR2_PACKAGE_WIIMOTE_3RDPARTY			if !BR2_mipsel && !BR2_PACKAGE_SYSTEM_TARGET_BCM2835 && !BR2_PACKAGE_SYSTEM_TARGET_BCM2836 && !BR2_PACKAGE_SYSTEM_TARGET_RK3326 && !BR2_PACKAGE_SYSTEM_TARGET_CHA # some non official wiimotes
	select BR2_PACKAGE_XWIIMOTE				if !BR2_PACKAGE_SYSTEM_TARGET_BCM2835 && !BR2_PACKAGE_SYSTEM_TARGET_BCM2836 && !BR2_PACKAGE_SYSTEM_TARGET_RK3326 && !BR2_PACKAGE_SYSTEM_TARGET_CHA # a tool to analye wiimote events (mainly to debug, but helps and is funny)
	select BR2_PACKAGE_BATOCERA_GUNS			if !BR2_mipsel && !BR2_PACKAGE_SYSTEM_TARGET_BCM2835 && !BR2_PACKAGE_SYSTEM_TARGET_BCM2836 && !BR2_PACKAGE_SYSTEM_TARGET_RK3326 && !BR2_PACKAGE_SYSTEM_TARGET_RK3128 && !BR2_PACKAGE_SYSTEM_TARGET_CHA && !BR2_PACKAGE_SYSTEM_TARGET_MINI && !BR2_PACKAGE_SYSTEM_TARGET_H700
	select BR2_PACKAGE_BATOCERA_WHEEL_CALIBRATOR		if !BR2_mipsel && !BR2_PACKAGE_SYSTEM_TARGET_BCM2835 && !BR2_PACKAGE_SYSTEM_TARGET_BCM2836 && !BR2_PACKAGE_SYSTEM_TARGET_RK3326 && !BR2_PACKAGE_SYSTEM_TARGET_RK3128 && !BR2_PACKAGE_SYSTEM_TARGET_H700 && !BR2_PACKAGE_SYSTEM_TARGET_CHA
	select BR2_PACKAGE_NEW_LG4FF				if !BR2_mipsel && !BR2_PACKAGE_SYSTEM_TARGET_BCM2835 && !BR2_PACKAGE_SYSTEM_TARGET_BCM2836 && !BR2_PACKAGE_SYSTEM_TARGET_RK3326 && !BR2_PACKAGE_SYSTEM_TARGET_RK3128 && !BR2_PACKAGE_SYSTEM_TARGET_CHA && !BR2_PACKAGE_SYSTEM_TARGET_H700 && !BR2_PACKAGE_SYSTEM_TARGET_S812 && !BR2_PACKAGE_SYSTEM_TARGET_MT8395 # Improved Linux module driver for Logitech driving wheels (the lg4ff is disabled in kernels)
	select BR2_PACKAGE_HID_NX				if !BR2_mipsel && !BR2_PACKAGE_SYSTEM_TARGET_BCM2835 && !BR2_PACKAGE_SYSTEM_TARGET_BCM2836 && !BR2_PACKAGE_SYSTEM_TARGET_RK3326 && !BR2_PACKAGE_SYSTEM_TARGET_CHA # updated nintendo switch controller driver, requires kernel > 4.4
	select BR2_PACKAGE_JAMMASD				if !BR2_mipsel && !BR2_PACKAGE_SYSTEM_TARGET_BCM2835 && !BR2_PACKAGE_SYSTEM_TARGET_BCM2836 && !BR2_PACKAGE_SYSTEM_TARGET_RK3326 && !BR2_PACKAGE_SYSTEM_TARGET_H700 && !BR2_PACKAGE_SYSTEM_TARGET_CHA
	#TODO MUSL
	select BR2_PACKAGE_XARCADE2JSTICK			if !BR2_TOOLCHAIN_USES_MUSL && !BR2_PACKAGE_SYSTEM_TARGET_BCM2835 && !BR2_PACKAGE_SYSTEM_TARGET_BCM2836 && !BR2_PACKAGE_SYSTEM_TARGET_RK3326 && !BR2_PACKAGE_SYSTEM_TARGET_CHA # keyboard events of the Xarcade Tankstick

	# Case
	select BR2_PACKAGE_ELEMENT14_PI_DESKTOP		if BR2_PACKAGE_SYSTEM_TARGET_BCM2836 || BR2_PACKAGE_SYSTEM_TARGET_BCM2837 # rpi2/rpi3
	select BR2_PACKAGE_GPICASE			if BR2_PACKAGE_SYSTEM_TARGET_RPI_ANY && !BR2_PACKAGE_SYSTEM_TARGET_BCM2712 # retroflag gpicase
	select BR2_PACKAGE_ROSHAMBO			if BR2_PACKAGE_SYSTEM_TARGET_RK3399 # roshambo case
	select BR2_PACKAGE_RPIGPIOSWITCH		if BR2_PACKAGE_SYSTEM_TARGET_RPI_ANY # gpio switchs
	select BR2_PACKAGE_RETROGAME			if BR2_PACKAGE_SYSTEM_TARGET_RPI_ANY # gpio pads
	select BR2_PACKAGE_DESKPIPRO			if BR2_PACKAGE_SYSTEM_TARGET_BCM2711 # deskpi pro case rpi4 only
	select BR2_PACKAGE_PIBOY			if BR2_PACKAGE_SYSTEM_TARGET_BCM2836	|| \
							   BR2_PACKAGE_SYSTEM_TARGET_BCM2837	|| \
							   BR2_PACKAGE_SYSTEM_TARGET_BCM2711 # piboy rpi3/rpi4
	select BR2_PACKAGE_PICADE			if BR2_PACKAGE_SYSTEM_TARGET_RPI_ANY # picade arcade case
	select BR2_PACKAGE_PIRONMAN			if BR2_PACKAGE_SYSTEM_TARGET_BCM2711 # pironman case is rpi4 only
	select BR2_PACKAGE_PIRONMAN5			if BR2_PACKAGE_SYSTEM_TARGET_BCM2712 # pironman 5 case is rpi5 only

	# LUA
	select BR2_PACKAGE_LUA
	select BR2_PACKAGE_LUA_5_4

	# swap on zram, optional user-enabled service
	select BR2_PACKAGE_REGLINUX_ZRAMSWAP	# ALL

	# irq balancing
	select BR2_PACKAGE_IRQBALANCE

	# networking stack
	select BR2_PACKAGE_REGLINUX_NETWORK

	# music support
	select BR2_PACKAGE_REGLINUX_MUSIC_SUPPORT

	# Feral GameMode
	select BR2_PACKAGE_GAMEMODE		# ALL

	# Vulkan-enabled targets
	select BR2_PACKAGE_REGLINUX_VULKAN	if  BR2_PACKAGE_SYSTEM_TARGET_X86_ANY	|| \
						    BR2_PACKAGE_SYSTEM_TARGET_ASAHI	|| \
						    BR2_PACKAGE_SYSTEM_TARGET_BCM2711	|| \
						    BR2_PACKAGE_SYSTEM_TARGET_BCM2712	|| \
						    BR2_PACKAGE_SYSTEM_TARGET_H616      || \
						    BR2_PACKAGE_SYSTEM_TARGET_H700      || \
						    BR2_PACKAGE_SYSTEM_TARGET_RK3326    || \
						    BR2_PACKAGE_SYSTEM_TARGET_RK3568    || \
						    BR2_PACKAGE_SYSTEM_TARGET_RK3588	|| \
						    BR2_PACKAGE_SYSTEM_TARGET_S905GEN3  || \
						    BR2_PACKAGE_SYSTEM_TARGET_S922X     || \
						    BR2_PACKAGE_SYSTEM_TARGET_SM6115	|| \
						    BR2_PACKAGE_SYSTEM_TARGET_SM8250	|| \
						    BR2_PACKAGE_SYSTEM_TARGET_SM8550	|| \
						    BR2_PACKAGE_SYSTEM_TARGET_JH7110	|| \
						    BR2_PACKAGE_SYSTEM_TARGET_TH1520	|| \
						    BR2_PACKAGE_SYSTEM_TARGET_K1

	# compression tools
	select BR2_PACKAGE_UNZIP	# for /userdata/system/upgrade/share.zip
	select BR2_PACKAGE_XZ		# for updates
	select BR2_PACKAGE_ZSTD		# for btrfs compression
	select BR2_PACKAGE_LZ4		# for initramfs compression

	# script tool
	select BR2_PACKAGE_DIALOG
	select BR2_PACKAGE_MOSQUITTO    if !BR2_PACKAGE_SYSTEM_TARGET_CHA && !BR2_PACKAGE_SYSTEM_TARGET_MINI # connected object interface (https://wiki.batocera.org/hardware:lcd_led_marquees)

	# tools
	select BR2_PACKAGE_I2C_TOOLS
	select BR2_PACKAGE_MDADM	if BR2_PACKAGE_SYSTEM_TARGET_X86_ANY # RAID
	select BR2_PACKAGE_MC		if !BR2_PACKAGE_SYSTEM_TARGET_CHA && !BR2_PACKAGE_SYSTEM_TARGET_MINI
	select BR2_PACKAGE_OD_COMMANDER # ALL
	select BR2_PACKAGE_PYTHON_SERIAL		if BR2_PACKAGE_SYSTEM_TARGET_X86_ANY
	select BR2_PACKAGE_SMARTMONTOOLS
	# Removed because Qt5
	#select BR2_PACKAGE_BAUH			if BR2_PACKAGE_SYSTEM_TARGET_X86_64_ANY # flatpak gui

	# gpio controllers
	select BR2_PACKAGE_DB9_GPIO_RPI					if BR2_PACKAGE_SYSTEM_TARGET_RPI_ANY
	select BR2_PACKAGE_GAMECON_GPIO_RPI				if BR2_PACKAGE_SYSTEM_TARGET_RPI_ANY
	select BR2_PACKAGE_MK_ARCADE_JOYSTICK_RPI			if BR2_PACKAGE_SYSTEM_TARGET_RPI_ANY
	select BR2_PACKAGE_PYTHON3_GPIOD				if BR2_PACKAGE_SYSTEM_TARGET_RPI_ANY
	select BR2_PACKAGE_PYTHON_RPI_GPIO				if BR2_PACKAGE_SYSTEM_TARGET_RPI_ANY && !BR2_PACKAGE_SYSTEM_TARGET_BCM2712
	select BR2_PACKAGE_PYTHON_GPIOZERO				if BR2_PACKAGE_SYSTEM_TARGET_BCM2835 || BR2_PACKAGE_SYSTEM_TARGET_BCM2836
	select BR2_PACKAGE_PYTHON_ADAFRUIT_CIRCUITPYTHON_WS2801		if BR2_PACKAGE_SYSTEM_TARGET_RPI_ANY && !BR2_PACKAGE_SYSTEM_TARGET_BCM2712

	# GPIO kernel driver
	select BR2_PACKAGE_LIBGPIOD		if BR2_PACKAGE_SYSTEM_TARGET_BCM2712	|| \
						  !BR2_PACKAGE_SYSTEM_TARGET_BCM2711	&& \
						  !BR2_PACKAGE_SYSTEM_TARGET_BCM2835	&& \
						  !BR2_PACKAGE_SYSTEM_TARGET_BCM2836	&& \
						  !BR2_PACKAGE_SYSTEM_TARGET_BCM2837	&& \
						   BR2_TOOLCHAIN_HEADERS_AT_LEAST_4_8

	# joy 2 pad
	select BR2_PACKAGE_EVMAPY
	select BR2_PACKAGE_EVMAPY_SYSTEM_CONFIG

	# FUN R1 Gamepad
	select BR2_PACKAGE_FUN_R1_GAMEPAD	if BR2_PACKAGE_SYSTEM_TARGET_S905

	# leds
	select BR2_PACKAGE_AYN_PLATFORM		  if BR2_PACKAGE_SYSTEM_TARGET_X86_ANY
	select BR2_PACKAGE_AYANEO_PLATFORM    if BR2_PACKAGE_SYSTEM_TARGET_X86_ANY

	help
	  Install the batocera.linux system files

config BR2_PACKAGE_SYSTEM_DEBUG
	bool "System debug mode"

	select BR2_PACKAGE_TMUX
	select BR2_PACKAGE_STRACE
	select BR2_PACKAGE_VALGRIND                     if !BR2_arm && !BR2_riscv
	select BR2_BINUTILS_GPROFNG
	select BR2_PACKAGE_GDB
	select BR2_PACKAGE_GDB_DEBUGGER
	select BR2_PACKAGE_LINUX_TOOLS_PERF
	select BR2_PACKAGE_LINUX_TOOLS_PERF_TUI
	select BR2_PACKAGE_MESA3D_DEMOS			if BR2_PACKAGE_MESA3D

	help
	  Install packages for system debug mode

config BR2_PACKAGE_SYSTEM_TOOLS
	bool "System tools"

	select BR2_PACKAGE_JSTEST2				# joysticks tester
	select BR2_PACKAGE_EVTEST				# joysticks tester
	select BR2_PACKAGE_LINUXCONSOLETOOLS			# tools for linux events calibration
	select BR2_PACKAGE_LINUXCONSOLETOOLS_JOYSTICK		# tools for linux events calibration
	select BR2_PACKAGE_LINUXCONSOLETOOLS_FORCEFEEDBACK	# tools for linux events calibration
	select BR2_PACKAGE_NCURSES				# ncurses
	select BR2_PACKAGE_NCURSES_WCHAR			# utf-8 support for ncurses
	select BR2_PACKAGE_NANO					# basic nano emulator
	select BR2_PACKAGE_ZIP					# zip tool
	select BR2_PACKAGE_P7ZIP				# zip tool
	select BR2_PACKAGE_NCDU					# Disk Usage
	select BR2_PACKAGE_FFMPEG_XCBGRAB			if BR2_PACKAGE_XORG7
	select BR2_PACKAGE_SWITCHRES				# switchres 15kHz
	select BR2_PACKAGE_LIBGPIOD_TOOLS			if BR2_PACKAGE_LIBGPIOD

	help
	  System tools

#### retroarch ####
config BR2_PACKAGE_REGLINUX_RETROARCH
	bool "REG-Linux RetroArch packages"

	# RetroArch frontend and core data
	select BR2_PACKAGE_RETROARCH
	select BR2_PACKAGE_BATOCERA_CONTROLLER_OVERLAYS
	select BR2_PACKAGE_REGLINUX_RETROACHIEVEMENTS_SOUNDS
	select BR2_PACKAGE_REGLINUX_BEZELS
	select BR2_PACKAGE_REGLINUX_SHADERS

#### systems ####
config BR2_PACKAGE_REGLINUX_ALL_SYSTEMS
	bool "REG-Linux all emulators packages selection"

	# RetroArch frontend and core data
	select BR2_PACKAGE_REGLINUX_RETROARCH

	# CJK support
	select BR2_PACKAGE_NOTO_CJK_FONTS

	# Include other systems
	select BR2_PACKAGE_REGLINUX_ARCADE_SYSTEMS
	select BR2_PACKAGE_REGLINUX_CONSOLE_SYSTEMS
	select BR2_PACKAGE_REGLINUX_HANDHELD_SYSTEMS
	select BR2_PACKAGE_REGLINUX_COMPUTER_SYSTEMS    if !BR2_PACKAGE_SYSTEM_TARGET_CHA
	select BR2_PACKAGE_REGLINUX_MSDOS_SYSTEMS	if !BR2_PACKAGE_SYSTEM_TARGET_CHA
	select BR2_PACKAGE_REGLINUX_SCUMMVM_SYSTEMS	if !BR2_PACKAGE_SYSTEM_TARGET_CHA
	select BR2_PACKAGE_REGLINUX_HOMEBREW_SYSTEMS

	select BR2_PACKAGE_REGLINUX_GAMESTREAM_SYSTEMS	if !BR2_PACKAGE_SYSTEM_TARGET_CHA
	select BR2_PACKAGE_REGLINUX_PORTS_SYSTEMS
	select BR2_PACKAGE_REGLINUX_FLASH_SYSTEMS	if !BR2_PACKAGE_SYSTEM_TARGET_CHA
	#select BR2_PACKAGE_REGLINUX_STEAM		if BR2_PACKAGE_SYSTEM_TARGET_X86_64_ANY

	select BR2_PACKAGE_REGLINUX_MULTI_SYSTEMS	if !BR2_PACKAGE_SYSTEM_TARGET_CHA
	select BR2_PACKAGE_REGLINUX_PINBALL_SYSTEMS	if !BR2_PACKAGE_SYSTEM_TARGET_CHA
	select BR2_PACKAGE_REGLINUX_MOBILE_SYSTEMS	if !BR2_PACKAGE_SYSTEM_TARGET_CHA && !BR2_PACKAGE_REGLINUX_RELEASE

	select BR2_PACKAGE_REGLINUX_GAMES

	help
	  batocera.linux all supported emulation systems

config BR2_PACKAGE_BATOCERA_GUNS
	bool "batocera guns support"
	select BR2_PACKAGE_AIMTRAK_GUNS				# aimtrak guns
	select BR2_PACKAGE_SAMCO_GUNS				# samco guns
	select BR2_PACKAGE_FUSION_LIGHTGUNS			# fusion lightguns
	select BR2_PACKAGE_DOLPHINBAR_GUNS			# dolphinbar guns
	#nope select BR2_PACKAGE_SINDEN_GUNS			# sinden guns (Needs to pull and build mono from scratch !!!!)
	select BR2_PACKAGE_AELIGHTGUN				# ae light gun
	select BR2_PACKAGE_GUN4IR_GUNS				# gun4ir guns
	select BR2_PACKAGE_RETROSHOOTER_GUNS			# retroshooter guns
	select BR2_PACKAGE_GUNCON				if BR2_PACKAGE_SYSTEM_TARGET_X86_64_ANY || BR2_PACKAGE_SYSTEM_TARGET_BCM2711 || BR2_PACKAGE_SYSTEM_TARGET_BCM2837 # guncon
	select BR2_PACKAGE_GUNCON3				# guncon3
	select BR2_PACKAGE_LIGHTGUNS_GAMES_PRECALIBRATIONS
	select BR2_PACKAGE_DOLPHINCROSSHAIRSPACK		if BR2_PACKAGE_DOLPHIN_EMU
	select BR2_PACKAGE_STEAMDECKGUN				if BR2_PACKAGE_SYSTEM_TARGET_X86_64_ANY

config BR2_PACKAGE_SYSTEM_LINUX_FIRMWARES
	bool "System firmware packages"

	# vim4
	select BR2_PACKAGE_FIRMWARE_KHADAS_VIM4		if BR2_PACKAGE_SYSTEM_TARGET_A3GEN2

	# armbian
	select BR2_PACKAGE_FIRMWARE_ARMBIAN		if BR2_PACKAGE_SYSTEM_TARGET_MT8395	|| \
						   	   BR2_PACKAGE_SYSTEM_TARGET_RK3399	|| \
							   BR2_PACKAGE_SYSTEM_TARGET_RK3568	|| \
							   BR2_PACKAGE_SYSTEM_TARGET_S9GEN4	|| \
							   BR2_PACKAGE_SYSTEM_TARGET_SM8550

	# alllinuxfirmwares
	select BR2_PACKAGE_ALLLINUXFIRMWARES		if !BR2_PACKAGE_SYSTEM_TARGET_H616 && !BR2_PACKAGE_SYSTEM_TARGET_H700

	# buildroot firmware
	select BR2_PACKAGE_LINUX_FIRMWARE		if BR2_PACKAGE_SYSTEM_TARGET_RK3288

	# audio
	select BR2_PACKAGE_SOUND_OPEN_FIRMWARE		if BR2_PACKAGE_SYSTEM_TARGET_X86_ANY

	# RK3588
	select BR2_PACKAGE_FIRMWARE_RK3588		if BR2_PACKAGE_SYSTEM_TARGET_RK3588

	# orangepi firmware
	select BR2_PACKAGE_FIRMWARE_ORANGEPI		if BR2_PACKAGE_SYSTEM_TARGET_H3		|| \
							   BR2_PACKAGE_SYSTEM_TARGET_H5		|| \
							   BR2_PACKAGE_SYSTEM_TARGET_H6		|| \
							   BR2_PACKAGE_SYSTEM_TARGET_H616	|| \
							   BR2_PACKAGE_SYSTEM_TARGET_H700

config BR2_PACKAGE_REGLINUX_SDL2
	bool "REG-Linux SDL2"

	select BR2_PACKAGE_SDL2
	#select BR2_PACKAGE_SDL2_GFX
	#select BR2_PACKAGE_SDL2_IMAGE
	#select BR2_PACKAGE_SDL2_MIXER
	#select BR2_PACKAGE_SDL2_NET
	#select BR2_PACKAGE_SDL2_TTF
	select BR2_PACKAGE_SDL2_OPENGLES	if BR2_PACKAGE_HAS_LIBGLES
	select BR2_PACKAGE_SDL2_OPENGL		if BR2_PACKAGE_HAS_LIBGL
	select BR2_PACKAGE_SDL2_X11		if BR2_PACKAGE_XWAYLAND
	select BR2_PACKAGE_SDL2_KMSDRM
	select BR2_PACKAGE_SDL2_WAYLAND		if BR2_PACKAGE_WAYLAND

config BR2_PACKAGE_REGLINUX_SDL3
	bool "REG-Linux SDL3"

	select BR2_PACKAGE_SDL3
	#select BR2_PACKAGE_SDL3_GFX
	#select BR2_PACKAGE_SDL3_IMAGE
	select BR2_PACKAGE_SDL3_MIXER
	#select BR2_PACKAGE_SDL3_NET
	#select BR2_PACKAGE_SDL3_TTF
	select BR2_PACKAGE_SDL3_OPENGLES	if BR2_PACKAGE_HAS_LIBGLES
	select BR2_PACKAGE_SDL3_OPENGL		if BR2_PACKAGE_HAS_LIBGL
	select BR2_PACKAGE_SDL3_X11		if BR2_PACKAGE_XWAYLAND
	select BR2_PACKAGE_SDL3_KMSDRM
	select BR2_PACKAGE_SDL3_WAYLAND		if BR2_PACKAGE_WAYLAND

config BR2_PACKAGE_REGLINUX_SWAY
	bool "REG-Linux sway packages selection"

	select BR2_PACKAGE_SEATD
	select BR2_PACKAGE_SWAY
	select BR2_PACKAGE_SWAYBG

config BR2_PACKAGE_REGLINUX_GAMESCOPE
	bool "REG-Linux gamescope packages selection"

	select BR2_PACKAGE_SEATD
	select BR2_PACKAGE_GAMESCOPE

config BR2_PACKAGE_REGLINUX_XWAYLAND
	bool "REG-Linux xwayland packages selection"

	# Xorg emulation layer of Wayland
	select BR2_PACKAGE_XORG7
	select BR2_PACKAGE_WLROOTS_X11		if BR2_PACKAGE_WLROOTS
	select BR2_PACKAGE_WLROOTS_XWAYLAND	if BR2_PACKAGE_WLROOTS

### ### ###
config BR2_PACKAGE_LLVM_BUILD_FROM_SOURCE
	bool "llvm-build-from-source"
	default n

### ### ###
```
