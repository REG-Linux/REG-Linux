## package/reglinux/emulators/flycast/Config.in
```kconfig
config BR2_PACKAGE_FLYCAST
    bool "flycast"
    select BR2_PACKAGE_SDL2
    select BR2_PACKAGE_LIBPNG
    select BR2_PACKAGE_LIBZIP
    depends on BR2_GCC_ENABLE_OPENMP
    select BR2_PACKAGE_BOOST
    select BR2_PACKAGE_BOOST_NOWIDE
    select BR2_PACKAGE_LIBAO
    select BR2_PACKAGE_LIBCURL
    select BR2_PACKAGE_LIBMINIUPNPC
    select BR2_PACKAGE_ELFUTILS
    select BR2_PACKAGE_GLSLANG		if BR2_PACKAGE_REGLINUX_VULKAN
    help
        Flycast is a multi-platform Sega Dreamcast, Naomi and Atomiswave emulator.
```

## package/reglinux/emulators/gopher64/Config.in
```kconfig
config BR2_PACKAGE_GOPHER64
	bool "gopher64"
	depends on BR2_PACKAGE_HOST_RUSTC_TARGET_ARCH_SUPPORTS
	select BR2_PACKAGE_HOST_RUSTC

	help
	N64 emulator written in Rust

	https://github.com/gopher64/gopher64
```

## package/reglinux/emulators/libretro/libretro-panda3ds/Config.in
```kconfig
config BR2_PACKAGE_LIBRETRO_PANDA3DS
    bool "libretro-panda3ds"
    select BR2_PACKAGE_SDL2
    select BR2_PACKAGE_GLSLANG	if BR2_PACKAGE_REGLINUX_VULKAN

    help
      Panda3DS is an HLE, red-panda-themed Nintendo 3DS emulator written in C++ which started out as a fun project out of curiosity, but evolved into something that can sort of play games!

      https://github.com/wheremyfoodat/Panda3DS
```

## package/reglinux/emulators/libretro/libretro-play/Config.in
```kconfig
config BR2_PACKAGE_LIBRETRO_PLAY
    bool "libretro-play"
    select BR2_PACKAGE_LIBGLEW	if BR2_PACKAGE_HAS_LIBGL
    select BR2_PACKAGE_LIBGLU   if BR2_PACKAGE_HAS_LIBGL

      help
        Play! - PlayStation2 Emulator

        https://purei.org/
```

## package/reglinux/emulators/mednafen/Config.in
```kconfig
config BR2_PACKAGE_MEDNAFEN
    bool "mednafen"
    select BR2_PACKAGE_SDL2
    select BR2_PACKAGE_ZLIB
    select BR2_PACKAGE_LIBPNG
    select BR2_PACKAGE_FLAC

    help
        Mednafen is a portable, utilizing OpenGL and SDL, argument(command-line)-driven multi-system emulator.

if BR2_PACKAGE_MEDNAFEN

config BR2_PACKAGE_MEDNAFEN_PCFX
        bool "mednafen-pcfx"

config BR2_PACKAGE_MEDNAFEN_PSX
        bool "mednafen-psx"

config BR2_PACKAGE_MEDNAFEN_SATURN
        bool "mednafen-saturn"

endif
```

## package/reglinux/emulators/oricutron/Config.in
```kconfig
config BR2_PACKAGE_ORICUTRON
    bool "oricutron"

    select BR2_PACKAGE_SDL2
  
    help
      Oricutron Oric computers emulator

      https://github.com/pete-gordon/oricutron
```

## package/reglinux/emulators/panda3ds/Config.in
```kconfig
config BR2_PACKAGE_PANDA3DS
    bool "panda3ds"
    select BR2_PACKAGE_SDL2

    help
      Panda3DS is an HLE, red-panda-themed Nintendo 3DS emulator written in C++ which started out as a fun project out of curiosity, but evolved into something that can sort of play games!

      https://github.com/wheremyfoodat/Panda3DS
```

## package/reglinux/emulators/play/Config.in
```kconfig
config BR2_PACKAGE_PLAY
    bool "play"
    select BR2_PACKAGE_PCRE2
    select BR2_PACKAGE_LIBCURL
    select BR2_PACKAGE_LIBCURL_OPENSSL
    select BR2_PACKAGE_LIBGLEW		               if BR2_PACKAGE_XORG7
    select BR2_PACKAGE_OPENAL
    select BR2_PACKAGE_REGLINUX_QT6
    select BR2_PACKAGE_SQLITE
    select BR2_PACKAGE_ECM

    help
      Play! is a PlayStation2 emulator.

      https://purei.org/
```

## package/reglinux/emulators/reglinux-mame/Config.in
```kconfig
config BR2_PACKAGE_HAS_MAME
        bool

config BR2_PACKAGE_HAS_LIBRETRO_MAME
        bool

config BR2_PACKAGE_REGLINUX_MAME
	bool "reglinux-mame"
	select BR2_PACKAGE_HAS_MAME
	select BR2_PACKAGE_HAS_LIBRETRO_MAME
	help
	  MAME and libretro-mame prebuilt package

	  https://github.com/REG-Linux/REG-MAME
```

## package/reglinux/emulators/reglinux-scummvm/Config.in
```kconfig
config BR2_PACKAGE_HAS_SCUMMVM
        bool

config BR2_PACKAGE_HAS_LIBRETRO_SCUMMVM
        bool

config BR2_PACKAGE_REGLINUX_SCUMMVM
	bool "reglinux-scummvm"

	# Make sure to build the dependencies even if prebuilt ScummVM
	select BR2_PACKAGE_SDL2
	select BR2_PACKAGE_LIBMPEG2
	select BR2_PACKAGE_JPEG
	select BR2_PACKAGE_LIBJPEG_BATO
	select BR2_PACKAGE_LIBOGG
	select BR2_PACKAGE_LIBVORBIS	if !BR2_arm && !BR2_mipsel
	select BR2_PACKAGE_TREMOR	if  BR2_arm || BR2_mipsel
	select BR2_PACKAGE_FLAC
	select BR2_PACKAGE_LIBMAD
	select BR2_PACKAGE_LIBPNG
	select BR2_PACKAGE_LIBTHEORA
	select BR2_PACKAGE_FAAD2
	select BR2_PACKAGE_FREETYPE
	select BR2_PACKAGE_ZLIB

	# Virtual packages for ES systems
	select BR2_PACKAGE_HAS_SCUMMVM
	select BR2_PACKAGE_HAS_LIBRETRO_SCUMMVM
	help
	  ScummVM and libretro-scummvm prebuilt package

	  https://github.com/REG-Linux/REG-ScummVM
```

## package/reglinux/emulators/ruffle/Config.in
```kconfig
config BR2_PACKAGE_RUFFLE
	bool "ruffle"
	depends on BR2_PACKAGE_HOST_RUSTC_TARGET_ARCH_SUPPORTS
	select BR2_PACKAGE_HOST_RUSTC

	help
        ruffle is a Flash Player emulator built in the Rust programming language.

        https://ruffle.rs/
```

## package/reglinux/emulators/snes9x/Config.in
```kconfig
config BR2_PACKAGE_SNES9X
	bool "snes9x"
	depends on BR2_PACKAGE_BATOCERA_QT6

	help
	  Snes9x - Portable Super Nintendo Entertainment System (TM) emulator

	  https://github.com/snes9xgit/snes9x/
```

## package/reglinux/emulators/thextech/Config.in
```kconfig
config BR2_PACKAGE_THEXTECH
    bool "thextech"
    select BR2_PACKAGE_SDL2
    select BR2_PACKAGE_SDL2_MIXER
    select BR2_PACKAGE_SDL2_TTF
    
    help
      TheXTech is a C++ SMBX engine

      https://github.com/Wohlstand/TheXTech/
```

## package/reglinux/emulators/xemu/Config.in
```kconfig
config BR2_PACKAGE_XEMU
    bool "xemu"
    depends on BR2_TOOLCHAIN_GCC_AT_LEAST_8
    select BR2_PACKAGE_SDL2
    select BR2_PACKAGE_LIBSAMPLERATE
    select BR2_PACKAGE_SLIRP
    select BR2_PACKAGE_PYTHON_PYYAML
    select BR2_PACKAGE_LIBPCAP
    select BR2_PACKAGE_HOST_LIBCURL
    select BR2_PACKAGE_HOST_LIBCURL_CURL
    help
        Xbox (og) emulator based on QEMU
        
        https://xemu.app/
```

## package/reglinux/libraries/appstream/Config.in
```kconfig
config BR2_PACKAGE_APPSTREAM
	bool "appstream"
	select BR2_PACKAGE_LIBXMLB
	select BR2_PACKAGE_ITSTOOL

	help 
	    AppStream makes machine-readable software metadata easily accessible. 
	    This library provides objects and helper methods to help reading and writing AppStream metadata.

		https://github.com/ximion/appstream
```

## package/reglinux/libraries/gamemode/Config.in
```kconfig
config BR2_PACKAGE_GAMEMODE
	bool "gamemode"

	help 
	    GameMode is a daemon/lib combo for Linux that allows games to request a set of optimisations be temporarily applied to the host OS and/or a game process.

		https://github.com/FeralInteractive/gamemode
```

## package/reglinux/libraries/goofy/Config.in
```kconfig
config BR2_PACKAGE_GOOFY
	bool "goofy"
		help
		Goofy ETC + SSE2NEON
		https://github.com/rtissera/Goofy
```

## package/reglinux/libraries/librashader/Config.in
```kconfig
config BR2_PACKAGE_LIBRASHADER
	bool "librashder"
	depends on BR2_PACKAGE_HOST_RUSTC_TARGET_ARCH_SUPPORTS
	select BR2_PACKAGE_HOST_RUSTC
	depends on BR2_PACKAGE_LIBGLFW
	depends on BR2_PACKAGE_XORG7

	help
        librashader is a preprocessor, compiler, and runtime for RetroArch 'slang' shaders, rewritten in pure Rust.

        https://github.com/SnowflakePowered/librashader
```

## package/reglinux/libraries/libxmlb/Config.in
```kconfig
config BR2_PACKAGE_LIBXMLB
	bool "libxmlb"

	help 
	    This allows an application to mmap the binary XML file, do an XPath query and return some strings without actually parsing the entire document. 
	    This is all done using (almost) zero allocations and no actual copying of the binary data.

		https://github.com/hughsie/libxmlb
```

## package/reglinux/libraries/lunasvg/Config.in
```kconfig
config BR2_PACKAGE_LUNASVG
	bool "lunasvg"

	help
	  LunaSVG is an SVG rendering library in C++, designed to be lightweight and portable, 
	  offering efficient rendering and manipulation of Scalable Vector Graphics (SVG) files.

	  https://github.com/sammycage/lunasvg
```

## package/reglinux/libraries/mimalloc/Config.in
```kconfig
config BR2_PACKAGE_MIMALLOC
	bool "mimalloc"

	help
	  mimalloc (pronounced "me-malloc") is a general purpose allocator with excellent performance characteristics. 
	  Initially developed by Daan Leijen for the runtime systems of the Koka and Lean languages.

	  https://github.com/microsoft/mimalloc
```

## package/reglinux/libraries/plutosvg/Config.in
```kconfig
config BR2_PACKAGE_PLUTOSVG
	bool "plutosvg"
	select BR2_PACKAGE_PLUTOVG
	help
	  PlutoSVG is a compact and efficient SVG rendering library written in C.

	  https://github.com/sammycage/plutosvg
```

## package/reglinux/libraries/reglinux-qt6/Config.in
```kconfig
  source "$BR2_EXTERNAL_BATOCERA_PATH/package/reglinux/libraries/reglinux-qt6/qt6tools/Config.in"
  source "$BR2_EXTERNAL_BATOCERA_PATH/package/reglinux/libraries/reglinux-qt6/qt6multimedia/Config.in"
  source "$BR2_EXTERNAL_BATOCERA_PATH/package/reglinux/libraries/reglinux-qt6/qt6wayland/Config.in"
  source "$BR2_EXTERNAL_BATOCERA_PATH/package/reglinux/libraries/reglinux-qt6/qt6websockets/Config.in"
  source "$BR2_EXTERNAL_BATOCERA_PATH/package/reglinux/libraries/reglinux-qt6/qt6declarative/Config.in"
  source "$BR2_EXTERNAL_BATOCERA_PATH/package/reglinux/libraries/reglinux-qt6/qt6shadertools/Config.in"
  #source "$BR2_EXTERNAL_BATOCERA_PATH/package/libraries/reglinux-qt6/qt6quick/Config.in"

config BR2_PACKAGE_REGLINUX_QT6_BUILD_FROM_SOURCE
        bool "reglinux-qt6-build-from-source"
        default n

config BR2_PACKAGE_REGLINUX_HAS_QT6
        bool

config BR2_PACKAGE_REGLINUX_QT6
        bool "reglinux-qt6"

        select BR2_PACKAGE_DOUBLE_CONVERSION
        select BR2_PACKAGE_LIBB2
        select BR2_PACKAGE_PCRE2
        select BR2_PACKAGE_PCRE2_16
        # REG fix qt6.5 build failing if not PCRE2_32 selected
        select BR2_PACKAGE_PCRE2_32
        select BR2_PACKAGE_ZLIB

        select BR2_PACKAGE_QT6				if BR2_PACKAGE_REGLINUX_QT6_BUILD_FROM_SOURCE
        select BR2_PACKAGE_QT6_VERSION_LATEST		if BR2_PACKAGE_REGLINUX_QT6_BUILD_FROM_SOURCE
        select BR2_PACKAGE_QT6BASE			if BR2_PACKAGE_REGLINUX_QT6_BUILD_FROM_SOURCE
        select BR2_PACKAGE_QT6BASE_CONCURRENT		if BR2_PACKAGE_REGLINUX_QT6_BUILD_FROM_SOURCE
        select BR2_PACKAGE_QT6BASE_DBUS			if BR2_PACKAGE_REGLINUX_QT6_BUILD_FROM_SOURCE
        select BR2_PACKAGE_QT6BASE_FONTCONFIG		if BR2_PACKAGE_REGLINUX_QT6_BUILD_FROM_SOURCE
        select BR2_PACKAGE_QT6BASE_GIF			if BR2_PACKAGE_REGLINUX_QT6_BUILD_FROM_SOURCE
        select BR2_PACKAGE_QT6BASE_GUI			if BR2_PACKAGE_REGLINUX_QT6_BUILD_FROM_SOURCE
        select BR2_PACKAGE_QT6BASE_JPEG			if BR2_PACKAGE_REGLINUX_QT6_BUILD_FROM_SOURCE
        select BR2_PACKAGE_QT6BASE_NETWORK		if BR2_PACKAGE_REGLINUX_QT6_BUILD_FROM_SOURCE
        select BR2_PACKAGE_QT6BASE_PNG			if BR2_PACKAGE_REGLINUX_QT6_BUILD_FROM_SOURCE
        select BR2_PACKAGE_QT6BASE_PRINTSUPPORT		if BR2_PACKAGE_REGLINUX_QT6_BUILD_FROM_SOURCE
        select BR2_PACKAGE_QT6BASE_SQL			if BR2_PACKAGE_REGLINUX_QT6_BUILD_FROM_SOURCE
        select BR2_PACKAGE_QT6BASE_TEST			if BR2_PACKAGE_REGLINUX_QT6_BUILD_FROM_SOURCE
        select BR2_PACKAGE_QT6BASE_WIDGETS		if BR2_PACKAGE_REGLINUX_QT6_BUILD_FROM_SOURCE
        select BR2_PACKAGE_QT6BASE_XML			if BR2_PACKAGE_REGLINUX_QT6_BUILD_FROM_SOURCE
        select BR2_PACKAGE_QT6BASE_OPENGL               if BR2_PACKAGE_REGLINUX_QT6_BUILD_FROM_SOURCE && BR2_PACKAGE_HAS_LIBGL
        select BR2_PACKAGE_QT6BASE_OPENGL_DESKTOP       if BR2_PACKAGE_REGLINUX_QT6_BUILD_FROM_SOURCE && BR2_PACKAGE_HAS_LIBGL
        select BR2_PACKAGE_QT6BASE_OPENGL_ES2           if BR2_PACKAGE_REGLINUX_QT6_BUILD_FROM_SOURCE && BR2_PACKAGE_HAS_LIBGLES
        select BR2_PACKAGE_QT6BASE_EGLFS                if BR2_PACKAGE_REGLINUX_QT6_BUILD_FROM_SOURCE && BR2_PACKAGE_HAS_LIBEGL
        select BR2_PACKAGE_QT6BASE_XCB                  if BR2_PACKAGE_REGLINUX_QT6_BUILD_FROM_SOURCE && BR2_PACKAGE_XORG7
        select BR2_PACKAGE_QT6DECLARATIVE		if BR2_PACKAGE_REGLINUX_QT6_BUILD_FROM_SOURCE
        select BR2_PACKAGE_QT6MULTIMEDIA		if BR2_PACKAGE_REGLINUX_QT6_BUILD_FROM_SOURCE
        select BR2_PACKAGE_QT6SHADERTOOLS		if BR2_PACKAGE_REGLINUX_QT6_BUILD_FROM_SOURCE
        select BR2_PACKAGE_QT6SVG			if BR2_PACKAGE_REGLINUX_QT6_BUILD_FROM_SOURCE
        select BR2_PACKAGE_QT6TOOLS			if BR2_PACKAGE_REGLINUX_QT6_BUILD_FROM_SOURCE
        select BR2_PACKAGE_QT6TOOLS_LINGUIST_TOOLS	if BR2_PACKAGE_REGLINUX_QT6_BUILD_FROM_SOURCE
        select BR2_PACKAGE_QT6WAYLAND			if BR2_PACKAGE_REGLINUX_QT6_BUILD_FROM_SOURCE
        select BR2_PACKAGE_QT6WEBSOCKETS		if BR2_PACKAGE_REGLINUX_QT6_BUILD_FROM_SOURCE

	select BR2_PACKAGE_REGLINUX_HAS_QT6

	help
	    Prebuilt (or built from source) REG-Linux QT6 stack
```

## package/reglinux/libraries/reglinux-qt6/qt6quick/Config.in
```kconfig
config BR2_PACKAGE_QT6QUICK
	bool "qt6quick"
	select BR2_PACKAGE_QT6BASE_GUI
	help
	  Qt is a cross-platform application and UI framework for
	  developers using C++.

	  Qt Quick3DQtprovides a high-level API for creating 3D content and 3D user interfaces based on Qt Quick. 
	  Rather than using an external engine, which creates syncing issues and additional layers of abstraction, 

	  https://doc.qt.io/qt-6/qtquick3d-index.html
```

## package/reglinux/libraries/sdl3-mixer/Config.in
```kconfig
config BR2_PACKAGE_SDL3_MIXER
	bool "sdl3-mixer"
	depends on !BR2_STATIC_LIBS
	depends on BR2_PACKAGE_SDL3
	help
	  SDL_mixer 3.0

	  SDL3-based simple multi-channel audio mixer.
	  https://github.com/libsdl-org/SDL_mixer

if BR2_PACKAGE_SDL3_MIXER
# TODO
endif

comment "SDL3_Mixer needs a toolchain w/ dynamic library"
	depends on BR2_STATIC_LIBS
```
