## package/reglinux/libraries/vulkan-volk/Config.in
```kconfig
config BR2_PACKAGE_VULKAN_VOLK
	select BR2_PACKAGE_VULKAN_HEADERS
	bool "vulkan-volk"
		help
		Meta loader for Vulkan
		https://github.com/zeux/volk
```

## package/reglinux/libsmbclient/Config.in
```kconfig
comment "libsmbclient needs a uClibc or glibc toolchain w/ wchar, dynamic library, NPTL"
	depends on BR2_TOOLCHAIN_HAS_SYNC_4
	depends on !BR2_USE_WCHAR || BR2_TOOLCHAIN_USES_MUSL \
		|| BR2_STATIC_LIBS || !BR2_TOOLCHAIN_HAS_THREADS_NPTL
	depends on BR2_USE_MMU

config BR2_PACKAGE_LIBSMBCLIENT
	bool "libsmbclient"

        depends on BR2_USE_MMU # fork()
        depends on BR2_USE_WCHAR # python
        depends on BR2_TOOLCHAIN_HAS_THREADS_NPTL # python -> libffi
        depends on !BR2_STATIC_LIBS # cmocka, python, gnutls
        depends on !BR2_nios2 # binary too large, relocations don't fit
        depends on BR2_TOOLCHAIN_HAS_SYNC_4
        depends on !BR2_TOOLCHAIN_USES_MUSL
        select BR2_PACKAGE_CMOCKA
        select BR2_PACKAGE_E2FSPROGS
        select BR2_PACKAGE_GNUTLS
        select BR2_PACKAGE_LIBICONV if !BR2_ENABLE_LOCALE
        select BR2_PACKAGE_LIBTIRPC if !BR2_TOOLCHAIN_HAS_NATIVE_RPC
	select BR2_PACKAGE_OPENLDAP
        select BR2_PACKAGE_POPT
        select BR2_PACKAGE_ZLIB

	help
	  libsmbclient is a library toolset that permits applications
	  to manipulate CIFS/SMB network resources using many of the
	  standards POSIX functions available for manipulating local
	  files.
```

## package/reglinux/nuitka/Config.in
```kconfig
config BR2_PACKAGE_NUITKA
    bool "nuitka"

    #select BR2_PACKAGE_PATCHELF
    select BR2_PACKAGE_HOST_PATCHELF
    select BR2_PACKAGE_HOST_PYTHON3
    select BR2_PACKAGE_HOST_ZSTD
    select BR2_PACKAGE_PYTHON3

    select BR2_PACKAGE_HOST_PYTHON_PIP
    select BR2_PACKAGE_PYTHON_PIP

    help
      Nuitka is the optimizing Python compiler written in Python that creates executables that run without a separate installer.
      
      https://github.com/Nuitka/Nuitka
```

## package/reglinux/ports/dhewm3/Config.in
```kconfig
config BR2_PACKAGE_DHEWM3
	bool "dhewm3"
	select BR2_PACKAGE_ZLIB
	select BR2_PACKAGE_OPENAL
	select BR2_PACKAGE_SDL2

	help
	  Doom 3 source port.

	  https://dhewm3.org/
```

## package/reglinux/ports/ioquake3/Config.in
```kconfig
config BR2_PACKAGE_IOQUAKE3
    bool "ioquake3"
    select BR2_PACKAGE_SDL2
    select BR2_PACKAGE_SDL2_NET
    depends on BR2_PACKAGE_HAS_LIBGL || BR2_PACKAGE_HAS_LIBGLES
    help
      The ioquake3 community effort to continue supporting/developing id's Quake III Arena.
      
      https://www.ioquake3.org/
```

## package/reglinux/ports/openlara/Config.in
```kconfig
config BR2_PACKAGE_OPENLARA
	bool "openlara"
	select BR2_PACKAGE_ZLIB
	select BR2_PACKAGE_OPENAL
	select BR2_PACKAGE_SDL2

	help
	  OpenLara Tomb Raider 1 (2, 3 WIP) open-source engine

	  https://github.com/XProger/OpenLara
```

## package/reglinux/ports/openmw/Config.in
```kconfig
config BR2_PACKAGE_OPENMW
	bool "openmw"
	depends on BR2_PACKAGE_HAS_LIBGL
	depends on BR2_PACKAGE_XORG7
	select BR2_PACKAGE_CAIRO
	select BR2_PACKAGE_FFMPEG
	select BR2_PACKAGE_SQLITE
	select BR2_PACKAGE_BOOST
	select BR2_PACKAGE_LZ4
	select BR2_PACKAGE_SDL2
	select BR2_PACKAGE_YAML_CPP
	select BR2_PACKAGE_BULLET
	select BR2_PACKAGE_OPENAL
	select BR2_PACKAGE_FONTCONFIG
	select BR2_PACKAGE_FREETYPE

	help
	  OpenMW is a free and open-source game engine recreation 
          that reimplements the one powering open-world role-playing game 
          The Elder Scrolls III: Morrowind

	  https://openmw.org
```

## package/reglinux/ports/yquake2/Config.in
```kconfig
  source "$BR2_EXTERNAL_BATOCERA_PATH/package/reglinux/ports/yquake2/yquake2-client/Config.in"
  source "$BR2_EXTERNAL_BATOCERA_PATH/package/reglinux/ports/yquake2/yquake2-xatrix/Config.in"
  source "$BR2_EXTERNAL_BATOCERA_PATH/package/reglinux/ports/yquake2/yquake2-rogue/Config.in"
  source "$BR2_EXTERNAL_BATOCERA_PATH/package/reglinux/ports/yquake2/yquake2-ctf/Config.in"
  source "$BR2_EXTERNAL_BATOCERA_PATH/package/reglinux/ports/yquake2/yquake2-zaero/Config.in"

config BR2_PACKAGE_YQUAKE2
        bool "yquake2"
	select BR2_PACKAGE_YQUAKE2_CLIENT
	select BR2_PACKAGE_YQUAKE2_XATRIX
	select BR2_PACKAGE_YQUAKE2_ROGUE
	select BR2_PACKAGE_YQUAKE2_CTF
	select BR2_PACKAGE_YQUAKE2_ZAERO

        help
          Yamagi Quake 2 source port.

          https://www.yamagi.org/quake2/
```

## package/reglinux/ports/yquake2/yquake2-client/Config.in
```kconfig
config BR2_PACKAGE_YQUAKE2_CLIENT
	bool "yquake2"
	select BR2_PACKAGE_SDL2
	select BR2_PACKAGE_YQUAKE2_XATRIX

	help
	  Yamagi Quake 2

	  https://github.com/yquake2/yquake2
```

## package/reglinux/ports/yquake2/yquake2-ctf/Config.in
```kconfig
config BR2_PACKAGE_YQUAKE2_CTF
	bool "yquake2-ctf"

	help
	  Yamagi Quake 2 CTF

	  https://github.com/yquake2/ctf
```

## package/reglinux/ports/yquake2/yquake2-rogue/Config.in
```kconfig
config BR2_PACKAGE_YQUAKE2_ROGUE
	bool "yquake2-rogue"

	help
	  Yamagi Quake 2 Rogue

	  https://github.com/yquake2/rogue
```

## package/reglinux/ports/yquake2/yquake2-zaero/Config.in
```kconfig
config BR2_PACKAGE_YQUAKE2_ZAERO
	bool "yquake2-zaero"

	help
	  Yamagi Quake 2 Zaero

	  https://github.com/yquake2/zaero
```

## package/reglinux/reg-rescue/Config.in
```kconfig
config BR2_PACKAGE_REG_RESCUE
        bool "reg-rescue"
        help
          minimal rootfs for rescue/update mode
```

## package/reglinux/reglinux-bezels/Config.in
```kconfig
config BR2_PACKAGE_REGLINUX_BEZELS
        bool "REG Linux bezels"
        help
          REG Linux bezels

	  https://github.com/REG-Linux/REG-bezel
```

## package/reglinux/reglinux-exfat/Config.in
```kconfig
config BR2_PACKAGE_REGLINUX_EXFAT
        bool "reglinux-exfat"

	# exFAT FUSE implementation
        select BR2_PACKAGE_EXFAT                        
	# exFAT userspace utilities (for FUSE-based driver)
        select BR2_PACKAGE_EXFAT_UTILS                  if  BR2_PACKAGE_EXFAT 
	# exFAT userspace utilities (for 5.7+ kernel-based support)
        select BR2_PACKAGE_EXFATPROGS                   if !BR2_PACKAGE_HOST_LINUX_HEADERS_CUSTOM_4_4 && !BR2_PACKAGE_HOST_LINUX_HEADERS_CUSTOM_5_4 

        help
          exFAT custom implementation using either FUSE or in-kernel exFAT support
```

## package/reglinux/reglinux-gpicase/Config.in
```kconfig
config BR2_PACKAGE_REGLINUX_GPICASE
        bool "reglinux-gpicase"
	depends on BR2_PACKAGE_BATOCERA_RPI_ANY

comment "reglinux-gpicase"
	depends on BR2_PACKAGE_BATOCERA_RPI_ANY
```

## package/reglinux/reglinux-ntfs/Config.in
```kconfig
config BR2_PACKAGE_REGLINUX_NTFS
        bool "reglinux-ntfs"

	# Use ntfs-3g only for kernel < 5.15 (TODO)
        select BR2_PACKAGE_NTFS_3G                      #if BR2_PACKAGE_HOST_LINUX_HEADERS_CUSTOM_4_4 || BR2_PACKAGE_HOST_LINUX_HEADERS_CUSTOM_5_4 || BR2_PACKAGE_HOST_LINUX_HEADERS_CUSTOM_5_10
	# NTFS user-space utilities for ntfs-3g
        select BR2_PACKAGE_NTFS_3G_NTFSPROGS            if BR2_PACKAGE_NTFS_3G 

        help
          NTFS custom implementation using either FUSE ntfs-3g or in-kernel (5.15+) NTFS3 r/w support
```

## package/reglinux/reglinux-rescue/Config.in
```kconfig
config BR2_PACKAGE_REGLINUX_RESCUE
        bool "reglinux-rescue"
        help
          minimal rootfs for rescue/update mode
```

## package/reglinux/reglinux-resolution/Config.in
```kconfig
config BR2_PACKAGE_REGLINUX_RESOLUTION
	bool "reglinux-resolution"

	select BR2_PACKAGE_BASH
	select BR2_PACKAGE_PCIUTILS
	select BR2_PACKAGE_GRIM         if BR2_PACKAGE_REGLINUX_SWAY
	select BR2_PACKAGE_WF_RECORDER  if BR2_PACKAGE_REGLINUX_SWAY

	help
	  REGLinux resolution
```

## package/reglinux/reglinux-samba/Config.in
```kconfig
config BR2_PACKAGE_REGLINUX_SAMBA
        bool "reglinux-samba"

	select BR2_PACKAGE_SAMBA4	\
		if BR2_PACKAGE_BATOCERA_TARGET_WINE    || \
		   BR2_PACKAGE_BATOCERA_TARGET_RK3128

	select BR2_PACKAGE_KSMBD_TOOLS  \
		if (!BR2_PACKAGE_BATOCERA_TARGET_RK3128)

        help
          Samba custom implementation using either ksmbd or plain samba4
```

## package/reglinux/reglinux-screen/Config.in
```kconfig
config BR2_PACKAGE_REGLINUX_SCREEN
	bool "reglinux-screen"

	select BR2_PACKAGE_BASH
	select BR2_PACKAGE_PCIUTILS
	select BR2_PACKAGE_GRIM         if BR2_PACKAGE_REGLINUX_SWAY
	select BR2_PACKAGE_WF_RECORDER  if BR2_PACKAGE_REGLINUX_SWAY

	help
	  REGLinux screen configuration
```

## package/reglinux/reglinux-shaders/Config.in
```kconfig
config BR2_PACKAGE_REGLINUX_SHADERS
        bool "REG-Linux shaders"
	depends on BR2_PACKAGE_RETROARCH
        select BR2_PACKAGE_GLSL_SHADERS
        help
          REG-Linux shaders for retroarch
```

## package/reglinux/reglinux-splash/Config.in
```kconfig
config BR2_PACKAGE_REGLINUX_SPLASH
	bool "reglinux-splash"

	select BR2_PACKAGE_DEJAVU_SANS	if BR2_PACKAGE_REGLINUX_SPLASH_OMXPLAYER
	select BR2_PACKAGE_OMXPLAYER	if BR2_PACKAGE_REGLINUX_SPLASH_OMXPLAYER
	select BR2_PACKAGE_MPV		if BR2_PACKAGE_REGLINUX_SPLASH_MPV
	select BR2_PACKAGE_LIBASS	if BR2_PACKAGE_REGLINUX_SPLASH_MPV || BR2_PACKAGE_REGLINUX_SPLASH_FFPLAY
	select BR2_PACKAGE_FFMPEG	if BR2_PACKAGE_REGLINUX_SPLASH_FFPLAY
	select BR2_PACKAGE_FFPLAY	if BR2_PACKAGE_REGLINUX_SPLASH_FFPLAY

	help
	  REG-Linux splash

choice
	prompt "splash type"
	default BR2_PACKAGE_REGLINUX_SPLASH_IMAGE
	help
	  Select REG-Linux splash type

config BR2_PACKAGE_REGLINUX_SPLASH_IMAGE
	bool "image"

config BR2_PACKAGE_REGLINUX_SPLASH_OMXPLAYER
	bool "omxplayer"

config BR2_PACKAGE_REGLINUX_SPLASH_MPV
	bool "mpv"

config BR2_PACKAGE_REGLINUX_SPLASH_FFPLAY
	bool "ffmpeg"

endchoice
```

## package/reglinux/shaderc/Config.in
```kconfig
config BR2_PACKAGE_SHADERC
	bool "shaderc"
		help
		Gogle ShaderC
		https://github.com/google/shaderc/
```

## package/reglinux/utils/gamescope/Config.in
```kconfig
config BR2_PACKAGE_GAMESCOPE
    bool "gamescope"
    select BR2_PACKAGE_WAYLAND
    select BR2_PACKAGE_WLROOTS
    select BR2_PACKAGE_STB
    select BR2_PACKAGE_SDL2
    select BR2_PACKAGE_LIBDECOR
    select BR2_PACKAGE_GLM
    select BR2_PACKAGE_GLSLANG
    select BR2_PACKAGE_SPIRV_TOOLS
    select BR2_PACKAGE_XWAYLAND
    select BR2_PACKAGE_WLROOTS_XWAYLAND
    select BR2_PACKAGE_XORG7
    select BR2_PACKAGE_LIBXCB
    select BR2_PACKAGE_XLIB_LIBXCOMPOSITE
    select BR2_PACKAGE_XLIB_LIBXDAMAGE
    select BR2_PACKAGE_XLIB_LIBXRES
    select BR2_PACKAGE_XLIB_LIBXXF86VM
    select BR2_PACKAGE_XLIB_LIBXTST
    select BR2_PACKAGE_XLIB_LIBXCURSOR
    select BR2_PACKAGE_XLIB_LIBXMU

    help
        Valve Gamescope compositor.

	https://github.com/ValveSoftware/gamescope
```
