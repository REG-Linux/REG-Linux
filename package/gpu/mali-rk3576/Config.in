## package/gpu/mali-rk3576/Config.in
```kconfig
config BR2_PACKAGE_MALI_RK3576
	bool "mali-rk3576"
	depends on BR2_aarch64
	depends on BR2_TOOLCHAIN_USES_GLIBC
	select BR2_PACKAGE_HAS_LIBEGL
	select BR2_PACKAGE_HAS_LIBGLES
	select BR2_PACKAGE_HAS_LIBGBM
	help
	  Install userspace Rockchip Mali Bifrost G52 MC3 (g24p0)
	  libraries for RK3576 (Anbernic RG Vita Pro).

if BR2_PACKAGE_MALI_RK3576

config BR2_PACKAGE_PROVIDES_LIBEGL
	default "mali-rk3576"

config BR2_PACKAGE_PROVIDES_LIBGLES
	default "mali-rk3576"

config BR2_PACKAGE_PROVIDES_LIBGBM
	default "mali-rk3576"

endif
```

## package/gpu/powervr-ge8300-driver/Config.in
```kconfig
comment "powervr-ge8300-driver needs a glibc toolchain"
	depends on BR2_aarch64
	depends on BR2_PACKAGE_SYSTEM_TARGET_A133
	depends on !BR2_TOOLCHAIN_USES_GLIBC

config BR2_PACKAGE_POWERVR_GE8300_DRIVER
	bool "PowerVR GE8300 GPU driver"
	depends on BR2_aarch64
	depends on BR2_PACKAGE_SYSTEM_TARGET_A133
	# Binary libs are glibc-linked
	depends on BR2_TOOLCHAIN_USES_GLIBC
	select BR2_PACKAGE_HAS_LIBEGL
	select BR2_PACKAGE_HAS_LIBGLES

	help
	  Binary user-space driver for the PowerVR GE8300 GPU found in the
	  Allwinner A133 SoC (TrimUI Smart Pro, TrimUI Brick, Powkiddy V20,
	  Powkiddy V90S, MagicX Zero 28).

	  This package requires a BSP kernel (4.9.x) with the powervrkm
	  GPU kernel driver enabled. There is no mainline kernel support
	  for this GPU.

if BR2_PACKAGE_POWERVR_GE8300_DRIVER

config BR2_PACKAGE_PROVIDES_LIBEGL
	default "powervr-ge8300-driver"

config BR2_PACKAGE_PROVIDES_LIBGLES
	default "powervr-ge8300-driver"

endif
```

## package/gpu/reglinux-amd/Config.in
```kconfig
config BR2_PACKAGE_REGLINUX_AMD
    bool "reglinux-amd"
    select BR2_PACKAGE_XWAYLAND
    select BR2_PACKAGE_MESA3D
    help
      This package helps switch between the different mesa amd drivers
```

## package/gpu/reglinux-nvidia/Config.in
```kconfig
config BR2_PACKAGE_REGLINUX_NVIDIA
    bool "reglinux-nvidia"

    select BR2_PACKAGE_XWAYLAND

    # drivers
    select BR2_PACKAGE_NVIDIA_OPEN_DRIVER      # the latest driver
    select BR2_PACKAGE_NVIDIA580_LEGACY_DRIVER # the legacy 580.xx driver
    select BR2_PACKAGE_NVIDIA470_LEGACY_DRIVER # the legacy 470.xx driver

    # kernel modules
    select BR2_PACKAGE_NVIDIA_OPEN_DRIVER_MODULE
    select BR2_PACKAGE_NVIDIA580_LEGACY_DRIVER_MODULE
    select BR2_PACKAGE_NVIDIA470_LEGACY_DRIVER_MODULE

    # cuda
    select BR2_PACKAGE_NVIDIA_OPEN_DRIVER_CUDA

    help
      This package a switch between the different nvidia drivers

config BR2_PACKAGE_REGLINUX_NVIDIA_32BIT
    bool "32-bit (i386) driver libraries"
    depends on BR2_PACKAGE_REGLINUX_NVIDIA
    default n
    help
      Install the 32-bit NVIDIA userspace libraries into /lib32, for
      every driver branch, along with the matching i686 Vulkan ICDs.

      Say 'n' unless something on the image can actually execute 32-bit
      code. A pure 64-bit REG-Linux target has no /lib/ld-linux.so.2 and
      no 32-bit glibc, so these libraries can never be loaded - they only
      exist to support a 32-bit runtime such as Wine, which is packaged
      separately by board/scripts/doWinepackage.sh. Enabling this adds
      roughly 450MB of uncompressed libraries to the image.
```

## package/gpu/vulkan/vulkan-wsi-layer/Config.in
```kconfig
config BR2_PACKAGE_VULKAN_WSI_LAYER
    bool "vulkan-wsi-layer"
    depends on BR2_PACKAGE_WAYLAND
    select BR2_PACKAGE_VULKAN_HEADERS
    select BR2_PACKAGE_VULKAN_LOADER
    help
      Implicit Vulkan layer that adds Window System Integration
      (VK_KHR_wayland_surface) support on top of a Vulkan ICD that
      does not expose WSI extensions natively.  Required for
      proprietary Mali userspace blobs that ship libMaliVulkan.so
      with only VK_KHR_display surface support.

      Installed as
        /usr/share/vulkan/implicit_layer.d/VkLayer_window_system_integration.json
      so the Vulkan loader picks it up automatically for every
      Vulkan application.

      https://gitlab.freedesktop.org/mesa/vulkan-wsi-layer
```

## package/l4t/switch-atf/Config.in
```kconfig
config BR2_PACKAGE_SWITCH_ATF
	bool "switch-atf"
	depends on BR2_PACKAGE_SYSTEM_TARGET_L4T
	depends on BR2_aarch64
	help
	  ARM Trusted Firmware (BL31) for the Nintendo Switch Tegra T210 SoC.
	  Builds bl31.bin from the Switchroot ATF fork.

	  https://gitlab.com/switchroot/bootstack/switch-atf
```

## package/l4t/switch-bootloader/Config.in
```kconfig
config BR2_PACKAGE_SWITCH_BOOTLOADER
	bool "switch-bootloader"
	depends on BR2_PACKAGE_SYSTEM_TARGET_L4T
	depends on BR2_aarch64
	select BR2_PACKAGE_SWITCH_ATF
	select BR2_PACKAGE_SWITCH_U_BOOT
	help
	  Boot orchestration package for the Nintendo Switch.
	  Creates Hekate boot configuration, U-Boot boot script (boot.scr),
	  and ties together ATF (bl31), U-Boot (bl33), and device trees.
```

## package/l4t/switch-bsp/Config.in
```kconfig
config BR2_PACKAGE_SWITCH_BSP
	bool "switch-bsp"
	depends on BR2_PACKAGE_SYSTEM_TARGET_L4T
	depends on BR2_aarch64
	select BR2_PACKAGE_USB_GADGET_SCRIPTS
	help
	  Nintendo Switch Board Support Package for REG-Linux.
	  Provides Joy-Con pairing, dock hotplug, sysfs permissions,
	  ALSA UCM audio configuration, and USB gadget support.
```

## package/l4t/switch-u-boot/Config.in
```kconfig
config BR2_PACKAGE_SWITCH_U_BOOT
	bool "switch-u-boot"
	depends on BR2_PACKAGE_SYSTEM_TARGET_L4T
	depends on BR2_aarch64
	help
	  CTCaer's modified U-Boot for the Nintendo Switch,
	  integrated with the Hekate bootloader.
	  Builds bl33.bin (U-Boot payload) and mkimage host tool.

	  https://github.com/CTCaer/switch-l4t-uboot
```

## package/l4t/tegra-bsp/Config.in
```kconfig
config BR2_PACKAGE_TEGRA_BSP
	bool "tegra-bsp"
	depends on BR2_PACKAGE_SYSTEM_TARGET_L4T
	select BR2_PACKAGE_MESA3D
	select BR2_PACKAGE_LIBGLVND
	select BR2_PACKAGE_LIBGLVND_DISPATCH_EGL
	select BR2_PACKAGE_LIBGLVND_DISPATCH_GLES

	help
	  NVIDIA Tegra BSP (Board Support Package) proprietary userspace
	  libraries for L4T R32.3.1 (Tegra T210).
	  Provides EGL, GBM, CUDA, Vulkan ICD, and multimedia libraries.
	  Works with libglvnd to dispatch between Mesa (Nouveau) and
	  NVIDIA proprietary implementations.
```

## package/l4t/usb-gadget-scripts/Config.in
```kconfig
config BR2_PACKAGE_USB_GADGET_SCRIPTS
	bool "usb-gadget-scripts"
	depends on BR2_PACKAGE_SYSTEM_TARGET_L4T
	select BR2_PACKAGE_UMTP_RESPONDER
	help
	  USB gadget configuration scripts for the Nintendo Switch.
	  Sets up USB-C port as a USB gadget for MTP file transfer
	  and serial console when not docked.
```

## package/libraries/asio/Config.in
```kconfig
config BR2_PACKAGE_ASIO
	bool "asio"

	help
	  Asio is a cross-platform C++ library for network and low-level
	  I/O programming that provides a consistent asynchronous model.
	  This is the standalone (non-Boost) distribution.

	  https://think-async.com/Asio/
```

## package/libraries/libgme/Config.in
```kconfig
config BR2_PACKAGE_LIBGME
	bool "libgme"
	help
	  Game Music Emu is a library to play console-style music files
	  (NSF, GBS, SPC, VGM, GYM, AY, HES, SAP, KSS, NSFE).

	  https://bitbucket.org/mpyne/game-music-emu
```

## package/libraries/libmikmod/Config.in
```kconfig
config BR2_PACKAGE_LIBMIKMOD
	bool "libmikmod"
	help
	  Libmikmod is a portable sound library capable of playing samples as
	  well as module files. It supports many module formats including MOD,
	  S3M, XM, and IT.

	  https://github.com/sezero/mikmod
```

## package/libraries/libzedmd/Config.in
```kconfig
config BR2_PACKAGE_LIBZEDMD
    bool "libzedmd"
    select BR2_PACKAGE_LIBSERIALPORT
    select BR2_PACKAGE_SOCKPP
    select BR2_PACKAGE_CARGS
    select BR2_PACKAGE_LIBGPIOD if BR2_ARCH_AARCH64
    help
      ZeDMD communication library.

      https://github.com/PPUC/libzedmd
```

## package/libraries/nsync/Config.in
```kconfig
config BR2_PACKAGE_NSYNC
	bool "nsync"

	help
	  Google nsync library

	  https://github.com/google/nsync
```

## package/libraries/pdfium/Config.in
```kconfig
config BR2_PACKAGE_PDFIUM_ARCH_SUPPORTS
	bool
	default y if BR2_arm
	default y if BR2_aarch64
	default y if BR2_x86_64
	default y if BR2_riscv && BR2_ARCH_IS_64

config BR2_PACKAGE_PDFIUM
	bool "PDFium (prebuilt binaries)"
	depends on BR2_PACKAGE_PDFIUM_ARCH_SUPPORTS
	depends on BR2_TOOLCHAIN_USES_GLIBC || BR2_TOOLCHAIN_USES_MUSL
	help
	  Installs the prebuilt PDFium shared library and headers from
	  https://github.com/bblanchon/pdfium-binaries (chromium/7557 release).
	  The package provides `libpdfium.so` for arm, AArch64, riscv64 and
	  x86_64 targets. Only glibc and musl toolchains are supported, and
	  shared libraries must be enabled on the target.
	  The archive is published under the MIT license (see LICENSE).
```

## package/libraries/rapidyaml/Config.in
```kconfig
config BR2_PACKAGE_RAPIDYAML
	bool "rapidyaml"

	help
	  Rapid YAML (ryml) is a library to parse and emit YAML,
	  aimed at speed and low memory footprint. It is written
	  in C++.

	  https://github.com/biojppm/rapidyaml
```

## package/libraries/uchardet/Config.in
```kconfig
config BR2_PACKAGE_UCHARDET
	bool "uchardet"
	depends on BR2_INSTALL_LIBSTDCPP
	help
	  uchardet is an encoding detector library ported from
	  Mozilla's Universal Charset Detector. It detects the
	  encoding of text in a buffer.

	  https://gitlab.freedesktop.org/uchardet/uchardet
```

## package/network/rtl8733bu/Config.in
```kconfig
comment "rtl8733bu needs a Linux kernel to be built"
	depends on !BR2_LINUX_KERNEL

config BR2_PACKAGE_RTL8733BU
	bool "rtl8733bu"
	depends on BR2_LINUX_KERNEL
	help
	  Linux driver for the USB WiFi half of the Realtek RTL8733BU
	  WiFi/BT combo chip, as found in the Miyoo Flip.

	  https://github.com/Charliechen114514/rtl8733bu-linux-driver
```

## package/ports/bermuda/Config.in
```kconfig
config BR2_PACKAGE_BERMUDA
	bool "bermuda"
	depends on BR2_INSTALL_LIBSTDCPP
	select BR2_PACKAGE_SDL2
	select BR2_PACKAGE_SDL2_MIXER
	select BR2_PACKAGE_LIBVORBIS
	select BR2_PACKAGE_LIBOGG
	select BR2_PACKAGE_ZLIB
	help
	  Reimplementation of the engine used in Bermuda Syndrome
	  (1995 adventure game). By Gregory Montoir.
	  Requires retail game data.

	  https://github.com/cyxx/bermuda
```

## package/ports/cannonball/Config.in
```kconfig
config BR2_PACKAGE_CANNONBALL
	bool "cannonball"
	depends on BR2_INSTALL_LIBSTDCPP
	depends on BR2_PACKAGE_HAS_LIBEGL
	depends on BR2_PACKAGE_HAS_LIBGLES
	select BR2_PACKAGE_SDL2
	select BR2_PACKAGE_TINYXML2
	select BR2_PACKAGE_LIBEXECINFO	if BR2_TOOLCHAIN_USES_MUSL
	select BR2_PACKAGE_LIBBACKTRACE	if BR2_TOOLCHAIN_USES_MUSL
	help
	  Cannonball SE - OutRun Engine (SDL2/GLES2)

	  https://github.com/J1mbo/cannonball-se

comment "Cannonball needs a toolchain w/ C++, EGL, GLES2, and following libraries: sdl2, tinyxml2"
	depends on !BR2_INSTALL_LIBSTDCPP || !BR2_PACKAGE_HAS_LIBEGL || !BR2_PACKAGE_HAS_LIBGLES || !BR2_PACKAGE_SDL2 || !BR2_PACKAGE_TINYXML2
```

## package/ports/dethrace/Config.in
```kconfig
config BR2_PACKAGE_DETHRACE
	bool "dethrace"
	depends on !BR2_STATIC_LIBS
	select BR2_PACKAGE_SDL2
	help
	  Dethrace is a reimplementation of the Carmageddon engine.
	  Software renderer (BRender), no OpenGL needed.
	  Requires original Carmageddon game data.

	  https://github.com/dethrace-labs/dethrace
```

## package/ports/ecwolf/Config.in.host
```kconfig
config BR2_PACKAGE_HOST_ECWOLF
	bool "host ecwolf tools"
	help
	  This package is required for building ecwolf.
```

## package/ports/fteqw/Config.in
```kconfig
config BR2_PACKAGE_FTEQW
	bool "fteqw"
	depends on BR2_PACKAGE_SDL3
	depends on BR2_PACKAGE_HAS_LIBGL || BR2_PACKAGE_HAS_LIBGLES
	select BR2_PACKAGE_ZLIB
	select BR2_PACKAGE_LIBPNG
	select BR2_PACKAGE_JPEG
	select BR2_PACKAGE_LIBOGG
	select BR2_PACKAGE_LIBVORBIS
	help
	  FTEQW is a heavily extended, actively maintained, multi-game
	  idTech1-derived engine. It natively plays Quake and Hexen II
	  (including their mission packs) using its own compiled-in game
	  profiles, selected at launch with a flag such as -quake or
	  -hexen2. It renders via SDL3, so it picks up whichever of GL,
	  GLES, or Vulkan SDL3 itself was built with.

	  Game data (.pak files) must be provided separately.

	  https://github.com/fte-team/fteqw
```
