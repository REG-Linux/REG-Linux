## package/batocera/emulators/scummvm/Config.in
```kconfig
config BR2_PACKAGE_SCUMMVM
    bool "Scummvm"
    depends on BR2_INSTALL_LIBSTDCPP
    select BR2_PACKAGE_SDL2
    select BR2_PACKAGE_LIBMPEG2
    select BR2_PACKAGE_JPEG
    select BR2_PACKAGE_LIBJPEG_BATO
    select BR2_PACKAGE_LIBOGG
    select BR2_PACKAGE_LIBVORBIS	if !BR2_arm && !BR2_mipsel
    select BR2_PACKAGE_TREMOR		if  BR2_arm || BR2_mipsel
    select BR2_PACKAGE_FLAC
    select BR2_PACKAGE_LIBMAD
    select BR2_PACKAGE_LIBPNG
    select BR2_PACKAGE_LIBTHEORA
    select BR2_PACKAGE_FAAD2
    select BR2_PACKAGE_FREETYPE
    select BR2_PACKAGE_ZLIB
    select BR2_PACKAGE_HAS_SCUMMVM
    help
      ScummVM point and click
      
      http://wiki.scummvm.org/

comment "Scummvm  needs a toolchain w/ C++,  SDL2"
    depends on !BR2_INSTALL_LIBSTDCPP || !BR2_PACKAGE_SDL2
```

## package/batocera/gpu/batocera-nvidia/Config.in
```kconfig
config BR2_PACKAGE_BATOCERA_NVIDIA
    bool "batocera-nvidia"

    depends on BR2_PACKAGE_XWAYLAND

    # drivers
    select BR2_PACKAGE_NVIDIA_OPEN_DRIVER      # the latest driver
    select BR2_PACKAGE_NVIDIA470_LEGACY_DRIVER # the legacy 470.xx driver

    # kernel modules
    select BR2_PACKAGE_NVIDIA_OPEN_DRIVER_MODULE
    select BR2_PACKAGE_NVIDIA_PROPRIETARY_DRIVER_MODULE # addition production kernel modules
    select BR2_PACKAGE_NVIDIA470_LEGACY_DRIVER_MODULE

    # cuda
    select BR2_PACKAGE_NVIDIA_OPEN_DRIVER_CUDA

    help
      This package a switch between the different nvidia drivers
```

## package/batocera/gpu/intel-clc/Config.in
```kconfig
menuconfig BR2_PACKAGE_INTEL_CLC
	bool "intel-clc"
	depends on BR2_INSTALL_LIBSTDCPP
	depends on !BR2_STATIC_LIBS
	depends on BR2_TOOLCHAIN_HAS_SYNC_1
	depends on BR2_TOOLCHAIN_HAS_THREADS_NPTL
	depends on BR2_TOOLCHAIN_GCC_AT_LEAST_8
	select BR2_PACKAGE_EXPAT
	select BR2_PACKAGE_LIBDRM
	select BR2_PACKAGE_ZLIB
	select BR2_PACKAGE_REGLINUX_LLVM        if BR2_PACKAGE_REGLINUX_LLVM_BUILD_FROM_SOURCE != "y"
	select BR2_PACKAGE_LLVM                 if !BR2_PACKAGE_REGLINUX_LLVM
	select BR2_PACKAGE_LLVM_RTTI            if !BR2_PACKAGE_REGLINUX_LLVM
	select BR2_PACKAGE_HOST_LLVM            if !BR2_PACKAGE_REGLINUX_LLVM
	select BR2_PACKAGE_HOST_LLVM_RTTI       if !BR2_PACKAGE_REGLINUX_LLVM
	select BR2_PACKAGE_PYTHON_PYCPARSER
	select BR2_PACKAGE_HOST_PYTHON_PYCPARSER
	help
	  Mesa 3D, an open-source implementation of the OpenGL
	  specification.

	  http://mesa3d.org

comment "intel-clc needs a toolchain w/ gcc >=8, C++, NPTL, dynamic library"
	depends on !BR2_INSTALL_LIBSTDCPP || !BR2_TOOLCHAIN_HAS_THREADS_NPTL || \
		BR2_STATIC_LIBS || !BR2_TOOLCHAIN_GCC_AT_LEAST_8
	depends on BR2_TOOLCHAIN_HAS_SYNC_1
```

## package/batocera/gpu/nvidia-open-driver/Config.in
```kconfig
comment "nvidia-open-driver needs a glibc toolchain"
#batocera nvidia dropped x86 support
	depends on BR2_x86_64
	depends on !BR2_TOOLCHAIN_USES_GLIBC

config BR2_PACKAGE_NVIDIA_OPEN_DRIVER
	bool "nvidia-open-driver"
#batocera nvidia dropped x86 support
	depends on BR2_x86_64
	depends on BR2_TOOLCHAIN_USES_GLIBC
	select BR2_PACKAGE_NVIDIA470_LEGACY_DRIVER
	select BR2_PACKAGE_NVIDIA_PROPRIETARY_DRIVER
	help
	  The binary-only driver blob for NVidia cards.
	  This is the userland part only.

	  http://www.nvidia.com/

if BR2_PACKAGE_NVIDIA_OPEN_DRIVER

config BR2_PACKAGE_NVIDIA_OPEN_DRIVER_CUDA
	bool "CUDA support"

if BR2_PACKAGE_NVIDIA_OPEN_DRIVER_CUDA

config BR2_PACKAGE_NVIDIA_OPEN_DRIVER_OPENCL
	bool "OpenCL support"
	select BR2_PACKAGE_MESA3D_HEADERS
	select BR2_PACKAGE_HAS_LIBOPENCL

config BR2_PACKAGE_PROVIDES_LIBOPENCL
	default "nvidia-open-driver" if BR2_PACKAGE_NVIDIA_OPEN_DRIVER_OPENCL

config BR2_PACKAGE_NVIDIA_OPEN_DRIVER_CUDA_PROGS
	bool "CUDA MPS server and control"
	help
	  Say 'y' here if you need to run more than one program
	  doing CUDA at the same time. The MPS server will be
	  launched automatically when needed.

endif # BR2_PACKAGE_NVIDIA_OPEN_DRIVER_CUDA

comment "nvidia kernel module needs a kernel to be built"
	depends on !BR2_LINUX_KERNEL

config BR2_PACKAGE_NVIDIA_OPEN_DRIVER_MODULE
	bool "nvidia kernel module"
	depends on BR2_LINUX_KERNEL
	select BR2_LINUX_NEEDS_MODULES # not using kernel-module infra
	help
	  Build the nvidia.ko kernel module.

	  If CUDA support (above) is set, and the target is x86_64, then
	  this will also build the nvidia-uvm.ko kernel module, which
	  provides Unified Memory access to the GPU and CPU memories for
	  CUDA programs.

endif # BR2_PACKAGE_NVIDIA_OPEN_DRIVER
```

## package/batocera/libraries/python-adafruit-circuitpython-busdevice/Config.in
```kconfig
config BR2_PACKAGE_PYTHON_ADAFRUIT_CIRCUITPYTHON_BUSDEVICE
	bool "python-adafruit-circuitpython-busdevice"
	select BR2_PACKAGE_PYTHON_ADAFRUIT_BLINKA
	select BR2_PACKAGE_PYTHON_ADAFRUIT_CIRCUITPYTHON_TYPING
	select BR2_PACKAGE_HOST_PYTHON_SETUPTOOLS_SCM
	help
	  CircuitPython bus device classes to manage bus sharing.

	  https://pypi.org/project/adafruit-circuitpython-busdevice
```

## package/batocera/libraries/python-adafruit-circuitpython-connectionmanager/Config.in
```kconfig
config BR2_PACKAGE_PYTHON_ADAFRUIT_CIRCUITPYTHON_CONNECTIONMANAGER
	bool "python-adafruit-circuitpython-connectionmanager"
	select BR2_PACKAGE_HOST_PYTHON_SETUPTOOLS_SCM
	help
	  A urllib3.poolmanager/urllib3.connectionpool-like library for managing sockets and connections.

	  https://pypi.org/project/adafruit-circuitpython-connectionmanager
```

## package/batocera/libraries/python-adafruit-circuitpython-typing/Config.in
```kconfig
config BR2_PACKAGE_PYTHON_ADAFRUIT_CIRCUITPYTHON_TYPING
	bool "python-adafruit-circuitpython-typing"
	select BR2_PACKAGE_HOST_PYTHON_SETUPTOOLS_SCM
	help
	  Types needed for type annotation that are not in `typing`

	  https://pypi.org/project/adafruit-circuitpython-typing
```

## package/batocera/libraries/python-adafruit-circuitpython-ws2801/Config.in
```kconfig
config BR2_PACKAGE_PYTHON_ADAFRUIT_CIRCUITPYTHON_WS2801
	bool "python-adafruit-circuitpython-ws2801"
	select BR2_PACKAGE_PYTHON_ADAFRUIT_BLINKA
	select BR2_PACKAGE_PYTHON_ADAFRUIT_CIRCUITPYTHON_BUSDEVICE
	select BR2_PACKAGE_HOST_PYTHON_SETUPTOOLS_SCM
	help
	  CircuitPython library for WS2801 LEDs.

	  https://pypi.org/project/adafruit-circuitpython-ws2801
```

## package/batocera/libraries/python-adafruit-platformdetect/Config.in
```kconfig
config BR2_PACKAGE_PYTHON_ADAFRUIT_PLATFORMDETECT
	bool "python-adafruit-platformdetect"
	select BR2_PACKAGE_HOST_PYTHON_SETUPTOOLS_SCM
	help
	  Platform detection for use by libraries like Adafruit-Blinka.

	  https://pypi.org/project/Adafruit-PlatformDetect
```

## package/batocera/libraries/python-adafruit-pureio/Config.in
```kconfig
config BR2_PACKAGE_PYTHON_ADAFRUIT_PUREIO
	bool "python-adafruit-pureio"
	select BR2_PACKAGE_HOST_PYTHON_SETUPTOOLS_SCM
	help
	  Pure python (i.e. no native extensions) access to Linux IO including
	  I2C and SPI. Drop in replacement for smbus and spidev modules.

	  https://pypi.org/project/Adafruit-PureIO
```

## package/batocera/libraries/python-binho-host-adapter/Config.in
```kconfig
config BR2_PACKAGE_PYTHON_BINHO_HOST_ADAPTER
	bool "python-binho-host-adapter"
	select BR2_PACKAGE_PYTHON_SERIAL
	select BR2_PACKAGE_HOST_PYTHON_SETUPTOOLS_SCM
	help
	  Cross-platform Python 3.x library for automated control of
	  Binho Multi-Protocol USB Host Adapters.

	  https://pypi.org/project/binho-host-adapter
```

## package/batocera/libraries/python-lgpio/Config.in
```kconfig
config BR2_PACKAGE_PYTHON_LGPIO
	bool "python-lgpio"
	select BR2_PACKAGE_LIBLGPIO
	select BR2_PACKAGE_HOST_SWIG
	help
	  lgpio is a module for Linux Single Board Computers (SBC)
	  which allows control of the General Purpose Input Outputs (GPIO).

	  https://pypi.org/project/lgpio
```

## package/batocera/libraries/shaderc/Config.in
```kconfig
config BR2_PACKAGE_SHADERC
    bool "shaderc"
    select BR2_PACKAGE_GLSLANG
    help
      A collection of tools, libraries and tests for shader compilation.
      
      https://github.com/google/shaderc
```

## package/batocera/ports/sonic3-air/Config.in
```kconfig
config BR2_PACKAGE_SONIC3_AIR
	bool "sonic3-air"
	depends on BR2_PACKAGE_HAS_LIBGLES || BR2_PACKAGE_HAS_LIBGL
	select BR2_PACKAGE_ALSA_LIB
	select BR2_PACKAGE_LIBCURL
	select BR2_PACKAGE_LIBGLU               if BR2_PACKAGE_XORG7
	select BR2_PACKAGE_XLIB_LIBXCOMPOSITE   if BR2_PACKAGE_XORG7
	select BR2_PACKAGE_XLIB_LIBXXF86VM      if BR2_PACKAGE_XORG7
	select BR2_PACKAGE_ZLIB

	help
	  Sonic 3 A.I.R. (Angel Island Revisited) and the Oxygen Engine.

	  https://github.com/Eukaryot/sonic3air
```

## package/batocera/utils/grim/Config.in
```kconfig
config BR2_PACKAGE_GRIM
    bool "grim"
    depends on BR2_PACKAGE_WAYLAND
    select BR2_PACKAGE_PIXMAN

    help
        Grab images from a Wayland compositor.

	    https://git.sr.ht/~emersion/grim
```

## package/batocera/utils/xxd/Config.in
```kconfig
config BR2_PACKAGE_XXD
	bool "xxd"

	help
	  This is the well-known hex-dump-type utility xxd commonly
	  distributed as a part of the vim-project. The version of
	  xxd in this repository has been adapted for MSVC/GCC/clang
	  standalone build.

		https://github.com/ckormanyos/xxd
```

## package/boot/uboot-rk3326/Config.in
```kconfig
config BR2_PACKAGE_UBOOT_RK3326
        bool "uboot files for RK3326"
        help
          uboot files for RK3326
```

## package/boot/uboot-tinkerboard2/Config.in
```kconfig
config BR2_PACKAGE_UBOOT_TINKERBOARD2
    bool "uboot files for Tinkerboard 2"
    help
        uboot files for Tinkerboard 2
```

## package/cases/deskpipro/Config.in
```kconfig
config BR2_PACKAGE_DESKPIPRO
	bool "deskpi-pro"

	help
	  Enable front USB, fan control & infrared on the DeskPi Pro Case.

	  https://deskpi.com/products/deskpi-pro-for-raspberry-pi-4
```

## package/cases/gpicase/Config.in
```kconfig
config BR2_PACKAGE_GPICASE
        bool "gpicase"
	depends on BR2_PACKAGE_SYSTEM_TARGET_RPI_ANY
	depends on BR2_LINUX_KERNEL

	help

	  https://github.com/RetroFlag/retroflag-picase

comment "gpicase needs a Linux kernel to be built"
	depends on !BR2_LINUX_KERNEL
```

## package/cases/picade/Config.in
```kconfig
config BR2_PACKAGE_PICADE
    bool "picade"
    depends on BR2_LINUX_KERNEL
      help
        Adds support for the Pimoroni Picade RPi arcade case

        https://github.com/pimoroni/picade-hat

comment "picade needs a kernel and headers"
	depends on !BR2_LINUX_KERNEL
```

## package/cases/roshambo/Config.in
```kconfig
config BR2_PACKAGE_ROSHAMBO
	bool "roshambo"
	depends on BR2_PACKAGE_PYTHON3
	help
	  Scripts to enable the LED, Fan, and Buttons on the Kintaro SNES and Roshambo Super Famicom Cases.
```

## package/controllers/gamecontrollerdb/Config.in
```kconfig
config BR2_PACKAGE_GAMECONTROLLERDB
	bool "gamecontrollerdb"
	help
	  A curated and automatically updated game controller mapping
	  database for Linux platforms, based on the SDL_GameControllerDB project.

	  https://github.com/REG-Linux/SDL_GameControllerDB
```

## package/controllers/pads/db9-gpio-rpi/Config.in
```kconfig
config BR2_PACKAGE_DB9_GPIO_RPI
	bool "db9-gpio-rpi"
	help
	  Kernel module to support db9 joysticks on gpios
```

## package/emulationstation/es-system/Config.in
```kconfig
config BR2_PACKAGE_ES_SYSTEM
        bool "es-system"
	select BR2_PACKAGE_REGLINUX_CONFIGGEN
        help
          Generates the es_system.cfg file and the roms folder
```
