## package/system/reglinux-launcher-defaults/Config.in
```kconfig
config BR2_PACKAGE_REGLINUX_LAUNCHER_DEFAULTS
	bool "reglinux launcher defaults"

	help
	  System -> (emulator, core) + options defaults for the REG-Linux
	  launcher, plus the per-SoC overlay selected for this board.

	  Installed as /usr/share/regmsg/launcher/launcher-defaults.yml and
	  launcher-defaults-arch.yml. Read by regmsgd at runtime
	  (launcher/system_map.rs) to resolve a system to an installed
	  emulator/core pair, and by es-system at build time from staging to
	  generate rs_systems.cfg / rs_features.json.
```

## package/system/reglinux-led-handheld/Config.in
```kconfig
config BR2_PACKAGE_REGLINUX_LED_HANDHELD
	bool "reglinux-led-handheld"
	select BR2_PACKAGE_HOST_RUSTC_TARGET_ARCH_SUPPORTS
	select BR2_PACKAGE_HOST_RUSTC

	help
	  LED controller daemon for handheld devices.
	  Supports battery level indication, effects (rainbow, pulse),
	  and per-LED individual control for devices like Retroid Pocket 5.

	  https://github.com/REG-Linux/REG-Linux
```

## package/system/reglinux-rescue/Config.in
```kconfig
config BR2_PACKAGE_REGLINUX_RESCUE
	bool "reglinux-rescue"
	depends on BR2_aarch64 || BR2_arm || BR2_riscv || BR2_mipsel || BR2_x86_64
	help
	  minimal rootfs for rescue/update mode
```

## package/system/reglinux-scripts/Config.in
```kconfig
config BR2_PACKAGE_REGLINUX_SCRIPTS
	bool "reglinux-scripts"

	select BR2_PACKAGE_BASH
	select BR2_PACKAGE_PCIUTILS
	select BR2_PACKAGE_PYTHON3
	select BR2_PACKAGE_DBUS_PYTHON		# required for bluetooth scripts
	select BR2_PACKAGE_JQ			# for vulkan parsing

	help
	  Batocera scripts
```

## package/system/reglinux-test/Config.in
```kconfig
config BR2_PACKAGE_REGLINUX_TEST
	bool "reglinux-test"
	select BR2_PACKAGE_PYTHON3
	select BR2_PACKAGE_PYTHON_PYYAML
	select BR2_PACKAGE_PYTHON_PILLOW
	help
	  System-level test + fuzz harness for REG-Linux.
	  Validates frontend (REG-Station) lifecycle, regmsgd IPC launcher,
	  and in-process libra runs. Black-box: only spawns existing CLIs.

if BR2_PACKAGE_REGLINUX_TEST

config BR2_PACKAGE_REGLINUX_TEST_WL_PROBE
	bool "build wl-probe (Wayland window enumerator)"
	default y if BR2_PACKAGE_WAYLAND
	depends on BR2_PACKAGE_WAYLAND
	select BR2_PACKAGE_WAYLAND_PROTOCOLS
	help
	  Small helper binary that enumerates Wayland toplevels via the
	  ext_foreign_toplevel_list_v1 / zwlr_foreign_toplevel_manager_v1
	  protocols. Required for window_exists + assert_focused probes
	  on weston, sway, and any wlroots-based compositor.

	  Disable on bare KMS targets (no compositor) to skip the
	  wayland-protocols + host-wayland-scanner build.

endif
```

## package/system/reglinux-triggerhappy/Config.in
```kconfig
config BR2_PACKAGE_REGLINUX_TRIGGERHAPPY
	bool "reglinux-triggerhappy"

	select BR2_PACKAGE_TRIGGERHAPPY
```

## package/system/reglinux-usbgadget/Config.in
```kconfig
config BR2_PACKAGE_REGLINUX_USBGADGET
	bool "reglinux-usbgadget"

	select BR2_PACKAGE_UMTP_RESPONDER
	select BR2_PACKAGE_ANDROID_TOOLS
	select BR2_PACKAGE_ANDROID_TOOLS_ADBD

	help
	  reglinux usbgadget
```

## package/touchscreen/synaptics-dsx/Config.in
```kconfig
config BR2_PACKAGE_SYNAPTICS_DSX
	bool "synaptics-dsx"
	depends on BR2_LINUX_KERNEL
	help
	  Synaptics DSX touchscreen driver for I2C.
	  Supports chips with "synaptics,dsx-i2c" compatible.
```

## package/utils/innoextract/Config.in
```kconfig
config BR2_PACKAGE_INNOEXTRACT
    bool "innoextract"
    select BR2_PACKAGE_XZ
    select BR2_PACKAGE_BOOST

    help
      innoextract - A tool to unpack installers created by Inno Setup

	    https://constexpr.org/innoextract/
```

## package/utils/lgogdownloader/Config.in
```kconfig
config BR2_PACKAGE_LGOGDOWNLOADER
	bool "lgogdownloader"

	select BR2_PACKAGE_BOOST
	select BR2_PACKAGE_JSONCPP
	select BR2_PACKAGE_LIBCURL
	select BR2_PACKAGE_LIBTIDY
	select BR2_PACKAGE_TINYXML2
	select BR2_PACKAGE_RHASH
	help
	  Unofficial GOG downloader

	  https://github.com/Sude-/lgogdownloader
```

## package/utils/neoconv/Config.in
```kconfig
config BR2_PACKAGE_NEOCONV
	bool "neoconv"
	help
	  MAME Neo Geo romset (.zip) to TerraOnion (.neo) converter.

	  https://github.com/carmiker/neoconv
```

## package/utils/zftpd/Config.in
```kconfig
config BR2_PACKAGE_ZFTPD
	bool "zftpd"

	help
	  High-performance, zero-copy FTP server for Linux.

	  https://github.com/seregonwar/zftpd
```
