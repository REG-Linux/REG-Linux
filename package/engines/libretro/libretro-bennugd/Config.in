## package/engines/libretro/libretro-bennugd/Config.in
```kconfig
config BR2_PACKAGE_LIBRETRO_BENNUGD
	bool "libretro-bennugd"
	depends on BR2_INSTALL_LIBSTDCPP
	help
	  BennuGD libretro core. Runs BennuGD games (.dcb/.dat
	  bytecode) through RetroArch. Used for Streets of Rage
	  Remake and other BennuGD games.

	  https://github.com/diekleinekuh/BennuGD_libretro
```

## package/engines/love2d/Config.in
```kconfig
config BR2_PACKAGE_LOVE2D
	bool "love2d"
	depends on BR2_INSTALL_LIBSTDCPP
	depends on BR2_PACKAGE_OPENAL_ARCH_SUPPORTS
	depends on BR2_PACKAGE_REGLINUX_LUAJIT_ARCH_SUPPORTS
	depends on BR2_TOOLCHAIN_HAS_THREADS_NPTL # openal
	depends on !BR2_STATIC_LIBS # SDL2
	depends on BR2_PACKAGE_HAS_LIBGL || BR2_PACKAGE_HAS_LIBGLES

	select BR2_PACKAGE_FREETYPE
	select BR2_PACKAGE_LIBMODPLUG
	select BR2_PACKAGE_LIBOGG
	select BR2_PACKAGE_LIBTHEORA
	select BR2_PACKAGE_LIBVORBIS
	select BR2_PACKAGE_MPG123
	select BR2_PACKAGE_OPENAL
	select BR2_PACKAGE_REGLINUX_LUAJIT
	select BR2_PACKAGE_SDL2
	select BR2_PACKAGE_ZLIB
	select BR2_PACKAGE_GL4ES if !BR2_PACKAGE_HAS_LIBGL
	help
	  LOVE is a free 2D game engine which enables easy game
	  creation in Lua. Games are packaged as .love files (Lua
	  scripts) which are fully architecture-independent.

	  https://love2d.org
	  https://github.com/love2d/love

comment "love2d needs OpenGL/GLES, C++, NPTL, dynamic libs, and luajit"
	depends on BR2_PACKAGE_OPENAL_ARCH_SUPPORTS
	depends on BR2_PACKAGE_REGLINUX_LUAJIT_ARCH_SUPPORTS
	depends on !BR2_INSTALL_LIBSTDCPP || !BR2_TOOLCHAIN_HAS_THREADS_NPTL \
		|| BR2_STATIC_LIBS \
		|| !(BR2_PACKAGE_HAS_LIBGL || BR2_PACKAGE_HAS_LIBGLES)
```

## package/engines/mkxp-z/Config.in
```kconfig
config BR2_PACKAGE_MKXP_Z
	bool "mkxp-z"
	depends on BR2_INSTALL_LIBSTDCPP
	depends on !BR2_STATIC_LIBS # SDL2
	depends on BR2_PACKAGE_HAS_LIBGL || BR2_PACKAGE_HAS_LIBGLES
	depends on BR2_PACKAGE_RUBY # needs MRI Ruby
	select BR2_PACKAGE_SDL2
	select BR2_PACKAGE_SDL2_IMAGE
	select BR2_PACKAGE_SDL2_TTF
	select BR2_PACKAGE_SDL_SOUND
	select BR2_PACKAGE_OPENAL
	select BR2_PACKAGE_PHYSFS
	select BR2_PACKAGE_PIXMAN
	select BR2_PACKAGE_LIBVORBIS
	select BR2_PACKAGE_LIBOGG
	select BR2_PACKAGE_LIBTHEORA
	select BR2_PACKAGE_FREETYPE
	select BR2_PACKAGE_LIBPNG
	select BR2_PACKAGE_ZLIB
	select BR2_PACKAGE_LIBICONV if !BR2_ENABLE_LOCALE
	select BR2_PACKAGE_DBUS
	select BR2_PACKAGE_UCHARDET
	select BR2_PACKAGE_GCOMPAT if BR2_TOOLCHAIN_USES_MUSL
	help
	  mkxp-z is an advanced player for RPG Maker XP, VX and VX Ace
	  games. Heavy fork of Ancurio/mkxp with extended RGSS API,
	  animated bitmaps, video support, and more.

	  Reads mkxp.json (JSON5 format). Covers Hylics and other
	  ports needing extended RGSS features.

	  https://github.com/mkxp-z/mkxp-z

comment "mkxp-z needs C++, OpenGL/GLES, dynamic libs, Ruby"
	depends on !BR2_INSTALL_LIBSTDCPP || BR2_STATIC_LIBS \
		|| !(BR2_PACKAGE_HAS_LIBGL || BR2_PACKAGE_HAS_LIBGLES) \
		|| !BR2_PACKAGE_RUBY
```

## package/engines/mkxp/Config.in
```kconfig
config BR2_PACKAGE_MKXP
	bool "mkxp"
	depends on BR2_INSTALL_LIBSTDCPP
	depends on !BR2_STATIC_LIBS # SDL2
	depends on BR2_PACKAGE_HAS_LIBGL || BR2_PACKAGE_HAS_LIBGLES
	depends on BR2_PACKAGE_RUBY # needs MRI Ruby
	select BR2_PACKAGE_BOOST
	select BR2_PACKAGE_BOOST_PROGRAM_OPTIONS
	select BR2_PACKAGE_SDL2
	select BR2_PACKAGE_SDL2_IMAGE
	select BR2_PACKAGE_SDL2_TTF
	select BR2_PACKAGE_SDL_SOUND
	select BR2_PACKAGE_OPENAL
	select BR2_PACKAGE_PHYSFS
	select BR2_PACKAGE_PIXMAN
	select BR2_PACKAGE_LIBSIGC
	select BR2_PACKAGE_LIBVORBIS
	select BR2_PACKAGE_LIBOGG
	select BR2_PACKAGE_ZLIB
	help
	  Falcon-mkxp is a player for RPG Maker XP, VX and VX Ace
	  games on Linux. Fork of Ancurio/mkxp with unlocked
	  resolution support and Japanese font bundling.

	  Reads mkxp.conf (INI format). Covers 17 PortMaster ports
	  including To the Moon, LISA series, Finding Paradise.

	  https://github.com/pk-2000/Falcon-mkxp

comment "mkxp needs C++, OpenGL/GLES, dynamic libs, Ruby"
	depends on !BR2_INSTALL_LIBSTDCPP || BR2_STATIC_LIBS \
		|| !(BR2_PACKAGE_HAS_LIBGL || BR2_PACKAGE_HAS_LIBGLES) \
		|| !BR2_PACKAGE_RUBY
```

## package/firmwares/firmware-rtl8723fu/Config.in
```kconfig
config BR2_PACKAGE_FIRMWARE_RTL8723FU
	bool "firmware-rtl8723fu"
	help
	  Bluetooth firmware of the Realtek RTL8733BU WiFi/BT combo chip,
	  as found in the Miyoo Flip.
```

## package/firmwares/firmware-tegra/Config.in
```kconfig
config BR2_PACKAGE_FIRMWARE_TEGRA
	bool "firmware-tegra"
	select BR2_PACKAGE_ALLLINUXFIRMWARES

	help
	  Firmware files for NVIDIA Tegra platforms (Nouveau GPU, WiFi, USB)
```

## package/fpga/reglinux-mister-bridge/Config.in
```kconfig
config BR2_PACKAGE_REGLINUX_MISTER_BRIDGE
	bool "reglinux-mister-bridge"
	depends on BR2_PACKAGE_SYSTEM_TARGET_DE10NANO
	depends on BR2_PACKAGE_HOST_RUSTC_TARGET_ARCH_SUPPORTS
	select BR2_PACKAGE_HOST_RUSTC
	help
	  MiSTer FPGA core bridge for DE10-Nano.
	  Loads RBF bitstreams, transfers ROMs, and forwards
	  USB input to FPGA cores via SPI.

	  https://github.com/REG-Linux/REG-Linux
```

## package/frontend/es-system/Config.in
```kconfig
config BR2_PACKAGE_ES_SYSTEM
	bool "es-system"
	select BR2_PACKAGE_HOST_RUSTC
	select BR2_PACKAGE_REGLINUX_LAUNCHER_DEFAULTS
	help
	  Generates rs_systems.cfg, rs_features.json, and default ROMs.
	  Installs es-system binary for on-device config regeneration.

	  https://github.com/REG-Linux/es-system
```

## package/frontend/regplayer/Config.in
```kconfig
config BR2_PACKAGE_REGPLAYER
	bool "REG-Player"
	depends on BR2_INSTALL_LIBSTDCPP
	depends on (BR2_PACKAGE_HAS_LIBGLES || BR2_PACKAGE_HAS_LIBGL)
	select BR2_PACKAGE_SDL3
	select BR2_PACKAGE_SDL3_IMAGE
	select BR2_PACKAGE_SDL3_TTF
	select BR2_PACKAGE_MPV
	select BR2_PACKAGE_TAGLIB
	select BR2_PACKAGE_LIBXMP
	select BR2_PACKAGE_LIBGME
	select BR2_PACKAGE_OPUSFILE
	select BR2_PACKAGE_ALSA_LIB
	select BR2_PACKAGE_ALSA_UTILS
	select BR2_PACKAGE_ALSA_UTILS_AMIXER
	select BR2_PACKAGE_ZLIB
	help
	  XMB-style media player for REG-Linux handhelds.
	  Plays music (incl. trackers + chiptune), photos, video.
	  Default scan root: /userdata/medias.

	  https://github.com/REG-Linux/REG-Player

comment "REG-Player needs a toolchain w/ C++17, OpenGL/GLES"
	depends on !BR2_INSTALL_LIBSTDCPP || \
		!(BR2_PACKAGE_HAS_LIBGLES || BR2_PACKAGE_HAS_LIBGL)
```

## package/frontend/rs-background-musics/Config.in
```kconfig
config BR2_PACKAGE_RS_BACKGROUND_MUSICS
        bool "rs-background-musics"

        help
         REG-Station background musics
```

## package/games/alephone/Config.in
```kconfig
config BR2_PACKAGE_ALEPHONE
	bool "alephone"
	depends on BR2_INSTALL_LIBSTDCPP
	depends on !BR2_STATIC_LIBS
	select BR2_PACKAGE_SDL2
	select BR2_PACKAGE_SDL2_TTF
	select BR2_PACKAGE_SDL2_IMAGE
	select BR2_PACKAGE_OPENAL
	select BR2_PACKAGE_BOOST
	select BR2_PACKAGE_ZLIB
	select BR2_PACKAGE_LIBSNDFILE
	select BR2_PACKAGE_LIBVORBIS
	select BR2_PACKAGE_LIBOGG
	select BR2_PACKAGE_LIBPNG
	select BR2_PACKAGE_LIBCURL
	help
	  Aleph One is the open-source Marathon engine. Bungie
	  released the engine AND all three game campaigns as
	  freeware. Three full FPS games, completely free.

	  https://github.com/Aleph-One-Marathon/alephone
```

## package/games/apotris/Config.in
```kconfig
config BR2_PACKAGE_APOTRIS
	bool "apotris"
	depends on BR2_INSTALL_LIBSTDCPP
	depends on !BR2_STATIC_LIBS
	depends on BR2_PACKAGE_HAS_LIBGL || BR2_PACKAGE_HAS_LIBGLES
	select BR2_PACKAGE_SDL2
	select BR2_PACKAGE_SDL2_MIXER
	select BR2_PACKAGE_OPUS
	help
	  Apotris is a feature-rich Tetris clone with hold, T-spins,
	  combos, skins, and multiplayer. Fully free.

	  https://gitea.com/akouzoukos/apotris
```

## package/games/billyfrontier/Config.in
```kconfig
config BR2_PACKAGE_BILLYFRONTIER
	bool "billyfrontier"
	depends on BR2_INSTALL_LIBSTDCPP
	depends on !BR2_STATIC_LIBS
	depends on BR2_PACKAGE_HAS_LIBGL || BR2_PACKAGE_HAS_LIBGLES
	select BR2_PACKAGE_SDL2
	select BR2_PACKAGE_LIBGL if BR2_PACKAGE_HAS_LIBGL
	select BR2_PACKAGE_GL4ES if !BR2_PACKAGE_HAS_LIBGL
	select BR2_PACKAGE_LIBGLES if BR2_PACKAGE_HAS_LIBGLES
	help
	  Billy Frontier by Pangea Software, open-sourced by Jorio.
	  Wild west arcade shooter. All assets included. Requires SDL3.

	  https://github.com/jorio/BillyFrontier
```

## package/games/ccleste/Config.in
```kconfig
config BR2_PACKAGE_CCLESTE
	bool "ccleste"
	select BR2_PACKAGE_SDL2
	select BR2_PACKAGE_SDL2_MIXER
	help
	  C source port of the original Celeste (PICO-8 version).
	  Tiny platformer — fully free, no game data needed.

	  https://github.com/lemon32767/ccleste
```

## package/games/classicube/Config.in
```kconfig
config BR2_PACKAGE_CLASSICUBE
	bool "classicube"
	depends on !BR2_STATIC_LIBS
	depends on BR2_PACKAGE_HAS_LIBGL || BR2_PACKAGE_HAS_LIBGLES
	select BR2_PACKAGE_SDL2
	select BR2_PACKAGE_GL4ES if !BR2_PACKAGE_HAS_LIBGL
	help
	  ClassiCube is a custom Minecraft Classic compatible client
	  written in C. Pure C, minimal dependencies.
	  Free — connects to ClassiCube.net servers.

	  https://github.com/ClassiCube/ClassiCube
```

## package/games/cromagrally/Config.in
```kconfig
config BR2_PACKAGE_CROMAGRALLY
	bool "cromagrally"
	depends on BR2_INSTALL_LIBSTDCPP
	depends on !BR2_STATIC_LIBS
	depends on BR2_PACKAGE_HAS_LIBGL || BR2_PACKAGE_HAS_LIBGLES
	select BR2_PACKAGE_SDL2
	select BR2_PACKAGE_GL4ES if !BR2_PACKAGE_HAS_LIBGL
	help
	  Cro-Mag Rally is a caveman kart racing game by Pangea
	  Software, open-sourced by Jorio. All assets included.
	  Requires SDL3.

	  https://github.com/jorio/CroMagRally
```

## package/games/freegemas/Config.in
```kconfig
config BR2_PACKAGE_FREEGEMAS
	bool "freegemas"
	depends on BR2_INSTALL_LIBSTDCPP
	select BR2_PACKAGE_SDL2
	select BR2_PACKAGE_SDL2_IMAGE
	select BR2_PACKAGE_SDL2_MIXER
	select BR2_PACKAGE_SDL2_TTF
	select BR2_PACKAGE_JSONCPP
	help
	  Freegemas is an open-source Bejeweled clone.
	  Fully free, all assets included.

	  https://github.com/JoseTomasTocino/freegemas
```

## package/games/luanti/Config.in
```kconfig
config BR2_PACKAGE_LUANTI
	bool "luanti"
	depends on BR2_INSTALL_LIBSTDCPP
	depends on !BR2_STATIC_LIBS
	depends on BR2_PACKAGE_HAS_LIBGL || BR2_PACKAGE_HAS_LIBGLES
	depends on BR2_PACKAGE_REGLINUX_LUAJIT_ARCH_SUPPORTS
	select BR2_PACKAGE_SDL2
	select BR2_PACKAGE_ZLIB
	select BR2_PACKAGE_ZSTD
	select BR2_PACKAGE_SQLITE
	select BR2_PACKAGE_OPENSSL
	select BR2_PACKAGE_GMP
	select BR2_PACKAGE_JSONCPP
	select BR2_PACKAGE_REGLINUX_LUAJIT
	select BR2_PACKAGE_FREETYPE
	select BR2_PACKAGE_OPENAL
	select BR2_PACKAGE_LIBVORBIS
	select BR2_PACKAGE_LIBOGG
	select BR2_PACKAGE_LIBCURL
	select BR2_PACKAGE_LIBPNG
	select BR2_PACKAGE_JPEG
	help
	  Luanti (formerly Minetest) is a free open-source voxel
	  game engine. Fully free, no game data needed.

	  https://github.com/minetest/minetest
```

## package/games/nanosaur2/Config.in
```kconfig
config BR2_PACKAGE_NANOSAUR2
	bool "nanosaur2"
	depends on BR2_INSTALL_LIBSTDCPP
	depends on !BR2_STATIC_LIBS
	depends on BR2_PACKAGE_HAS_LIBGL || BR2_PACKAGE_HAS_LIBGLES
	select BR2_PACKAGE_SDL2
	select BR2_PACKAGE_LIBGL if BR2_PACKAGE_HAS_LIBGL
	select BR2_PACKAGE_GL4ES if !BR2_PACKAGE_HAS_LIBGL
	select BR2_PACKAGE_LIBGLES if BR2_PACKAGE_HAS_LIBGLES
	help
	  Nanosaur 2: Hatchling by Pangea Software, open-sourced
	  by Jorio. 3D dinosaur shooter. All assets included.
	  Requires SDL3.

	  https://github.com/jorio/Nanosaur2
```

## package/games/neverball/Config.in
```kconfig
config BR2_PACKAGE_NEVERBALL
	bool "neverball"
	depends on !BR2_STATIC_LIBS
	depends on BR2_PACKAGE_HAS_LIBGL || BR2_PACKAGE_HAS_LIBGLES
	select BR2_PACKAGE_SDL2
	select BR2_PACKAGE_SDL2_TTF
	select BR2_PACKAGE_LIBVORBIS
	select BR2_PACKAGE_LIBOGG
	select BR2_PACKAGE_LIBPNG
	select BR2_PACKAGE_JPEG
	help
	  Neverball is a tilt-the-floor ball puzzle game.
	  Includes Neverputt (mini-golf). Fully free, all
	  game data included.

	  https://github.com/Neverball/neverball
```

## package/games/openfodder/Config.in
```kconfig
config BR2_PACKAGE_OPENFODDER
	bool "openfodder"
	depends on BR2_INSTALL_LIBSTDCPP
	depends on !BR2_STATIC_LIBS
	select BR2_PACKAGE_SDL2
	select BR2_PACKAGE_SDL2_MIXER
	help
	  OpenFodder is a reimplementation of Cannon Fodder.
	  Includes shareware campaign data. Full campaigns
	  require original Amiga/DOS/CD32 game data.

	  https://github.com/OpenFodder/openfodder
```

## package/games/srb2/Config.in
```kconfig
config BR2_PACKAGE_SRB2
	bool "srb2"
	depends on BR2_INSTALL_LIBSTDCPP
	depends on !BR2_STATIC_LIBS
	depends on BR2_PACKAGE_HAS_LIBGL || BR2_PACKAGE_HAS_LIBGLES
	select BR2_PACKAGE_SDL2
	select BR2_PACKAGE_SDL2_MIXER
	select BR2_PACKAGE_LIBPNG
	select BR2_PACKAGE_ZLIB
	select BR2_PACKAGE_LIBCURL
	help
	  Sonic Robo Blast 2 is a 3D Sonic the Hedgehog fan game
	  built on the Doom Legacy engine. Full campaigns,
	  multiplayer, completely free.

	  https://github.com/STJr/SRB2
```

## package/games/srb2kart/Config.in
```kconfig
config BR2_PACKAGE_SRB2KART
	bool "srb2kart"
	depends on BR2_INSTALL_LIBSTDCPP
	depends on !BR2_STATIC_LIBS
	depends on BR2_PACKAGE_HAS_LIBGL || BR2_PACKAGE_HAS_LIBGLES
	select BR2_PACKAGE_SDL2
	select BR2_PACKAGE_SDL2_MIXER
	select BR2_PACKAGE_LIBPNG
	select BR2_PACKAGE_ZLIB
	select BR2_PACKAGE_LIBCURL
	help
	  Sonic Robo Blast 2 Kart is a kart racing spinoff of SRB2.
	  Mario Kart-style racing with Sonic characters.
	  Completely free, all assets included.

	  https://github.com/STJr/Kart-Public
```

## package/games/yatka/Config.in
```kconfig
config BR2_PACKAGE_YATKA
	bool "yatka"
	select BR2_PACKAGE_SDL
	select BR2_PACKAGE_SDL_IMAGE
	select BR2_PACKAGE_SDL_MIXER
	select BR2_PACKAGE_SDL_TTF
	help
	  Yatka is a modern Tetris implementation using SDL 1.2.
	  Fully free, all assets included.

	  https://github.com/szymor/yatka
```
