## package/utils/vkbasalt/Config.in
```kconfig
config BR2_PACKAGE_VKBASALT
    bool "vkbasalt"
    depends on BR2_PACKAGE_REGLINUX_GAMESCOPE
    #select BR2_PACKAGE_WAYLAND
    #select BR2_PACKAGE_WLROOTS
    #select BR2_PACKAGE_STB
    #select BR2_PACKAGE_SDL2
    #select BR2_PACKAGE_LIBDECOR
    #select BR2_PACKAGE_GLM
    #select BR2_PACKAGE_GLSLANG
    #select BR2_PACKAGE_SPIRV_TOOLS
    #select BR2_PACKAGE_XWAYLAND
    #select BR2_PACKAGE_WLROOTS_XWAYLAND
    #select BR2_PACKAGE_XORG7
    #select BR2_PACKAGE_LIBXCB
    #select BR2_PACKAGE_XLIB_LIBXCOMPOSITE
    #select BR2_PACKAGE_XLIB_LIBXDAMAGE
    #select BR2_PACKAGE_XLIB_LIBXRES
    #select BR2_PACKAGE_XLIB_LIBXXF86VM
    #select BR2_PACKAGE_XLIB_LIBXTST
    #select BR2_PACKAGE_XLIB_LIBXCURSOR
    #select BR2_PACKAGE_XLIB_LIBXMU

    help
        vkBasalt is a Vulkan post processing layer to enhance the visual graphics of games.

	https://github.com/DadSchoorse/vkBasalt
```
