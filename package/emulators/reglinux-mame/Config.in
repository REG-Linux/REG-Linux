## package/ports/augustus/Config.in
```kconfig
config BR2_PACKAGE_AUGUSTUS
	bool "augustus"
	select BR2_PACKAGE_SDL2
	select BR2_PACKAGE_SDL2_MIXER
	select BR2_PACKAGE_LIBPNG
        select BR2_PACKAGE_LIBEXECINFO          if BR2_TOOLCHAIN_USES_MUSL
        select BR2_PACKAGE_LIBBACKTRACE         if BR2_TOOLCHAIN_USES_MUSL
	help
	  The aim of this project is to provide enhanced, customizable gameplay to Caesar 3 using project Julius UI enhancements.

	  https://github.com/Keriew/augustus
```

## package/ports/bstone/Config.in
```kconfig
config BR2_PACKAGE_BSTONE
	bool "bstone"
	select BR2_PACKAGE_SDL2
	select BR2_PACKAGE_OPENAL
	help
	 Unofficial source port for Blake Stone series
	 (Aliens Of Gold and Planet Strike).

	  https://github.com/bibendovsky/bstone
```

## package/ports/ecwolf/Config.in
```kconfig
config BR2_PACKAGE_ECWOLF
    bool "ecwolf"
    select BR2_PACKAGE_HOST_ECWOLF
    select BR2_PACKAGE_SDL2
    select BR2_PACKAGE_SDL2_NET
    select BR2_PACKAGE_SDL2_MIXER
    select BR2_PACKAGE_ZLIB
    select BR2_PACKAGE_BZIP2
    select BR2_PACKAGE_LIBJPEG
    select BR2_PACKAGE_MUSL_FTS		if BR2_TOOLCHAIN_USES_MUSL
    help
      ECWolf is a port of the Wolfenstein 3D engine based of Wolf4SDL.

	    http://maniacsvault.net/ecwolf/
```
