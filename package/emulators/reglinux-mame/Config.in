## package/emulators/reglinux-mame/Config.in
```kconfig
config BR2_PACKAGE_HAS_MAME
        bool

config BR2_PACKAGE_HAS_LIBRETRO_MAME
        bool

config BR2_PACKAGE_REGLINUX_MAME
	bool "reglinux-mame"

        # Make sure to build dependencies even if prebuilt
	select BR2_PACKAGE_ALSA_LIB
	select BR2_PACKAGE_SDL2
	select BR2_PACKAGE_SDL2_TTF
	select BR2_PACKAGE_ZLIB
	select BR2_PACKAGE_LIBPNG
	select BR2_PACKAGE_JPEG
	select BR2_PACKAGE_SQLITE
	select BR2_PACKAGE_FONTCONFIG
	select BR2_PACKAGE_RAPIDJSON
	select BR2_PACKAGE_EXPAT
	select BR2_PACKAGE_GLM

	# Virtual packages for ES systems
	select BR2_PACKAGE_HAS_MAME
	select BR2_PACKAGE_HAS_LIBRETRO_MAME
	help
	  MAME and libretro-mame prebuilt package

	  https://github.com/REG-Linux/REG-MAME
```

## package/emulators/sugarbox/Config.in
```kconfig
config BR2_PACKAGE_SUGARBOX
	bool "sugarbox"

	depends on BR2_PACKAGE_REGLINUX_HAS_QT6

	help
	  SugarBox - Amstrad CPC emulator
	  https://github.com/Tom1975/SugarboxV2
```

## package/emulators/xemu/Config.in
```kconfig
config BR2_PACKAGE_XEMU
    bool "xemu"
    depends on BR2_TOOLCHAIN_GCC_AT_LEAST_8
    select BR2_PACKAGE_SDL2
    select BR2_PACKAGE_LIBSAMPLERATE
    select BR2_PACKAGE_SLIRP
    select BR2_PACKAGE_PYTHON_PYYAML
    select BR2_PACKAGE_LIBPCAP
    select BR2_PACKAGE_LIBCURL
    select BR2_PACKAGE_LIBUSB
    select BR2_PACKAGE_JSON_FOR_MODERN_CPP
    select BR2_PACKAGE_HOST_CMAKE
    help
        Xbox (og) emulator based on QEMU

        https://xemu.app/
```

## package/emulators/xenia-canary/Config.in
```kconfig
config BR2_PACKAGE_XENIA_CANARY
    bool "xenia-canary"
    #depends on BR2_x86_64
    depends on BR2_PACKAGE_LLVM
    depends on BR2_PACKAGE_CLANG
    select BR2_PACKAGE_PYTHON_TOML
    select BR2_PACKAGE_LIBGTK3
    select BR2_PACKAGE_SDL2
    select BR2_PACKAGE_BINUTILS
    select BR2_PACKAGE_LIBUNWIND
    help
        Xenia is an open source research project for emulating Xbox 360 games on modern PCs.
        This is the bleeding edge canary release.

        https://xenia.jp/
```

## package/firmwares/firmware-orangepi/Config.in
```kconfig
config BR2_PACKAGE_FIRMWARE_ORANGEPI
	bool "firmware-orangepi"
	help
	  This package contains firmware files for Orange Pi devices.

	  https://github.com/orangepi-xunlong/firmware
```

## package/firmwares/sound-open-firmware/Config.in
```kconfig
config BR2_PACKAGE_SOUND_OPEN_FIRMWARE
	bool "sound-open-firmware"
	select BR2_PACKAGE_ALSA_LIB
	select BR2_PACKAGE_ALSA_UTILS
	select BR2_PACKAGE_ALLLINUXFIRMWARES	if !BR2_PACKAGE_SYSTEM_VIRTUAL_TARGET
	help
	  Open source audio DSP firmware and development tools.

	  https://www.sofproject.org/
```

## package/games/lbreakouthd/Config.in
```kconfig
config BR2_PACKAGE_LBREAKOUTHD
	bool "LBreakoutHD"
	select BR2_PACKAGE_SDL2
	select BR2_PACKAGE_SDL2_IMAGE
	select BR2_PACKAGE_SDL2_MIXER
	select BR2_PACKAGE_SDL2_TTF
	select BR2_PACKAGE_LIBPNG
	help
	  LBreakoutHD is the successor to LBreakout2, a breakout-style
	  arcade game in the manner of Arkanoid. Requires SDL2, libpng,
	  and optionally SDL2_mixer/SDL2_net.
	  A display with minimum 640x480 resolution, a keyboard and a
	  mouse are recommended.

	  https://lgames.sourceforge.io/LBreakoutHD/
```

## package/games/ltris2/Config.in
```kconfig
config BR2_PACKAGE_LTRIS2
	bool "LTris2"
	depends on BR2_USE_MMU # fork()
	select BR2_PACKAGE_SDL2
	select BR2_PACKAGE_SDL2_IMAGE
	select BR2_PACKAGE_SDL2_MIXER
	select BR2_PACKAGE_SDL2_TTF
	help
	  LTris2 is a tetris clone, using SDL2. It optionally requires
	  SDL2_mixer for audio support. A display with minimum 640x480
	  resolution and a keyboard are recommended.

	  http://lgames.sourceforge.net/index.php?project=LTris
```

## package/games/warzone2100/Config.in
```kconfig
config BR2_PACKAGE_WARZONE2100
	bool "warzone2100"
	select BR2_PACKAGE_SDL2
	select BR2_PACKAGE_LIBSODIUM
	select BR2_PACKAGE_SQLITE
	select BR2_PACKAGE_SQLITE_ENABLE_COLUMN_METADATA
	select BR2_PACKAGE_PROTOBUF
	select BR2_PACKAGE_LIBZIP
	select BR2_PACKAGE_PHYSFS
	select BR2_PACKAGE_OPENAL
	select BR2_PACKAGE_LIBTHEORA
	select BR2_PACKAGE_LIBCURL
	depends on BR2_INSTALL_LIBSTDCPP

	help
	  Warzone 2100 is a free, open source, 3D real-time strategy game 
	  with a story-driven single-player campaign, online multi-player, 
	  offline skirmish, and more.

	  https://wz2100.net/

comment "BR2_PACKAGE_WARZONE2100 needs a toolchain w/ C++"
	depends on !BR2_INSTALL_LIBSTDCPP
```

## package/gpu/img-mesa3d/Config.in
```kconfig
menuconfig BR2_PACKAGE_IMG_MESA3D
	bool "img-mesa3d"
	depends on BR2_INSTALL_LIBSTDCPP
	depends on !BR2_STATIC_LIBS
	depends on BR2_TOOLCHAIN_HAS_SYNC_1
	depends on BR2_TOOLCHAIN_HAS_THREADS_NPTL
	depends on !BR2_m68k || BR2_TOOLCHAIN_GCC_AT_LEAST_7 # m68k needs gcc >= 7.x
	select BR2_PACKAGE_EXPAT
	select BR2_PACKAGE_LIBDRM
	select BR2_PACKAGE_WAYLAND_PROTOCOLS if BR2_PACKAGE_WAYLAND
	select BR2_PACKAGE_ZLIB
	help
	  Mesa 3D, an open-source implementation of the OpenGL
	  specification.

	  http://mesa3d.org

if BR2_PACKAGE_IMG_MESA3D

# Some Gallium driver needs libelf when built with LLVM support
config BR2_PACKAGE_IMG_MESA3D_NEEDS_ELFUTILS
	bool

config BR2_PACKAGE_IMG_MESA3D_LLVM
	bool "llvm support"
	depends on BR2_PACKAGE_LLVM_ARCH_SUPPORTS
	depends on BR2_TOOLCHAIN_GCC_AT_LEAST_5
	depends on BR2_TOOLCHAIN_HAS_THREADS
	depends on BR2_INSTALL_LIBSTDCPP
	depends on !BR2_TOOLCHAIN_HAS_GCC_BUG_64735 # std::shared_future
	depends on !BR2_STATIC_LIBS
	depends on BR2_USE_WCHAR # std::wstring
	depends on BR2_HOST_GCC_AT_LEAST_5 # host-llvm
	select BR2_PACKAGE_LLVM

comment "llvm support needs a toolchain w/ wchar, threads, C++, gcc >= 5, dynamic library, host gcc >= 5"
	depends on BR2_PACKAGE_LLVM_ARCH_SUPPORTS
	depends on !BR2_TOOLCHAIN_HAS_THREADS || !BR2_INSTALL_LIBSTDCPP || \
		!BR2_TOOLCHAIN_GCC_AT_LEAST_5 \
		|| BR2_STATIC_LIBS || !BR2_USE_WCHAR \
		|| !BR2_HOST_GCC_AT_LEAST_5

comment "llvm support needs a toolchain not affected by GCC bug 64735"
	depends on BR2_PACKAGE_LLVM_ARCH_SUPPORTS
	depends on BR2_TOOLCHAIN_HAS_GCC_BUG_64735

# clang and libclc dependencies are satisfied by
# BR2_PACKAGE_IMG_MESA3D_LLVM
config BR2_PACKAGE_IMG_MESA3D_OPENCL
	bool "OpenCL support"
	depends on BR2_PACKAGE_IMG_MESA3D_LLVM
	depends on BR2_PACKAGE_IMG_MESA3D_GALLIUM_DRIVER_R600 || \
		BR2_PACKAGE_IMG_MESA3D_GALLIUM_DRIVER_RADEONSI
	select BR2_PACKAGE_LLVM_RTTI
	select BR2_PACKAGE_CLANG
	select BR2_PACKAGE_LIBCLC
	select BR2_PACKAGE_HAS_LIBOPENCL

# inform the .mk file of gallium, dri, dri3 or vulkan driver selection
config BR2_PACKAGE_IMG_MESA3D_DRI3
	bool
	select BR2_PACKAGE_XLIB_LIBXSHMFENCE

config BR2_PACKAGE_IMG_MESA3D_GALLIUM_DRIVER
	bool
	select BR2_PACKAGE_IMG_MESA3D_DRIVER

config BR2_PACKAGE_IMG_MESA3D_VULKAN_DRIVER
	bool
	select BR2_PACKAGE_IMG_MESA3D_DRIVER

config BR2_PACKAGE_IMG_MESA3D_DRIVER
	bool

# Gallium xa state tracker.
# Quote from mesa3d meson.build: "XA state tracker requires at least
# one of the following gallium drivers: nouveau, freedreno, i915, svga.
config BR2_PACKAGE_IMG_MESA3D_NEEDS_XA
	bool

# OpenGL GLX needs X11
config BR2_PACKAGE_IMG_MESA3D_NEEDS_X11
	bool
	depends on BR2_PACKAGE_XORG7
	select BR2_PACKAGE_LIBXCB
	select BR2_PACKAGE_XLIB_LIBX11
	select BR2_PACKAGE_XLIB_LIBXDAMAGE
	select BR2_PACKAGE_XLIB_LIBXEXT
	select BR2_PACKAGE_XLIB_LIBXFIXES
	select BR2_PACKAGE_XLIB_LIBXRANDR
	select BR2_PACKAGE_XLIB_LIBXXF86VM
	select BR2_PACKAGE_XORGPROTO

comment "Gallium drivers"

config BR2_PACKAGE_IMG_MESA3D_GALLIUM_DRIVER_SVGA
	bool "Gallium vmware svga driver"
	select BR2_PACKAGE_IMG_MESA3D_GALLIUM_DRIVER
	select BR2_PACKAGE_LIBDRM_VMWGFX
	select BR2_PACKAGE_IMG_MESA3D_NEEDS_XA
	help
	  This is a virtual GPU driver for VMWare virtual machines.

config BR2_PACKAGE_IMG_MESA3D_GALLIUM_DRIVER_SWRAST
	bool "Gallium swrast driver"
	select BR2_PACKAGE_IMG_MESA3D_GALLIUM_DRIVER
	help
	  This is a software opengl implementation using the Gallium3D
	  infrastructure.

config BR2_PACKAGE_IMG_MESA3D_GALLIUM_DRIVER_VIRGL
	bool "Gallium virgl driver"
	select BR2_PACKAGE_IMG_MESA3D_GALLIUM_DRIVER
	select BR2_PACKAGE_IMG_MESA3D_OPENGL_EGL
	help
	  virgl is the 3D acceleration backend for the virtio-gpu
	  shipping with qemu.

config BR2_PACKAGE_IMG_MESA3D_GALLIUM_DRIVER_PVR
	bool "Gallium pvr driver"
	select BR2_PACKAGE_IMG_MESA3D_GALLIUM_DRIVER
	select BR2_PACKAGE_IMG_MESA3D_OPENGL_EGL
	help
	  pvr is the 3D acceleration backend for Imagination PowerVR GPUs

config BR2_PACKAGE_IMG_MESA3D_XVMC
	bool "Gallium XvMC state tracker"
	depends on BR2_PACKAGE_XORG7
	depends on BR2_PACKAGE_IMG_MESA3D_GALLIUM_DRIVER_NOUVEAU \
		|| BR2_PACKAGE_IMG_MESA3D_GALLIUM_DRIVER_R600
	select BR2_PACKAGE_IMG_MESA3D_NEEDS_X11
	select BR2_PACKAGE_XLIB_LIBXV
	select BR2_PACKAGE_XLIB_LIBXVMC
	help
	  XvMC state tracker (needs r600 or nouveau gallium drivers).

comment "Gallium XvMC state tracker needs X.org and gallium drivers r600 or nouveau"
	depends on !BR2_PACKAGE_XORG7 || \
		!(BR2_PACKAGE_IMG_MESA3D_GALLIUM_DRIVER_NOUVEAU \
		|| BR2_PACKAGE_IMG_MESA3D_GALLIUM_DRIVER_R600)

comment "Off-screen Rendering"

config BR2_PACKAGE_IMG_MESA3D_OSMESA_GALLIUM
	bool "OSMesa (Gallium) library"
	select BR2_PACKAGE_IMG_MESA3D_GALLIUM_DRIVER_SWRAST
	help
	  The OSMesa API provides functions for off-screen rendering.

if BR2_PACKAGE_IMG_MESA3D_DRIVER

comment "OpenGL API Support"

config BR2_PACKAGE_IMG_MESA3D_GBM
	bool "gbm"
	depends on BR2_PACKAGE_IMG_MESA3D_GALLIUM_DRIVER && \
		BR2_PACKAGE_IMG_MESA3D_OPENGL_EGL
	select BR2_PACKAGE_HAS_LIBGBM
	select BR2_PACKAGE_LIBGBM_HAS_FEATURE_FORMAT_MODIFIER_PLANE_COUNT
	select BR2_PACKAGE_LIBGBM_HAS_FEATURE_DMA_BUF
	help
	  Enable Generic Buffer Management (gbm)

comment "gbm support needs a gallium driver w/ EGL support."
	depends on !(BR2_PACKAGE_IMG_MESA3D_GALLIUM_DRIVER && BR2_PACKAGE_IMG_MESA3D_OPENGL_EGL)

config BR2_PACKAGE_IMG_MESA3D_OPENGL_GLX
	bool "OpenGL GLX"
	depends on BR2_PACKAGE_XORG7
	select BR2_PACKAGE_HAS_LIBGL if !BR2_PACKAGE_LIBGLVND
	select BR2_PACKAGE_LIBGLVND_DISPATCH_GL if BR2_PACKAGE_LIBGLVND
	select BR2_PACKAGE_IMG_MESA3D_NEEDS_X11
	help
	  Enable GLX graphic acceleration (OpenGL + X11).

comment "OpenGL GLX support needs X11"
	depends on !BR2_PACKAGE_XORG7

config BR2_PACKAGE_IMG_MESA3D_OPENGL_EGL
	bool "OpenGL EGL"
	depends on BR2_PACKAGE_IMG_MESA3D_GALLIUM_DRIVER
	select BR2_PACKAGE_HAS_LIBEGL if !BR2_PACKAGE_LIBGLVND
	select BR2_PACKAGE_LIBGLVND_DISPATCH_EGL if BR2_PACKAGE_LIBGLVND
	select BR2_PACKAGE_IMG_MESA3D_GBM
	help
	  Use the Khronos EGL APIs. EGL is a window manager for OpenGL
	  applications similar to GLX, for X, and WGL, for Windows.

config BR2_PACKAGE_IMG_MESA3D_OPENGL_ES
	bool "OpenGL ES"
	select BR2_PACKAGE_HAS_LIBGLES if !BR2_PACKAGE_LIBGLVND
	select BR2_PACKAGE_LIBGLVND_DISPATCH_GLES if BR2_PACKAGE_LIBGLVND
	help
	  Use the Khronos OpenGL ES APIs. This is commonly used on
	  embedded systems and represents a subset of the OpenGL API.

endif # BR2_PACKAGE_IMG_MESA3D_DRIVER

config BR2_PACKAGE_PROVIDES_LIBGBM
	default "img-mesa3d" if BR2_PACKAGE_IMG_MESA3D_GBM

config BR2_PACKAGE_PROVIDES_LIBGL
	default "img-mesa3d" if BR2_PACKAGE_IMG_MESA3D_OPENGL_GLX && !BR2_PACKAGE_LIBGLVND

config BR2_PACKAGE_PROVIDES_LIBEGL
	default "img-mesa3d" if BR2_PACKAGE_IMG_MESA3D_OPENGL_EGL && !BR2_PACKAGE_LIBGLVND

#config BR2_PACKAGE_PROVIDES_LIBGLES
#	default "img-mesa3d" if BR2_PACKAGE_IMG_MESA3D_OPENGL_ES && !BR2_PACKAGE_LIBGLVND

#config BR2_PACKAGE_PROVIDES_LIBOPENCL
#	default "img-mesa3d" if BR2_PACKAGE_IMG_MESA3D_OPENCL

endif # BR2_PACKAGE_IMG_MESA3D

comment "mesa3d needs a toolchain w/ C++, NPTL, dynamic library"
	depends on !BR2_INSTALL_LIBSTDCPP || !BR2_TOOLCHAIN_HAS_THREADS_NPTL || \
		BR2_STATIC_LIBS
	depends on BR2_TOOLCHAIN_HAS_SYNC_1

comment "mesa3d needs a toolchain w/ gcc >= 7"
	depends on BR2_m68k
	depends on !BR2_TOOLCHAIN_GCC_AT_LEAST_7
```

## package/gpu/vulkan/spirv-cross/Config.in
```kconfig
config BR2_PACKAGE_SPIRV_CROSS
  bool "spirv-cross"
  depends on BR2_PACKAGE_WAYLAND || BR2_PACKAGE_XORG7
  select BR2_PACKAGE_VULKAN_HEADERS	if BR2_PACKAGE_REGLINUX_VULKAN
  select BR2_PACKAGE_VULKAN_LOADER	if BR2_PACKAGE_REGLINUX_VULKAN
  help
    SPIRV-Cross is a tool designed for parsing and converting SPIR-V to other shader languages.

    https://github.com/KhronosGroup/SPIRV-Cross
```

## package/libraries/appstream/Config.in
```kconfig
config BR2_PACKAGE_APPSTREAM
	bool "appstream"
	select BR2_PACKAGE_LIBXMLB
	select BR2_PACKAGE_LIBCURL
	select BR2_PACKAGE_LIBIDN2
	select BR2_PACKAGE_ITSTOOL
	select BR2_PACKAGE_LIBYAML
	select BR2_PACKAGE_GPERF
	select BR2_PACKAGE_BROTLI
	select BR2_PACKAGE_ZSTD

	help 
	    AppStream makes machine-readable software metadata easily accessible. 
	    This library provides objects and helper methods to help reading and writing AppStream metadata.

		https://github.com/ximion/appstream
```

## package/libraries/cxxopts/Config.in
```kconfig
config BR2_PACKAGE_CXXOPTS
	bool "cxxopts"

	help
	  This is a lightweight C++ 
	  option parser library, 
	  supporting the standard GNU 
	  style syntax for options.

	  https://github.com/jarro2783/cxxopts
```

## package/libraries/gcompat/Config.in
```kconfig
config BR2_PACKAGE_GCOMPAT
	bool "gcompat"
	depends on BR2_TOOLCHAIN_USES_MUSL
	help
	  GNU C Library compatibility layer for musl.
	  Lets glibc-linked binaries run on musl systems
```

## package/libraries/kddockwidgets/Config.in
```kconfig
config BR2_PACKAGE_KDDOCKWIDGETS
    bool "kddockwidgets"
	depends on BR2_PACKAGE_REGLINUX_QT6
	select BR2_PACKAGE_SPDLOG
	select BR2_PACKAGE_FMT
	select BR2_PACKAGE_JSON_FOR_MODERN_CPP

    help
        A Qt dock widget library written by KDAB, 
	suitable for replacing QDockWidget and 
	implementing advanced functionalities missing in Qt.
```

## package/libraries/lhasa/Config.in
```kconfig
config BR2_PACKAGE_LHASA
	bool "lhasa
	help
	  Lhasa is a library for parsing LHA (.lzh) archives and a free
	  replacement for the Unix LHA tool.

	  https://github.com/fragglet/lhasa
```

## package/libraries/libmt32emu/Config.in
```kconfig
config BR2_PACKAGE_LIBMT32EMU
	bool "libmt32emu"

	help
	  mt32emu is a C/C++ library which allows to 
	  emulate (approximately) the Roland MT-32, CM-32L 
	  and LAPC-I synthesiser modules.

	  From "Munt" project

	  https://github.com/munt/munt
```

## package/libraries/libplacebo/Config.in
```kconfig
config BR2_PACKAGE_LIBPLACEBO
    bool "libplacebo"
    #select BR2_PACKAGE_LIBDRM
    help
	libplacebo for MPV
```

## package/libraries/libtidy/Config.in
```kconfig
config BR2_PACKAGE_LIBTIDY
	bool "libtidy"

	help
	  HTACG HTML Tidy

	  https://github.com/htacg/tidy-html5
```

## package/libraries/onnxruntime/Config.in
```kconfig
config BR2_PACKAGE_ONNXRUNTIME
	bool "onnxruntime"
	depends on BR2_INSTALL_LIBSTDCPP
	depends on BR2_PACKAGE_PROTOBUF
	select BR2_PACKAGE_LIBABSEIL_CPP
	help
	  ONNX Runtime inference engine (CPU only)

	  Minimal C++ runtime built via upstream cmake/.
```

## package/libraries/plutovg/Config.in
```kconfig
config BR2_PACKAGE_PLUTOVG
	bool "plutovg"

	help
	  PlutoVG is a standalone 2D vector graphics library in C.

	  https://github.com/sammycage/plutovg
```

## package/libraries/reglinux-llvm/Config.in
```kconfig
config BR2_PACKAGE_REGLINUX_LLVM_BUILD_FROM_SOURCE
    bool "reglinux-llvm-build-from-source"
    default n

config BR2_PACKAGE_REGLINUX_HAS_LLVM
    bool

config BR2_PACKAGE_REGLINUX_LLVM
    bool "reglinux-llvm"
    depends on BR2_PACKAGE_LLVM_ARCH_SUPPORTS
    depends on BR2_TOOLCHAIN_GCC_AT_LEAST_7
    depends on BR2_TOOLCHAIN_HAS_THREADS
    depends on BR2_INSTALL_LIBSTDCPP
    depends on !BR2_TOOLCHAIN_HAS_GCC_BUG_64735 # std::shared_future
    depends on !BR2_STATIC_LIBS
    depends on BR2_USE_WCHAR            # std::wstring
    depends on BR2_HOST_GCC_AT_LEAST_7  # host-llvm

    help
        Prebuilt (or built from source) REG-Linux LLVM/clang/libclc
```
