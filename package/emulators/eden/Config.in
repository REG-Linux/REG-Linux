## package/emulators/eden/Config.in
```kconfig
config BR2_PACKAGE_EDEN
	bool "eden"
	depends on BR2_x86_64 || BR2_aarch64
	select BR2_PACKAGE_JSON_FOR_MODERN_CPP
	select BR2_PACKAGE_REGLINUX_QT6
	select BR2_PACKAGE_SDL2
	select BR2_PACKAGE_FMT
	select BR2_PACKAGE_BOOST
	select BR2_PACKAGE_ZSTD
	select BR2_PACKAGE_ZLIB
	select BR2_PACKAGE_LIBZIP
	select BR2_PACKAGE_LIBUSB
	select BR2_PACKAGE_LZ4
	select BR2_PACKAGE_CATCH2
	select BR2_PACKAGE_OPUS
	select BR2_PACKAGE_ENET
	select BR2_PACKAGE_GAMEMODE
	select BR2_PACKAGE_LIBVA
	select BR2_PACKAGE_FFMPEG
	select BR2_PACKAGE_CUBEB
	select BR2_PACKAGE_LIBDRM
	select BR2_PACKAGE_WAYLAND
	select BR2_PACKAGE_LIBXKBCOMMON
	# Need yasm on x86_64 to compile bundled ffmpeg
	select BR2_PACKAGE_HOST_YASM		if BR2_x86_64
	select BR2_PACKAGE_MBEDTLS
	select BR2_PACKAGE_VULKAN_UTILITY_LIBRARIES	if BR2_PACKAGE_REGLINUX_VULKAN

	help
	  Eden: Nintendo Switch Emulator

	  Eden is a Nintendo Switch emulator forked from Yuzu/Citra,
	  focusing on performance and accuracy. It supports both
	  desktop and handheld gaming with enhanced graphics up to
	  4K resolution.

	  https://eden-emu.dev/
```

## package/emulators/flycast/Config.in
```kconfig
config BR2_PACKAGE_FLYCAST
    bool "flycast"
    select BR2_PACKAGE_SDL2
    select BR2_PACKAGE_LIBZIP
    select BR2_PACKAGE_LIBCURL
    select BR2_PACKAGE_ALSA_LIB
    select BR2_PACKAGE_LIBAO
    select BR2_PACKAGE_LIBMINIUPNPC
    depends on BR2_GCC_ENABLE_OPENMP
    select BR2_PACKAGE_GLSLANG		if BR2_PACKAGE_REGLINUX_VULKAN
    help
      Flycast is a multi-platform Sega Dreamcast, Naomi and Atomiswave
      emulator derived from reicast.

      Features:
      - OpenGL ES 2/3 or Desktop OpenGL rendering
      - Vulkan support (optional, requires glslang)
      - SDL2 for input/audio/windowing
      - ALSA for audio output (PipeWire compatible)
      - Netplay support
      - Per-SoC optimizations (RK3399, RK3568, RPi4/5, S922X, etc.)

      https://github.com/flyinghead/flycast
```

## package/emulators/gopher64/Config.in
```kconfig
config BR2_PACKAGE_GOPHER64
	bool "gopher64"
	depends on BR2_PACKAGE_HOST_RUSTC_TARGET_ARCH_SUPPORTS
	select BR2_PACKAGE_HOST_RUSTC
	select BR2_PACKAGE_FONTCONFIG
	select BR2_PACKAGE_LIBXKBCOMMON
	select BR2_PACKAGE_XLIB_LIBXCURSOR
	select BR2_PACKAGE_XLIB_LIBXEXT
	select BR2_PACKAGE_XLIB_LIBXFIXES
	select BR2_PACKAGE_XLIB_LIBXI
	select BR2_PACKAGE_XLIB_LIBXRANDR
	select BR2_PACKAGE_XLIB_LIBXSCRNSAVER
	select BR2_PACKAGE_XLIB_LIBXTST

	depends on BR2_PACKAGE_WAYLAND
	depends on BR2_PACKAGE_ALSA_LIB
	depends on BR2_PACKAGE_HAS_LIBGL
	depends on BR2_PACKAGE_XWAYLAND
	depends on BR2_PACKAGE_VULKAN_HEADERS
	depends on BR2_PACKAGE_VULKAN_LOADER

	help
	N64 emulator written in Rust

	https://github.com/gopher64/gopher64
```

## package/emulators/jgenesis/Config.in
```kconfig
config BR2_PACKAGE_JGENESIS
	bool "jgenesis"
	depends on BR2_ARCH_IS_64
	select BR2_PACKAGE_XLIB_LIBX11
	select BR2_PACKAGE_XLIB_LIBXRANDR
	select BR2_PACKAGE_HOST_RUSTC
	select BR2_PACKAGE_HOST_CMAKE

	help
	  jgenesis is a multi-system emulator supporting Sega Genesis/Mega Drive,
	  Sega CD, 32X, Master System, Game Gear, NES, SNES, Game Boy, Game Boy
	  Color, and Game Boy Advance.

	  https://github.com/jsgroth/jgenesis
```

## package/emulators/libretro/libretro-amiberry/Config.in
```kconfig
config BR2_PACKAGE_LIBRETRO_AMIBERRY
    bool "libretro-amiberry"
    select BR2_PACKAGE_ZLIB
    select BR2_PACKAGE_JSON_FOR_MODERN_CPP

    help
	Amiberry Amiga emulator as libretro core
```

## package/emulators/libretro/libretro-azahar/Config.in
```kconfig
config BR2_PACKAGE_LIBRETRO_AZAHAR
    bool "libretro-azahar"
    select BR2_PACKAGE_FMT
    select BR2_PACKAGE_BOOST
    select BR2_PACKAGE_FFMPEG  
    select BR2_PACKAGE_SDL2
    select BR2_PACKAGE_FDK_AAC

    help
      Azahar is an open-source 3DS emulator project based Citra.
      https://github.com/azahar-emu/azahar
```

## package/emulators/libretro/libretro-geolith/Config.in
```kconfig
config BR2_PACKAGE_LIBRETRO_GEOLITH
    bool "libretro-geolith"
    depends on BR2_INSTALL_LIBSTDCPP
    select BR2_PACKAGE_ZLIB
    select BR2_PACKAGE_ZSTD

    help
        Neo Geo AES / MVS emulator for libretro

	https://github.com/libretro/geolith-libretro

comment "LIBRETRO_GEOLITH needs a toolchain w/ C++"
	depends on !BR2_INSTALL_LIBSTDCPP
```

## package/emulators/libretro/libretro-hatari/Config.in
```kconfig
config BR2_PACKAGE_LIBRETRO_HATARI
	bool "libretro-hatari"
	
	depends on BR2_INSTALL_LIBSTDCPP
	select BR2_PACKAGE_LIBCAPSIMAGE
	select BR2_PACKAGE_ZLIB
	# This is ugly but WIP
	select BR2_PACKAGE_SDL2
	  help
	    A libretro Atari ST emulator core.
		
		http://www.libretro.com

comment "LIBRETRO_HATARI needs a toolchain w/ C++"
	depends on !BR2_INSTALL_LIBSTDCPP
```

## package/emulators/libretro/libretro-mame/Config.in
```kconfig
config BR2_PACKAGE_LIBRETRO_MAME
    bool "libretro-mame"
	depends on BR2_INSTALL_LIBSTDCPP
	select BR2_PACKAGE_ALSA_LIB
	select BR2_PACKAGE_HAS_LIBRETRO_MAME
	help
	  A libretro MAME core for arcade game emulation.

	  MAME (Multiple Arcade Machine Emulator) is a multi-purpose
	  emulation framework that can emulate a wide variety of arcade
	  games. This libretro core is a trimmed-down version focused
	  on arcade games.

	  Features:
	  - Extensive arcade game library support
	  - Accurate hardware emulation
	  - Save states
	  - Controller support
	  - Shader support

	  Note: Requires game ROMs and BIOS files.
	  Hash files are installed to /usr/share/lr-mame/hash/

	  http://www.libretro.com
	  https://www.mamedev.org/

comment "LIBRETRO_MAME needs a toolchain w/ C++"
	depends on !BR2_INSTALL_LIBSTDCPP

comment "LIBRETRO_MAME needs ALSA"
	depends on !BR2_PACKAGE_ALSA_LIB
```

## package/emulators/libretro/libretro-mgba/Config.in
```kconfig
config BR2_PACKAGE_LIBRETRO_MGBA
    bool "libretro-mgba"

	depends on BR2_INSTALL_LIBSTDCPP
	select BR2_PACKAGE_LIBZIP
	select BR2_PACKAGE_LIBPNG
	select BR2_PACKAGE_ZLIB
	help
	  A libretro Game Boy Advance emulator core.

	  mGBA is a fast, accurate, and portable GBA emulator with
	  many features including save states, BIOS support, and
	  controller support.

	  Features:
	  - High accuracy GBA emulation
	  - Save states
	  - Real-time clock support
	  - Game Boy/Game Boy Color support
	  - Controller support
	  - Shader support
	  - Cheat support

	  Note: Requires GBA BIOS file for accurate emulation
	  (optional, can run without BIOS)

	  http://www.libretro.com
	  https://mgba.io/

comment "LIBRETRO_MGBA needs a toolchain w/ C++"
	depends on !BR2_INSTALL_LIBSTDCPP
```

## package/emulators/libretro/libretro-ppsspp/Config.in
```kconfig
config BR2_PACKAGE_LIBRETRO_PPSSPP
    bool "libretro-ppsspp"

    depends on BR2_INSTALL_LIBSTDCPP
    help
      A libretro PSP core. PPSSPP is a portable PlayStation Portable
      emulator that supports OpenGL, Vulkan, and software rendering.

      Features:
      - High-resolution rendering
      - Save states
      - Controller support
      - Shader support
      - Vulkan support (optional)

      http://www.libretro.com
      https://www.ppsspp.org/

comment "LIBRETRO_PPSSPP needs a toolchain w/ C++"
    depends on !BR2_INSTALL_LIBSTDCPP
```

## package/emulators/libretro/libretro-supermodel/Config.in
```kconfig
config BR2_PACKAGE_LIBRETRO_SUPERMODEL
	bool "libretro-supermodel"

	depends on BR2_INSTALL_LIBSTDCPP
	depends on (BR2_PACKAGE_HAS_LIBGLES || BR2_PACKAGE_HAS_LIBGL)
      help
        A libretro Sega Model 3 arcade emulator core.

	  http://www.libretro.com

comment "LIBRETRO_SUPERMODEL needs a toolchain w/ C++ and OpenGL ES or OpenGL"
	depends on !BR2_INSTALL_LIBSTDCPP || \
		(!BR2_PACKAGE_HAS_LIBGLES && !BR2_PACKAGE_HAS_LIBGL)
```

## package/emulators/mupen64plus/mupen64plus-gliden64/Config.in
```kconfig
config BR2_PACKAGE_MUPEN64PLUS_GLIDEN64
	bool "mupen64plus-gliden64-plugin"
	select BR2_PACKAGE_ZLIB
	select BR2_PACKAGE_LIBPNG
	select BR2_INSTALL_LIBSTDCPP
	select BR2_PACKAGE_SDL2
	select BR2_PACKAGE_ALSA_LIB
	select BR2_PACKAGE_MUPEN64PLUS_CORE
	help
	  A new generation, open-source graphics plugin for N64 emulators.

	  GLideN64 is a high-level graphics plugin that provides enhanced
	  graphics rendering for Mupen64Plus. It supports modern OpenGL
	  features and can upscale games to higher resolutions.

	  https://github.com/gonetz/GLideN64

comment "MUPEN64PLUS_GLIDEN64 needs a toolchain w/ C++, ALSA and SDL2"
	depends on !BR2_INSTALL_LIBSTDCPP || !BR2_PACKAGE_SDL2 || !BR2_PACKAGE_ALSA_LIB
```

## package/emulators/mupen64plus/mupen64plus-ui-console/Config.in
```kconfig
config BR2_PACKAGE_MUPEN64PLUS_UI_CONSOLE
	bool "mupen64plus-ui-console"
	depends on BR2_INSTALL_LIBSTDCPP
	depends on BR2_PACKAGE_SDL2
	depends on BR2_PACKAGE_ALSA_LIB
	depends on BR2_PACKAGE_MUPEN64PLUS_CORE
	help
	  Console (command-line) front-end user interface for Mupen64Plus.

	  This package provides a command-line interface to run Mupen64Plus
	  games without a graphical frontend.

	  https://github.com/mupen64plus/
	  https://github.com/mupen64plus/mupen64plus-ui-console

comment "MUPEN64PLUS_UI_CONSOLE needs a toolchain w/ C++, ALSA and SDL2"
	depends on !BR2_INSTALL_LIBSTDCPP || !BR2_PACKAGE_SDL2 || !BR2_PACKAGE_ALSA_LIB
```

## package/emulators/pocketHLE/Config.in
```kconfig
config BR2_PACKAGE_POCKETHLE
	bool "pocketHLE"
	depends on BR2_PACKAGE_HOST_RUSTC_TARGET_ARCH_SUPPORTS
	depends on BR2_PACKAGE_LIBGTK3
	depends on BR2_PACKAGE_CLANG
	select BR2_PACKAGE_HOST_RUSTC
	select BR2_PACKAGE_ALSA_LIB
	select BR2_PACKAGE_LIBGLIB2
	#select BR2_PACKAGE_BOOST
	#select BR2_PACKAGE_OPENAL
	#select BR2_PACKAGE_SDL2

	help
        A high-level Windows Mobile / Pocket PC / Gizmondo emulator for Linux, Windows and Android.

        https://github.com/j92580498-max/PocketHLE
```

## package/emulators/rpcs3/Config.in
```kconfig
config BR2_PACKAGE_RPCS3
	bool "rpcs3"
	depends on BR2_TOOLCHAIN_GCC_AT_LEAST_8
	select BR2_HOST_CMAKE_AT_LEAST_3_24
	select BR2_PACKAGE_ALSA_LIB
	select BR2_PACKAGE_LLVM
	select BR2_PACKAGE_FFMPEG_SWSCALE
	select BR2_PACKAGE_LIBEVDEV
	select BR2_PACKAGE_LIBCURL
	select BR2_PACKAGE_LIBPNG
	select BR2_PACKAGE_LIBGLEW
	select BR2_PACKAGE_LIBGLU
	select BR2_PACKAGE_LIBUSB
	select BR2_PACKAGE_LIBXML2
	select BR2_PACKAGE_MESA3D
	select BR2_PACKAGE_NCURSES
	select BR2_PACKAGE_OPENAL
	select BR2_PACKAGE_PUGIXML
	select BR2_PACKAGE_REGLINUX_QT6
	select BR2_PACKAGE_RTMIDI
	select BR2_PACKAGE_RTMPDUMP
	select BR2_PACKAGE_SDL3
	select BR2_PACKAGE_ZLIB
	select BR2_PACKAGE_ZSTD
	select BR2_PACKAGE_CUBEB
	select BR2_PACKAGE_LIBDRM
	select BR2_PACKAGE_WAYLAND
	select BR2_PACKAGE_LIBXKBCOMMON
	select BR2_PACKAGE_CLANG
	help
	  RPCS3 is a multi-platform open-source Sony PlayStation 3 emulator.

	  It supports both Windows and Linux platforms and features both OpenGL
	  and Vulkan renderers. RPCS3 was initiated on 23rd of May, 2011, by
	  DH and Hykem, and is still being actively developed to this day.

	  https://rpcs3.net/
```

## package/emulators/touchHLE/Config.in
```kconfig
config BR2_PACKAGE_TOUCHHLE
	bool "touchHLE"
	depends on BR2_PACKAGE_HOST_RUSTC_TARGET_ARCH_SUPPORTS
	select BR2_PACKAGE_HOST_RUSTC
	select BR2_PACKAGE_BOOST
	select BR2_PACKAGE_OPENAL
	select BR2_PACKAGE_SDL2

	help
        touchHLE is a high-level emulator for iPhone OS apps. 
        It runs on modern desktop operating systems and Android, and is written in Rust.

        https://github.com/touchHLE/touchHLE
```

## package/emulators/vice/Config.in
```kconfig
config BR2_PACKAGE_VICE
	bool "vice"
	select BR2_PACKAGE_SDL2
	select BR2_PACKAGE_SDL2_IMAGE
	select BR2_PACKAGE_ALSA_LIB
	select BR2_PACKAGE_LIBCURL
	select BR2_PACKAGE_HOST_XA
	select BR2_PACKAGE_HOST_DOS2UNIX
	# Image formats
	select BR2_PACKAGE_GIFLIB
	select BR2_PACKAGE_JPEG
	select BR2_PACKAGE_LIBPNG
	# Audio formats (all enabled for full compatibility)
	select BR2_PACKAGE_ZLIB
	select BR2_PACKAGE_LAME
	select BR2_PACKAGE_LIBVORBIS
	select BR2_PACKAGE_MPG123
	select BR2_PACKAGE_FLAC
	help
	  VICE is an emulator collection which emulates the C64, the
	  C64-DTV, the C128, the VIC20, practically all PET models,
	  the PLUS4 and the CBM-II (aka C610).

	  This build uses SDL2 for the user interface (not GTK3).

	  Features:
	  - SDL2 video/audio/input
	  - ALSA audio output
	  - EVDEV input support
	  - Multiple audio formats (MP3, FLAC, Vorbis)
	  - Image formats (PNG, GIF, JPEG)
	  - Network update support (libcurl)

	  https://vice-emu.sourceforge.io/

# Select which VICE binaries we should build
config BR2_PACKAGE_VICE_X64
    bool "Build x64 (C64 standard)"
    default y
    depends on BR2_PACKAGE_VICE
    help
      Build the standard C64 binary (x64).

config BR2_PACKAGE_VICE_X128
    bool "Build x128 (C128)"
    default y
    depends on BR2_PACKAGE_VICE
    help
      Build the Commodore 128 binary (x128).

config BR2_PACKAGE_VICE_XVIC
    bool "Build xvic (VIC-20)"
    default y
    depends on BR2_PACKAGE_VICE
    help
      Build the VIC-20 binary (xvic).

config BR2_PACKAGE_VICE_XPLUS4
    bool "Build xplus4 (Plus/4)"
    default y
    depends on BR2_PACKAGE_VICE
    help
      Build the Commodore Plus/4 binary (xplus4).

config BR2_PACKAGE_VICE_XPET
    bool "Build xpet (PET/CBM-II)"
    default y
    depends on BR2_PACKAGE_VICE
    help
      Build the PET/CBM-II binary (xpet).

config BR2_PACKAGE_VICE_XCBM2
    bool "Build xcbm2 (CBM-II variant)"
    default y
    depends on BR2_PACKAGE_VICE
    help
      Build the CBM-II variant binary (xcbm2).

# Those cores require fast cpu to run fullspeed
config BR2_PACKAGE_VICE_X64DTV
    bool "Build x64dtv (C64-DTV standard)"
    depends on BR2_PACKAGE_VICE
    help
      Build the standard C64-DTV binary (x64dtv).

config BR2_PACKAGE_VICE_X64SC
    bool "Build x64sc (C64 Single Cycle)"
    depends on BR2_PACKAGE_VICE
    help
      Build the C64 Single Cycle binary (x64sc) for precise timing.

config BR2_PACKAGE_VICE_XSCPU64
    bool "Build xscpu64 (C64 SuperCPU)"
    depends on BR2_PACKAGE_VICE
    help
      Build the C64 SuperCPU binary (xscpu64).
```

## package/emulators/vita3k/Config.in
```kconfig
config BR2_PACKAGE_VITA3K
    bool "vita3k"
    select BR2_PACKAGE_SDL3
    select BR2_PACKAGE_SDL3_IMAGE
    select BR2_PACKAGE_SDL3_TTF
    select BR2_PACKAGE_LIBOGG
    select BR2_PACKAGE_LIBVORBIS
    select BR2_PACKAGE_ZLIB
    select BR2_PACKAGE_BOOST
    select BR2_PACKAGE_PYTHON_RUAMEL_YAML
    select BR2_PACKAGE_FMT
    select BR2_PACKAGE_LIBCURL
    help
      Experimental PlayStation Vita emulator

      https://github.com/vita3k/vita3k
```

## package/emulators/xenia-edge/Config.in
```kconfig
config BR2_PACKAGE_XENIA_EDGE
    bool "xenia-edge"
    depends on BR2_x86_64 || BR2_aarch64
    depends on BR2_PACKAGE_LLVM
    depends on BR2_PACKAGE_CLANG
    select BR2_PACKAGE_PYTHON_TOML
    select BR2_PACKAGE_LIBGTK3
    select BR2_PACKAGE_SDL2
    select BR2_PACKAGE_BINUTILS
    select BR2_PACKAGE_LIBUNWIND
    help
        Xenia Edge is a community fork of Xenia Canary (which itself
        forks the original Xenia Xbox 360 Emulator Research Project),
        focused on Vulkan renderer, GUI, and Linux compatibility
        improvements. Experimental package: sits alongside
        xenia-canary for a build/runtime bake-off, not a replacement
        yet.

        aarch64 support (the a64 JIT backend) is experimental - no
        upstream Linux-ARM CI covers it, unlike x86_64.

        https://github.com/has207/xenia-edge
```
