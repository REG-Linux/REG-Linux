## package/emulators/ymir/Config.in
```kconfig
config BR2_PACKAGE_YMIR
    bool "ymir"
    depends on BR2_PACKAGE_CLANG
    depends on BR2_PACKAGE_HAS_LIBEGL
    depends on BR2_x86_64 || BR2_aarch64
    select BR2_PACKAGE_CEREAL
    select BR2_PACKAGE_CXXOPTS
    select BR2_PACKAGE_DATE
    select BR2_PACKAGE_FMT
    select BR2_PACKAGE_JSON_FOR_MODERN_CPP
    select BR2_PACKAGE_LIBCURL
    select BR2_PACKAGE_LIBXKBCOMMON
    select BR2_PACKAGE_NGHTTP3
    select BR2_PACKAGE_RTMIDI
    select BR2_PACKAGE_SDL3
    select BR2_PACKAGE_SEMVER
    select BR2_PACKAGE_STB
    select BR2_PACKAGE_TOMLPLUSPLUS
    select BR2_PACKAGE_WAYLAND
    select BR2_PACKAGE_WAYLAND_PROTOCOLS
    select BR2_PACKAGE_ZSTD
    select BR2_PACKAGE_MINIZIP_ZLIB

    help
      A work-in-progress Sega Saturn emulator.

      Features:
      - Sega Saturn emulation with accurate timing
      - SDL3 frontend for Wayland/X11
      - OpenGL/Vulkan graphics backends
      - CHD, BIN+CUE, IMG+CCD, MDF+MDS, ISO support
      - Requires Sega Saturn IPL BIOS

      https://github.com/StrikerX3/Ymir
```

## package/engines/fna-runtime/Config.in
```kconfig
config BR2_PACKAGE_FNA_RUNTIME
	bool "fna-runtime"
	depends on BR2_aarch64 || BR2_x86_64 || BR2_RISCV_64
	depends on BR2_INSTALL_LIBSTDCPP
	depends on !BR2_STATIC_LIBS # SDL2
	depends on BR2_PACKAGE_HAS_LIBGL || BR2_PACKAGE_HAS_LIBGLES
	select BR2_PACKAGE_SDL2
	select BR2_PACKAGE_GCOMPAT if BR2_TOOLCHAIN_USES_MUSL # glibc compat for MonoKickstart
	select BR2_PACKAGE_BOX64 if BR2_RISCV_64 # x86_64 MonoKickstart via Box64
	help
	  FNA game runtime for running XNA/FNA games (Stardew Valley,
	  Celeste, TMNT Shredder's Revenge, etc.).

	  Includes:
	  - FNA3D (3D graphics, SDL2 backend)
	  - FAudio (XAudio2 reimplementation, SDL2 backend)
	  - Theorafile (Theora video decoding)
	  - MonoKickstart (embedded Mono runtime for .NET/FNA games)

	  On aarch64/x86_64+glibc: MonoKickstart runs natively.
	  On aarch64+musl: MonoKickstart runs via gcompat.
	  On riscv64: x86_64 MonoKickstart runs via Box64.

	  Users must provide their own game files (Steam/GOG purchase).

	  https://fna-xna.github.io

comment "fna-runtime needs aarch64/x86_64/riscv64, C++, OpenGL/GLES, dynamic libs"
	depends on !(BR2_aarch64 || BR2_x86_64 || BR2_RISCV_64) \
		|| !BR2_INSTALL_LIBSTDCPP || BR2_STATIC_LIBS \
		|| !(BR2_PACKAGE_HAS_LIBGL || BR2_PACKAGE_HAS_LIBGLES)
```

## package/engines/gmloader-next/Config.in
```kconfig
config BR2_PACKAGE_GMLOADER_NEXT
	bool "gmloader-next"
	depends on BR2_arm || BR2_aarch64
	depends on BR2_INSTALL_LIBSTDCPP
	depends on !BR2_STATIC_LIBS # SDL2
	select BR2_PACKAGE_SDL2
	select BR2_PACKAGE_ZLIB
	help
	  gmloader-next is a compatibility layer that loads Android
	  GameMaker runner libraries on ARM Linux. It enables running
	  GameMaker Studio games from their Android APK builds.

	  Game data files (.win/.droid) are architecture-independent.
	  Users must provide their own game APK files.

	  Note: ARM-only (loads ARM Android .so binaries).

	  https://github.com/JohnnyonFlame/gmloader-next

comment "gmloader-next needs ARM (arm/aarch64), C++, dynamic libs"
	depends on !(BR2_arm || BR2_aarch64) || !BR2_INSTALL_LIBSTDCPP \
		|| BR2_STATIC_LIBS
```

## package/engines/ikemen/Config.in
```kconfig
config BR2_PACKAGE_IKEMEN
	bool "ikemen"
	depends on BR2_PACKAGE_HOST_GO_TARGET_ARCH_SUPPORTS
	depends on BR2_PACKAGE_HOST_GO_TARGET_CGO_LINKING_SUPPORTS
	depends on BR2_TOOLCHAIN_HAS_THREADS
	depends on BR2_PACKAGE_XORG7
	depends on BR2_PACKAGE_HAS_LIBGL
	select BR2_PACKAGE_HOST_GO
	select BR2_PACKAGE_LIBGTK3
	select BR2_PACKAGE_SDL2

	help
	  A MUGEN emulator written in GoLang

	  Ikemen GO is an open source fighting game engine that supports
	  resources from the MUGEN engine. It features rollback netcode,
	  OpenGL 3.3 rendering, and SDL2-based input/audio handling.

	  https://github.com/ikemen-engine/Ikemen-GO

comment "ikemen needs a toolchain w/ threads"
	depends on BR2_PACKAGE_HOST_GO_TARGET_ARCH_SUPPORTS
```
