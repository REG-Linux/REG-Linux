## package/ports/gzdoom/Config.in.host
```kconfig
config BR2_PACKAGE_HOST_GZDOOM
	bool "host gzdoom tools"
	help
	  This package is required for building gzdoom.
```

## package/ports/hode/Config.in
```kconfig
config BR2_PACKAGE_HODE
	bool "hode"
	depends on BR2_INSTALL_LIBSTDCPP
	select BR2_PACKAGE_SDL2
	help
	  hode is a reimplementation of the engine used in
	  Heart of Darkness by Eric Chahi (Amazing Studio).
	  By Gregory Montoir. Requires retail game data.

	  https://github.com/cyxx/hode
```

## package/ports/libretro/libretro-jazz2-native/Config.in
```kconfig
config BR2_PACKAGE_LIBRETRO_JAZZ2_NATIVE
	bool "libretro-jazz2-native"
	#select BR2_PACKAGE_SDL2
	#select BR2_PACKAGE_OPENAL
	select BR2_PACKAGE_LIBOPENMPT
	select BR2_PACKAGE_LIBCURL
	select BR2_PACKAGE_ZLIB
	help
	  Jazz² Resurrection: Native C++ reimplementation of Jazz Jackrabbit 2.
	  Libretro core variant.

	  https://github.com/deathkiller/jazz2-native
```

## package/ports/nakedavp/Config.in
```kconfig
config BR2_PACKAGE_NAKEDAVP
	bool "nakedavp"
	depends on BR2_INSTALL_LIBSTDCPP
	depends on !BR2_STATIC_LIBS
	depends on BR2_PACKAGE_HAS_LIBGL || BR2_PACKAGE_HAS_LIBGLES
	select BR2_PACKAGE_SDL3
	select BR2_PACKAGE_OPENAL
	select BR2_PACKAGE_FFMPEG
	help
	  Source port of Aliens versus Predator (1999 Rebellion game).
	  Supports OpenGL and OpenGL ES 2.0. Requires retail game data.

	  https://github.com/atsb/NakedAVP
```

## package/ports/nfsiise/Config.in
```kconfig
config BR2_PACKAGE_NFSIISE
	bool "nfsiise"
	depends on BR2_INSTALL_LIBSTDCPP
	depends on !BR2_STATIC_LIBS
	depends on BR2_PACKAGE_HAS_LIBGL || BR2_PACKAGE_HAS_LIBGLES
	select BR2_PACKAGE_SDL2
	help
	  Reimplementation of Need for Speed II Special Edition.
	  Uses C++ translation on non-x86 architectures.
	  Requires original game data files.

	  https://github.com/zaps166/NFSIISE
```

## package/ports/openjk/Config.in
```kconfig
config BR2_PACKAGE_OPENJK
	bool "openjk"
	depends on BR2_INSTALL_LIBSTDCPP
	depends on !BR2_STATIC_LIBS
	select BR2_PACKAGE_JPEG
	select BR2_PACKAGE_LIBPNG
	select BR2_PACKAGE_SDL2
	select BR2_PACKAGE_ZLIB
	help
	  OpenJK is a community source port of Jedi Academy (SP & MP)
	  and Jedi Outcast (SP). Requires retail game data files
	  from Steam/GOG. Two games, one engine.

	  https://github.com/JACoders/OpenJK
```

## package/ports/openrct2/Config.in
```kconfig
config BR2_PACKAGE_OPENRCT2
	bool "openrct2"
	select BR2_PACKAGE_SDL2
	select BR2_PACKAGE_LIBCURL
	select BR2_PACKAGE_LIBZIP
	select BR2_PACKAGE_SPEEXDSP
	select BR2_PACKAGE_FLAC
	select BR2_PACKAGE_LIBVORBIS
	select BR2_PACKAGE_JSON_FOR_MODERN_CPP
	select BR2_PACKAGE_ZLIB
	select BR2_PACKAGE_ZSTD
	select BR2_PACKAGE_LIBPNG
	select BR2_PACKAGE_ICU
	select BR2_PACKAGE_OPENSSL
	select BR2_PACKAGE_FREETYPE
	select BR2_PACKAGE_FONTCONFIG
	depends on BR2_INSTALL_LIBSTDCPP
	# icu
	depends on BR2_USE_WCHAR
	depends on BR2_TOOLCHAIN_HAS_THREADS
	depends on BR2_TOOLCHAIN_GCC_AT_LEAST_4_9
	depends on BR2_HOST_GCC_AT_LEAST_4_9
	depends on !BR2_BINFMT_FLAT

	help
	  An open-source re-implementation of
	  RollerCoaster Tycoon 2, a construction and
	  management simulation video game that simulates
	  amusement park management.

	  https://openrct2.io/

comment "BR2_PACKAGE_OPENRCT2 needs a toolchain w/ C++, wchar, threads"
	depends on !BR2_INSTALL_LIBSTDCPP || !BR2_USE_WCHAR || !BR2_TOOLCHAIN_HAS_THREADS
```

## package/ports/rawgl/Config.in
```kconfig
config BR2_PACKAGE_RAWGL
	bool "rawgl"
	depends on BR2_INSTALL_LIBSTDCPP
	depends on !BR2_STATIC_LIBS
	select BR2_PACKAGE_SDL2
	select BR2_PACKAGE_SDL2_MIXER
	select BR2_PACKAGE_ZLIB
	select BR2_PACKAGE_LIBGL if BR2_PACKAGE_HAS_LIBGL
	help
	  rawgl is a reimplementation of the engine used in the game
	  Another World / Out of This World by Eric Chahi.

	  Supports: DOS, Amiga, Atari, 3DO, Windows 3.1,
	  15th Anniversary, and 20th Anniversary (DotEmu) editions.
	  Requires original game data files.

	  https://github.com/cyxx/rawgl
```

## package/ports/raze/Config.in.host
```kconfig
config BR2_PACKAGE_HOST_RAZE
	bool "host raze tools"
	help
	  This package is required for building raze.
```

## package/ports/serioussam/Config.in
```kconfig
config BR2_PACKAGE_SERIOUSSAM
	bool "serioussam"
	depends on BR2_INSTALL_LIBSTDCPP
	depends on !BR2_STATIC_LIBS
	select BR2_PACKAGE_SDL2
	select BR2_PACKAGE_ZLIB
	select BR2_PACKAGE_LIBVORBIS
	select BR2_PACKAGE_LIBOGG
	help
	  Serious Engine 1 source port (ptitSeb ARM fork).
	  Builds both TFE (The First Encounter) and TSE
	  (The Second Encounter). Requires retail game data.

	  https://github.com/ptitSeb/Serious-Engine
```

## package/ports/sonic-mania/Config.in
```kconfig
config BR2_PACKAGE_SONIC_MANIA
	bool "sonic-mania"
	select BR2_PACKAGE_LIBGLU   if BR2_PACKAGE_XORG7
	select BR2_PACKAGE_LIBGLEW  if BR2_PACKAGE_XORG7
	select BR2_PACKAGE_LIBGLFW  if BR2_PACKAGE_XORG7
	select BR2_PACKAGE_SDL2
	select BR2_PACKAGE_LIBOGG
	select BR2_PACKAGE_LIBTHEORA
	help
	  A complete decompilation of Sonic Mania (2017).

	  https://github.com/RSDKModding/Sonic-Mania-Decompilation
```

## package/ports/sonic2/Config.in
```kconfig
config BR2_PACKAGE_SONIC2
	bool "sonic2"
	select BR2_PACKAGE_SDL2
	select BR2_PACKAGE_SDL2_NET
	select BR2_PACKAGE_SDL2_MIXER
	select BR2_PACKAGE_LIBOGG
	select BR2_PACKAGE_LIBVORBIS
	select BR2_PACKAGE_LIBGLEW    if BR2_PACKAGE_HAS_LIBGL
	select BR2_PACKAGE_LIBGLU     if BR2_PACKAGE_HAS_LIBGL
	select BR2_PACKAGE_LIBGL      if BR2_PACKAGE_HAS_LIBGL
	select BR2_PACKAGE_LIBGLES    if BR2_PACKAGE_HAS_LIBGLES

    help
      Sonic the Hedgehog 2 using the RSDKv4 Decompilation engine.
      Same engine as sonic2013 (Sonic 1). Requires retail game data.

	  https://github.com/RSDKModding/RSDKv4-Decompilation
```

## package/ports/spacecadetpinball/Config.in
```kconfig
config BR2_PACKAGE_SPACECADETPINBALL
	bool "spacecadetpinball"
	depends on BR2_INSTALL_LIBSTDCPP
	select BR2_PACKAGE_SDL2
	select BR2_PACKAGE_SDL2_MIXER
	help
	  Reverse-engineered Space Cadet Pinball from Windows.
	  Requires original game data files from Windows 95/XP.

	  https://github.com/k4zmu2a/SpaceCadetPinball
```

## package/ports/vvvvvv/Config.in
```kconfig
config BR2_PACKAGE_VVVVVV
	bool "vvvvvv"
	depends on BR2_INSTALL_LIBSTDCPP
	select BR2_PACKAGE_SDL2
	help
	  VVVVVV is a puzzle platformer by Terry Cavanagh.
	  Source code released by the author. Requires data.zip
	  from a retail purchase (Steam/itch.io).

	  https://github.com/TerryCavanagh/VVVVVV
```

## package/ports/wipeout/Config.in
```kconfig
config BR2_PACKAGE_WIPEOUT
	bool "wipeout"
	depends on BR2_INSTALL_LIBSTDCPP
	depends on !BR2_STATIC_LIBS
	select BR2_PACKAGE_SDL2
	help
	  Reimplementation of the PSX Wipeout racing game engine
	  by phoboslab. Supports GL, GLES2, and software rendering.
	  Requires original PSX Wipeout data files.

	  https://github.com/phoboslab/wipeout-rewrite
```

## package/ports/yquake2/yquake2-ref-vk/Config.in
```kconfig
config BR2_PACKAGE_YQUAKE2_REF_VK
	bool "yquake2-ref-vk"
	depends on BR2_PACKAGE_REGLINUX_VULKAN

	help
	  Vulkan renderer for Yamagi Quake 2

	  https://github.com/yquake2/ref_vk
```

## package/retroarch/retroachievements-sounds/Config.in
```kconfig
config BR2_PACKAGE_RETROACHIEVEMENTS_SOUNDS
	bool "retroachievements sounds"
	help
	  Play a sound when a retroachievement is unlocked
```

## package/retroarch/retroarch/Config.in
```kconfig
config BR2_PACKAGE_RETROARCH
    bool "Retroarch"
	depends on (BR2_PACKAGE_HAS_LIBGLES || BR2_PACKAGE_HAS_LIBEGL || BR2_PACKAGE_HAS_LIBGL)
	select BR2_PACKAGE_DEJAVU
	select BR2_PACKAGE_RETROARCH_ASSETS
	select BR2_PACKAGE_RETROARCH_JOYPAD_AUTOCONFIG
	select BR2_PACKAGE_LIBRETRO_CORE_INFO
	select BR2_PACKAGE_GAMEMODE
	select BR2_PACKAGE_HIDAPI
	select BR2_PACKAGE_LIBUSB
	select BR2_PACKAGE_ALSA_LIB
    help
      RetroArch is a free, ad-free, spyware-free, and open source
      cross platform frontend/framework for emulators, games, video
      players, and media players.

      Features:
      - Multi-core support (libretro API)
      - OpenGL/GLES/Vulkan rendering
      - SDL2 input and audio support
      - Network features (netplay, achievements)
      - Shader support (GLSL, CG, Slang)
      - Controller autoconfig
      - Cheevos/RetroAchievements support

      https://www.libretro.com/

comment "Retroarch depends on EGL or OpenGLES"
	depends on !(BR2_PACKAGE_HAS_LIBEGL || BR2_PACKAGE_HAS_LIBGLES || BR2_PACKAGE_HAS_LIBGL)
```

## package/system/glibc-sidecar-compat/Config.in
```kconfig
# Older sonames that prebuilt PortMaster ports link against, for the glibc
# sidecar only: runtime libraries, no headers, nothing in the sidecar builds
# against them.
config BR2_PACKAGE_FLAC_COMPAT
	bool "flac-compat (libFLAC.so.8)"
	depends on BR2_PACKAGE_REGLINUX_GLIBC_SIDECAR
	select BR2_PACKAGE_LIBOGG
	help
	  libFLAC 1.3 (soname libFLAC.so.8), next to FLAC 1.4's
	  libFLAC.so.12.

config BR2_PACKAGE_LIBOPENSSL_COMPAT
	bool "libopenssl-compat (OpenSSL 1.1)"
	depends on BR2_PACKAGE_REGLINUX_GLIBC_SIDECAR
	depends on BR2_PACKAGE_LIBOPENSSL # its target arch
	help
	  OpenSSL 1.1.1 (libssl.so.1.1, libcrypto.so.1.1), next to
	  OpenSSL 3.

config BR2_PACKAGE_LIBXML2_COMPAT
	bool "libxml2-compat (libxml2.so.2)"
	depends on BR2_PACKAGE_REGLINUX_GLIBC_SIDECAR
	select BR2_PACKAGE_ZLIB
	help
	  libxml2 2.13 (soname libxml2.so.2): 2.14 changed it to
	  libxml2.so.16.

config BR2_PACKAGE_SDL12_COMPAT
	bool "sdl12-compat (libSDL-1.2.so.0)"
	depends on BR2_PACKAGE_REGLINUX_GLIBC_SIDECAR
	depends on BR2_PACKAGE_SDL2
	help
	  SDL 1.2 on top of SDL2 (sdl12-compat), for SDL 1.2 ports.

config BR2_PACKAGE_SDL_IMAGE_COMPAT
	bool "sdl-image-compat (libSDL_image-1.2.so.0)"
	depends on BR2_PACKAGE_SDL12_COMPAT
	select BR2_PACKAGE_JPEG
	select BR2_PACKAGE_LIBPNG
	select BR2_PACKAGE_WEBP
	help
	  SDL_image 1.2, on sdl12-compat.

config BR2_PACKAGE_SDL_MIXER_COMPAT
	bool "sdl-mixer-compat (libSDL_mixer-1.2.so.0)"
	depends on BR2_PACKAGE_SDL12_COMPAT
	depends on BR2_PACKAGE_FLUIDSYNTH
	select BR2_PACKAGE_LIBVORBIS
	select BR2_PACKAGE_LIBMODPLUG
	help
	  SDL_mixer 1.2, on sdl12-compat.

config BR2_PACKAGE_SDL_TTF_COMPAT
	bool "sdl-ttf-compat (libSDL_ttf-2.0.so.0)"
	depends on BR2_PACKAGE_SDL12_COMPAT
	select BR2_PACKAGE_FREETYPE
	help
	  SDL_ttf 2.0 for SDL 1.2, on sdl12-compat.

config BR2_PACKAGE_FFMPEG_COMPAT
	bool "ffmpeg-compat (FFmpeg 4.4)"
	depends on BR2_PACKAGE_REGLINUX_GLIBC_SIDECAR
	select BR2_PACKAGE_ZLIB
	select BR2_PACKAGE_BZIP2
	help
	  FFmpeg 4.4 libraries (libavcodec.so.58, libavformat.so.58,
	  libavutil.so.56, libswscale.so.5, libswresample.so.3).

config BR2_PACKAGE_LIBZIP_COMPAT
	bool "libzip-compat (libzip.so.4)"
	depends on BR2_PACKAGE_REGLINUX_GLIBC_SIDECAR
	select BR2_PACKAGE_ZLIB
	help
	  libzip 1.1 (soname libzip.so.4), next to libzip 1.10's
	  libzip.so.5.

config BR2_PACKAGE_READLINE_COMPAT
	bool "readline-compat (libreadline.so.7)"
	depends on BR2_PACKAGE_REGLINUX_GLIBC_SIDECAR
	select BR2_PACKAGE_NCURSES
	help
	  readline 7.0 (libreadline.so.7, libhistory.so.7), next to
	  readline 8.

config BR2_PACKAGE_SNDIO_COMPAT
	bool "sndio-compat (libsndio.so.7)"
	depends on BR2_PACKAGE_REGLINUX_GLIBC_SIDECAR
	select BR2_PACKAGE_ALSA_LIB
	help
	  The sndio client library on ALSA, no sndiod.
```

## package/system/glibc-sidecar/Config.in
```kconfig
config BR2_PACKAGE_GLIBC_SIDECAR
	bool "glibc-sidecar"
	depends on BR2_TOOLCHAIN_BUILDROOT_GLIBC
	help
	  The toolchain's glibc built a second time with --prefix=/usr/glibc
	  (/usr/glibc32 on 32-bit ARM), for the glibc sidecar that runs PortMaster's prebuilt glibc programs
	  on the musl boards.

	  Same source, patches and configure options as the toolchain glibc;
	  only the prefix differs. Its loader therefore searches <prefix>/lib
	  only and reads its config from <prefix>/etc, so a glibc program
	  never picks up a library of the musl system.

	  Only the runtime is installed (loader, libc and friends, a few gconv
	  modules), into $(TARGET_DIR)<prefix>.

comment "glibc-sidecar needs a buildroot glibc toolchain"
	depends on !BR2_TOOLCHAIN_BUILDROOT_GLIBC
```

## package/system/reglinux-bluetooth-agent/Config.in
```kconfig
config BR2_PACKAGE_REGLINUX_BLUETOOTH_AGENT
	bool "reglinux-bluetooth-agent"
	select BR2_PACKAGE_BASU
	help
	  C bluetooth agent daemon using sd-bus (basu).
	  Auto-pairs and connects bluetooth input devices.
```

## package/system/reglinux-compat/Config.in
```kconfig
config BR2_PACKAGE_REGLINUX_COMPAT
	bool "reglinux-compat"
	help
	  Hardware compatibility auto-probe and reporting scripts.
	  Probes device features (WiFi, BT, GPU, display, etc.) at boot,
	  registers the device with compat.reglinux.org, and submits
	  compatibility reports when network is available.

	  https://compat.reglinux.org
```

## package/system/reglinux-configgen/Config.in
```kconfig
config BR2_PACKAGE_REGLINUX_CONFIGGEN
	bool "reglinux configgen"
	select BR2_PACKAGE_PYTHON3
	select BR2_PACKAGE_PYTHON_PYYAML
	select BR2_PACKAGE_PYTHON_LXML
	select BR2_PACKAGE_PYTHON_RUAMEL_YAML
	select BR2_PACKAGE_PYTHON_TOML
	select BR2_PACKAGE_PYTHON_TOMLI
	select BR2_PACKAGE_PYTHON_TOMLI_W
	select BR2_PACKAGE_PYTHON_PILLOW
	select BR2_PACKAGE_PYTHON_EVDEV
	select BR2_PACKAGE_PYTHON_PSUTIL
	select BR2_PACKAGE_PYTHON_PYUDEV
	select BR2_PACKAGE_PYTHON_REQUESTS
	select BR2_PACKAGE_FFMPEG_PYTHON	if BR2_PACKAGE_FFMPEG
	select BR2_PACKAGE_MANGOHUD		if BR2_x86_64 || BR2_PACKAGE_SYSTEM_TARGET_GLES3

	help
	  The configuration utility for reglinux
	  The purpose of the lib is to automatically configure emulators, using the environment variables available in REG-Linux.
	  The main program is emulatorlauncher.py, taking parameters, that are the system and controllers configurations.
```

## package/system/reglinux-games-databases/Config.in
```kconfig
config BR2_PACKAGE_REGLINUX_GAMES_DATABASES
	bool "REG-Linux games databases"
	help
	  Downloads the Redump.org, GameTDB and MAME offline databases,
	  gzipped, into /usr/share/reglinux/datainit/bios/databases
	  (unpacked to /userdata/bios/databases on first boot).

	  Redump.org/GameTDB (databases/) let regmsgd's scraper resolve an
	  optical disc's printed serial number straight to its known
	  checksum, without having to hash the whole disc image. MAME's own
	  "-listxml" release (mame/, stripped down to just name/year/
	  manufacturer/rotation/players) lets regmsgd's arcade library
	  resolve exact screen-rotation and metadata for the whole MAME/
	  FBNeo/Naomi/Atomiswave family, even on targets with no real mame
	  binary of their own.

	  https://redump.org
	  https://www.gametdb.com
	  https://www.mamedev.org
```

## package/system/reglinux-glibc-sidecar/Config.in
```kconfig
config BR2_PACKAGE_REGLINUX_GLIBC_SIDECAR
	bool "reglinux glibc sidecar"
	depends on BR2_TOOLCHAIN_BUILDROOT_GLIBC
	depends on BR2_aarch64 || BR2_arm
	select BR2_PACKAGE_GLIBC_SIDECAR
	select BR2_PACKAGE_HOST_SQUASHFS
	help
	  Builds glibc-<arch>.squashfs: a glibc userland (glibc, libstdc++,
	  Mesa, SDL2, audio clients and the libraries PortMaster ports expect)
	  that musl boards mount on /usr/glibc (armhf: /usr/glibc32) to run
	  prebuilt glibc programs. The board's /lib/ld-linux-* link points at
	  its loader.

	  Only meant for the reglinux-glibc-sidecar-<arch> configs: it
	  relocates the plugin and config paths of Mesa, alsa-lib,
	  alsa-plugins, vulkan-loader and glib into that prefix, so a glibc
	  program never loads one of the musl system's plugins.
```
