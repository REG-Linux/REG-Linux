## package/ports/eduke32/Config.in
```kconfig
config BR2_PACKAGE_EDUKE32
    bool "eduke32"
    depends on BR2_INSTALL_LIBSTDCPP
    depends on BR2_PACKAGE_HAS_LIBGL || BR2_PACKAGE_HAS_LIBGLES
    select BR2_PACKAGE_SDL2
    select BR2_PACKAGE_FLAC
    select BR2_PACKAGE_LIBVPX
    select BR2_PACKAGE_LIBEXECINFO	if BR2_TOOLCHAIN_USES_MUSL

    help
      EDuke32 is a Build Engine source port for playing games like Duke Nukem 3D and Ion Fury

      https://www.eduke32.com/
```

## package/ports/etlegacy/Config.in
```kconfig
config BR2_PACKAGE_ETLEGACY
	bool "etlegacy"
	select BR2_PACKAGE_FREETYPE
	select BR2_PACKAGE_LIBCURL
	select BR2_PACKAGE_LIBGLEW	if BR2_PACKAGE_REGLINUX_XWAYLAND
	select BR2_PACKAGE_LIBGLU	if BR2_PACKAGE_REGLINUX_XWAYLAND
	select BR2_PACKAGE_LIBPNG
	select BR2_PACKAGE_LIBTHEORA
	select BR2_PACKAGE_LIBVORBIS
	select BR2_PACKAGE_LUA
	select BR2_PACKAGE_OPENAL
	select BR2_PACKAGE_OPENSSL
	select BR2_PACKAGE_SDL2
	select BR2_PACKAGE_MINIZIP
	select BR2_PACKAGE_MINIZIP_ZLIB
	select BR2_PACKAGE_CJSON
	select BR2_PACKAGE_JPEG
	select BR2_PACKAGE_SQLITE
	select BR2_PACKAGE_LIBEXECINFO	if BR2_TOOLCHAIN_USES_MUSL

	help
	  ET: Legacy is an open source project based on the code of Wolfenstein: Enemy Territory
	  which was released in 2010 under the terms of the GPLv3 license.

	  www.etlegacy.com
```

## package/ports/fheroes2/Config.in
```kconfig
config BR2_PACKAGE_FHEROES2
	bool "fheroes2"
	select BR2_PACKAGE_SDL2
	select BR2_PACKAGE_SDL2_IMAGE
	select BR2_PACKAGE_SDL2_MIXER

	help
	  Free Heroes of Might and Magic 2.

	  https://github.com/ihhub/fheroes2
```

## package/ports/gemrb/Config.in
```kconfig
config BR2_PACKAGE_GEMRB
	bool "gemrb"
	select BR2_PACKAGE_SDL2
	select BR2_PACKAGE_SDL2_MIXER
	select BR2_PACKAGE_OPENAL
	select BR2_PACKAGE_ZLIB
	select BR2_PACKAGE_ICU
	select BR2_PACKAGE_LIBPNG
	select BR2_PACKAGE_FREETYPE
	select BR2_PACKAGE_LIBOGG
	select BR2_PACKAGE_LIBVORBIS
	help
	  GemRB (Game Engine Made with preRendered Background) is a portable open-source 
	  reimplementation of the Infinity Engine that underpinned Baldur's Gate, 
	  Icewind Dale and Planescape: Torment.

	  https://github.com/gemrb/gemrb
```

## package/ports/ioquake3/Config.in
```kconfig
config BR2_PACKAGE_IOQUAKE3
    bool "ioquake3"
    select BR2_PACKAGE_SDL2
    select BR2_PACKAGE_SDL2_NET
    select BR2_PACKAGE_LIBOGG
    select BR2_PACKAGE_LIBVORBIS
    select BR2_PACKAGE_OPUS
    select BR2_PACKAGE_OPUSFILE
    select BR2_PACKAGE_JPEG
    select BR2_PACKAGE_LIBCURL
    depends on BR2_PACKAGE_HAS_LIBGL || BR2_PACKAGE_HAS_LIBGLES
    help
      The ioquake3 community effort to continue supporting/developing id's Quake III Arena.
      
      https://www.ioquake3.org/
```

## package/ports/openmohaa/Config.in
```kconfig
config BR2_PACKAGE_OPENMOHAA
	bool "openmohaa"
	select BR2_PACKAGE_MINIZIP
	select BR2_PACKAGE_SDL2
	select BR2_PACKAGE_SDL2_IMAGE
	select BR2_PACKAGE_SDL2_MIXER
	select BR2_PACKAGE_SDL2_TTF
	select BR2_PACKAGE_FFMPEG
	select BR2_PACKAGE_LIBCURL
	select BR2_PACKAGE_OPENAL

	help
	  Medal of Honor : Allied Assault engine

	  https://github.com/openmoh/openmohaa
```

## package/ports/openomf/Config.in
```kconfig
config BR2_PACKAGE_OPENOMF
	bool "openomf"
	select BR2_PACKAGE_SDL2
	select BR2_PACKAGE_SDL2_MIXER
	select BR2_PACKAGE_ENET
	select BR2_PACKAGE_LIBCONFUSE
	select BR2_PACKAGE_LIBMINIUPNPC
	select BR2_PACKAGE_LIBNATPMP
	select BR2_PACKAGE_LIBEPOXY

	help
	  OpenOMF is an Open Source remake of "One Must Fall 2097" by Diversions Entertainment.

	  https://github.com/omf2097/openomf
```

## package/ports/quakespasm/Config.in
```kconfig
config BR2_PACKAGE_QUAKESPASM
	bool "QuakeSpasm"
	depends on BR2_PACKAGE_SDL2
	depends on BR2_PACKAGE_SDL2_MIXER
	depends on BR2_PACKAGE_HAS_LIBGL
	# TODO depends on BR2_PACKAGE_HAS_LIBGLES || BR2_PACKAGE_HAS_LIBGL
	help
	  QuakeSpasm is a modern, portable Quake 1 source port
	  using OpenGL / GLES and SDL2.

	  Game data (pak0.pak / pak1.pak) must be provided separately.
```

## package/ports/theforceengine/Config.in
```kconfig
config BR2_PACKAGE_THEFORCEENGINE
    bool "theforceengine"
    select BR2_PACKAGE_SDL2
    select BR2_PACKAGE_SDL2_IMAGE
    select BR2_PACKAGE_LIBGLEW
    select BR2_PACKAGE_LIBGLU
    select BR2_PACKAGE_LIBEXECINFO	if BR2_TOOLCHAIN_USES_MUSL

    help
      Modern "Jedi Engine" replacement supporting Dark Forces, mods,
      and in the future Outlaws.
      
      https://theforceengine.github.io/
```

## package/ports/vcmi/Config.in
```kconfig
config BR2_PACKAGE_VCMI
	bool "vcmi"
	select BR2_PACKAGE_MINIZIP_ZLIB
	select BR2_PACKAGE_ZSTD
	select BR2_PACKAGE_SDL2
	select BR2_PACKAGE_SDL2_IMAGE
	select BR2_PACKAGE_SDL2_MIXER
	select BR2_PACKAGE_SDL2_TTF
	select BR2_PACKAGE_FFMPEG
	select BR2_PACKAGE_TBB
	select BR2_PACKAGE_BOOST
	select BR2_PACKAGE_BOOST_CHRONO
	select BR2_PACKAGE_BOOST_DATE_TIME
	select BR2_PACKAGE_BOOST_FILESYSTEM
	select BR2_PACKAGE_BOOST_LOCALE
	select BR2_PACKAGE_BOOST_PROGRAM_OPTIONS
	select BR2_PACKAGE_BOOST_THREAD
	select BR2_PACKAGE_LIBSQUISH
	select BR2_PACKAGE_LIBEXECINFO	if BR2_TOOLCHAIN_USES_MUSL

	help
	  Heroes of Might and Magic 3 engine.

	  https://vcmi.eu
```

## package/ports/yquake2/Config.in
```kconfig
  source "$BR2_EXTERNAL_REGLINUX_PATH/package/ports/yquake2/yquake2-client/Config.in"
  source "$BR2_EXTERNAL_REGLINUX_PATH/package/ports/yquake2/yquake2-xatrix/Config.in"
  source "$BR2_EXTERNAL_REGLINUX_PATH/package/ports/yquake2/yquake2-rogue/Config.in"
  source "$BR2_EXTERNAL_REGLINUX_PATH/package/ports/yquake2/yquake2-ctf/Config.in"
  source "$BR2_EXTERNAL_REGLINUX_PATH/package/ports/yquake2/yquake2-zaero/Config.in"

config BR2_PACKAGE_YQUAKE2
        bool "yquake2"
	select BR2_PACKAGE_YQUAKE2_CLIENT
	select BR2_PACKAGE_YQUAKE2_XATRIX
	select BR2_PACKAGE_YQUAKE2_ROGUE
	select BR2_PACKAGE_YQUAKE2_CTF
	select BR2_PACKAGE_YQUAKE2_ZAERO
	select BR2_HOST_CMAKE_AT_LEAST_3_31

        help
          Yamagi Quake 2 source port.

          https://www.yamagi.org/quake2/
```

## package/ports/yquake2/yquake2-client/Config.in
```kconfig
config BR2_PACKAGE_YQUAKE2_CLIENT
	bool "yquake2"
	depends on BR2_PACKAGE_SDL2 || BR2_PACKAGE_SDL3
	select BR2_PACKAGE_LIBCURL
	select BR2_HOST_CMAKE_AT_LEAST_3_31
	select BR2_PACKAGE_YQUAKE2_XATRIX

	help
	  Yamagi Quake 2

	  https://github.com/yquake2/yquake2
```

## package/ports/yquake2/yquake2-xatrix/Config.in
```kconfig
config BR2_PACKAGE_YQUAKE2_XATRIX
	bool "yquake2-xatrix"

	help
	  Yamagi Quake 2 Xatrix

	  https://github.com/yquake2/xatrix
```

## package/reglinux/audio/asahi-alsa-ucm-conf/Config.in
```kconfig
config BR2_PACKAGE_ASAHI_ALSA_UCM_CONF
	bool "asahi-alsa-ucm-conf"
	help
	  Asahi Linux ALSA Use Case Manager configuration overlay.

	  https://github.com/AsahiLinux/alsa-ucm-conf-asahi
```

## package/reglinux/audio/ayn-alsa-ucm-conf/Config.in
```kconfig
config BR2_PACKAGE_AYN_ALSA_UCM_CONF
	bool "ayn-alsa-ucm-conf"
	help
	  AYN Technologies ALSA Use Case Manager configuration overlay.

	  https://github.com/AYNTechnologies/alsa-ucm-conf
```

## package/reglinux/boot/plymouth/Config.in
```kconfig
config BR2_PACKAGE_PLYMOUTH
	bool "plymouth"
	select BR2_PACKAGE_PANGO
	select BR2_PACKAGE_LIBPNG
	select BR2_PACKAGE_LIBEVDEV
	select BR2_PACKAGE_FREETYPE
	select BR2_PACKAGE_LIBXKBCOMMON
	select BR2_PACKAGE_XKEYBOARD_CONFIG

	help
	  Nice bootup

	  https://gitlab.freedesktop.org/plymouth/plymouth
```

## package/reglinux/boot/reglinux-initramfs/Config.in
```kconfig
config BR2_PACKAGE_REGLINUX_INITRAMFS
	bool "REG-Linux initramfs"
	select BR2_PACKAGE_HOST_UBOOT_TOOLS
	default n
	help
	  A simple initramfs based on busybox.

	  http://busybox.net/
```
