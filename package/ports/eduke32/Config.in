## package/reglinux/emulators/86Box/Config.in
```kconfig
config BR2_PACKAGE_86BOX
    bool "86box"
    select BR2_PACKAGE_RTMIDI
    select BR2_PACKAGE_LIBSNDFILE
    select BR2_PACKAGE_SLIRP
    select BR2_PACKAGE_FLUIDSYNTH
  
    help
      86Box

      https://86box.net/
```

## package/reglinux/emulators/aethersx2/Config.in
```kconfig
config BR2_PACKAGE_AETHERSX2
    bool "aethersx2"
    select BR2_PACKAGE_REGLINUX_QT6               

    help
      AetherSX2 Linux AppImage

      https://archive.org/details/AetherSX2-Collection
```

## package/reglinux/emulators/ares/Config.in
```kconfig
config BR2_PACKAGE_ARES
    bool "ares"
    select BR2_PACKAGE_SDL2
    select BR2_PACKAGE_ZLIB
    select BR2_PACKAGE_PANGO
    select BR2_PACKAGE_CAIRO
    select BR2_PACKAGE_LIBGTK3
    depends on BR2_PACKAGE_HAS_LIBGL
  
    help
      ares is a cross-platform, open source, multi-system emulator, focusing on accuracy and preservation.

      https://ares-emu.net/
```

## package/reglinux/emulators/azahar/Config.in
```kconfig
config BR2_PACKAGE_AZAHAR
    bool "azahar"
    select BR2_PACKAGE_REGLINUX_QT6               
    select BR2_PACKAGE_FMT
    select BR2_PACKAGE_BOOST
    select BR2_PACKAGE_BOOST_SERIALIZATION
    select BR2_PACKAGE_BOOST_IOSTREAMS
    select BR2_PACKAGE_BOOST_REGEX
    select BR2_PACKAGE_BOOST_LOCALE
    select BR2_PACKAGE_BOOST_CONTAINER
    select BR2_PACKAGE_FFMPEG  
    select BR2_PACKAGE_SDL2
    select BR2_PACKAGE_FDK_AAC

    help
      Azahar is an open-source 3DS emulator project based Citra.
      https://github.com/azahar-emu/azahar
```

## package/reglinux/emulators/box64/Config.in
```kconfig
config BR2_PACKAGE_BOX64
    bool "box64"
    depends on BR2_aarch64 || BR2_RISCV_64
    depends on BR2_PACKAGE_HOST_PYTHON3
  
    help
      Box64

      https://github.com/ptitseb/box64
```

## package/reglinux/emulators/box86/Config.in
```kconfig
config BR2_PACKAGE_BOX86
    bool "box86"
    depends on BR2_arm
    depends on BR2_PACKAGE_HOST_PYTHON3
  
    help
      Box86

      https://github.com/ptitseb/box86
```

## package/reglinux/emulators/clk/Config.in
```kconfig
config BR2_PACKAGE_CLK
    bool "clk"
    select BR2_PACKAGE_SDL2
    select BR2_PACKAGE_ZLIB
    depends on BR2_PACKAGE_HAS_LIBGL
  
    help
      CLK - Clock Signal multi-system emulator

      https://github.com/TomHarte/CLK
```
