## custom/package/libiberty/Config.in
```kconfig
config BR2_PACKAGE_LIBIBERTY
	bool "libiberty"
	depends on !BR2_nios2
	depends on BR2_USE_WCHAR

comment "libibertys needs a toolchain w/ wchar"
	depends on !BR2_nios2
	depends on !BR2_USE_WCHAR
```

## custom/package/llvm-project/libclc/Config.in
```kconfig
config BR2_PACKAGE_LIBCLC
	bool "libclc"
	depends on BR2_PACKAGE_LLVM_ARCH_SUPPORTS
	depends on BR2_HOST_GCC_AT_LEAST_7 # host-llvm
	select BR2_PACKAGE_HOST_CLANG
	select BR2_PACKAGE_HOST_LLVM
	select BR2_PACKAGE_HOST_SPIRV_TOOLS
	select BR2_PACKAGE_SPIRV_TOOLS
	select BR2_PACKAGE_SPIRV_LLVM_TRANSLATOR

	help
	  libclc is an open source, BSD licensed implementation of
	  the library requirements of the OpenCL C programming language,
	  as specified by the OpenCL 1.1 Specification.

	  http://libclc.llvm.org/

comment "libclc needs host gcc >= 7"
	depends on BR2_PACKAGE_LLVM_ARCH_SUPPORTS
	depends on !BR2_HOST_GCC_AT_LEAST_7
```

## custom/package/llvm-project/llvm-cmake/Config.in.host
```kconfig
config BR2_PACKAGE_LLVM_CMAKE
	bool "llvm-cmake"
	depends on BR2_TOOLCHAIN_GCC_AT_LEAST_7
	depends on BR2_TOOLCHAIN_HAS_THREADS
	depends on BR2_INSTALL_LIBSTDCPP
	depends on !BR2_TOOLCHAIN_HAS_GCC_BUG_64735 # std::shared_future
	depends on !BR2_STATIC_LIBS
	depends on BR2_USE_WCHAR # std::wstring
	depends on BR2_HOST_GCC_AT_LEAST_7 # host-llvm
	help
	  The LLVM Project is a collection of modular and reusable
	  compiler and toolchain technologies.

	  http://llvm.org

comment "llvm-cmake needs a toolchain w/ wchar, threads, C++, gcc >= 7, dynamic library, host gcc >= 7"
	depends on BR2_PACKAGE_LLVM_ARCH_SUPPORTS
	depends on !BR2_TOOLCHAIN_HAS_THREADS || !BR2_INSTALL_LIBSTDCPP || \
		!BR2_TOOLCHAIN_GCC_AT_LEAST_7 \
		|| BR2_STATIC_LIBS || !BR2_USE_WCHAR \
		|| !BR2_HOST_GCC_AT_LEAST_7

comment "llvm-cmake needs a toolchain not affected by GCC bug 64735"
	depends on BR2_PACKAGE_LLVM_ARCH_SUPPORTS
	depends on BR2_TOOLCHAIN_HAS_GCC_BUG_64735
```
