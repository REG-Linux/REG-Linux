## custom/package/python-pylibfdt/Config.in.host
```kconfig
#REG
config BR2_PACKAGE_HOST_PYTHON_PYLIBFDT
	bool "host python-pylibfdt"
	help
	  Python bindings for the Device Tree Compiler (dtc) toolchain.

	  https://github.com/devicetree-org/pylibfdt
```

## custom/package/python-setuptools-scm/Config.in.host
```kconfig
#REG
config BR2_PACKAGE_HOST_PYTHON_SETUPTOOLS_SCM
	bool "host-python-setuptools-scm"
	help
	  setuptools-scm extracts Python package versions from git or hg metadata instead of declaring them as the version argument or in an SCM managed file.

	  https://pypi.org/project/setuptools-scm/
```

## custom/package/spirv-llvm-translator/Config.in
```kconfig
config BR2_PACKAGE_SPIRV_LLVM_TRANSLATOR
	bool "spirv-llvm-translator"
	depends on BR2_INSTALL_LIBSTDCPP
	depends on !BR2_STATIC_LIBS
	depends on BR2_TOOLCHAIN_GCC_AT_LEAST_8 # C++17 filesystem
	select BR2_PACKAGE_SPIRV_HEADERS
	help
	  LLVM/SPIR-V Bi-Directional Translator

	  https://github.com/KhronosGroup/SPIRV-llvm-translator

comment "spirv-llvm-translator needs a toolchain w/ C++, dynamic library, gcc >= 8"
	depends on !BR2_INSTALL_LIBSTDCPP || BR2_STATIC_LIBS || \
		!BR2_TOOLCHAIN_GCC_AT_LEAST_8
```

## package/audio/asahi-audio/Config.in
```kconfig
config BR2_PACKAGE_ASAHI_AUDIO
	bool "asahi-audio"
	help
	  Linux userspace audio configuration for Apple Silicon Macs.

	  https://github.com/AsahiLinux/asahi-audio
```

## package/batocera/cases/deskpipro-case/Config.in
```kconfig
config BR2_PACKAGE_DESKPIPRO_CASE
	bool "deskpi-pro-case"

	help
	  Enable front USB, fan control & infrared on the DeskPi Pro Case.

	  https://deskpi.com/products/deskpi-pro-for-raspberry-pi-4
```

## package/batocera/controllers/gun4ir-guns/Config.in
```kconfig
config BR2_PACKAGE_GUN4IR_GUNS
	bool "gun4ir-guns"
	select BR2_PACKAGE_EVSIEVE

	help
	  gun4ir guns support
```

## package/batocera/controllers/guncon/Config.in
```kconfig
config BR2_PACKAGE_GUNCON
	bool "guncon"
	select BR2_PACKAGE_BATOCERA_GUN_CALIBRATOR
	select BR2_PACKAGE_EVSIEVE

	help
	  guncon support
```

## package/batocera/controllers/guncon3/Config.in
```kconfig
config BR2_PACKAGE_GUNCON3
	bool "guncon3"
	select BR2_PACKAGE_EVSIEVE

	help
	  guncon3 support
```

## package/batocera/controllers/hid-nx/Config.in
```kconfig
config BR2_PACKAGE_HID_NX
	bool "hid-nx"
	select BR2_PACKAGE_LIBUSB
	select BR2_PACKAGE_JOYCOND
	  help
	    Alternative Linux kernel HID driver for Nintendo Switch controllers

	    https://github.com/emilyst/hid-nx-dkms
```

## package/batocera/controllers/steamdeckgun/Config.in
```kconfig
config BR2_PACKAGE_STEAMDECKGUN
	bool "steamdeckgun"
	select BR2_PACKAGE_EVSIEVE
```

## package/batocera/core/batocera-audio/Config.in
```kconfig
config BR2_PACKAGE_BATOCERA_AUDIO
	bool "batocera-audio"
	select BR2_PACKAGE_ALSA_UTILS
	select BR2_PACKAGE_ALSA_UTILS_AMIXER
	select BR2_PACKAGE_ALSA_UTILS_APLAY
	select BR2_PACKAGE_ALSA_UTILS_ALSAUCM
	select BR2_PACKAGE_ALSA_UCM_CONF
	select BR2_PACKAGE_ALSA_TOPOLOGY_CONF		if BR2_PACKAGE_SYSTEM_TARGET_X86_ANY
	select BR2_PACKAGE_CHROMEBOOK_UCM_CONF		if !BR2_PACKAGE_SYSTEM_VIRTUAL_TARGET && BR2_x86_64
	select BR2_PACKAGE_CHROMEBOOK_LINUX_AUDIO	if !BR2_PACKAGE_SYSTEM_VIRTUAL_TARGET && BR2_x86_64
	select BR2_PACKAGE_ALSA_UTILS_ALSAINFO
	select BR2_PACKAGE_ALSA_PLUGINS
	select BR2_PACKAGE_SBC
	select BR2_PACKAGE_PIPEWIRE
	select BR2_PACKAGE_PIPEWIRE_V4L2
	select BR2_PACKAGE_PULSEAUDIO
	select BR2_PACKAGE_WIREPLUMBER
	select BR2_PACKAGE_LIBFREEAPTX
	select BR2_PACKAGE_LIBLDAC
	select BR2_PACKAGE_LIBLC3
	select BR2_PACKAGE_LIBSAMPLERATE
	select BR2_PACKAGE_SOUND_OPEN_FIRMWARE		if BR2_x86_64
	help
	  Audio support and scripts for batocera.linux
```

## package/batocera/core/batocera-bluetooth/Config.in
```kconfig
config BR2_PACKAGE_BATOCERA_BLUETOOTH
	bool "batocera-bluetooth"

	select BR2_PACKAGE_BLUEZ_TOOLS
	select BR2_PACKAGE_BLUEZ5_UTILS
	select BR2_PACKAGE_BLUEZ5_UTILS_CLIENT
	select BR2_PACKAGE_BLUEZ5_UTILS_MONITOR
	select BR2_PACKAGE_BLUEZ5_UTILS_TEST
	select BR2_PACKAGE_BLUEZ5_UTILS_DEPRECATED # needed for hciattach, ...
	select BR2_PACKAGE_BLUEZ5_UTILS_TOOLS # is it still needed ?
	select BR2_PACKAGE_BLUEZ5_UTILS_PLUGINS_SIXAXIS # sixaxis for PS3 controllers
	select BR2_PACKAGE_UTIL_LINUX_RFKILL
	help
	  Bluetooth support and scripts for batocera.linux
```

## package/batocera/core/batocera-resolution/Config.in
```kconfig
config BR2_PACKAGE_BATOCERA_RESOLUTION
	bool "batocera-resolution"

	select BR2_PACKAGE_BASH
	select BR2_PACKAGE_PCIUTILS
	select BR2_PACKAGE_GRIM         
	select BR2_PACKAGE_WF_RECORDER  

	help
	  Batocera resolution
```

## package/batocera/core/batocera-settings/Config.in
```kconfig
config BR2_PACKAGE_BATOCERA_SETTINGS
	bool "system-settings"

	help
	  system-settings-get/set binaries
```

## package/batocera/emulators/dolphin-triforce/Config.in
```kconfig
config BR2_PACKAGE_DOLPHIN_TRIFORCE
	bool "dolphin-triforce"
	depends on BR2_x86_64
	select BR2_PACKAGE_XORG7
	help
	  Gamecube/Wii emulator

	comment "DOLPHIN_TRIFORCE needs a toolchain w/ C++, OpenGL"
```

## package/batocera/emulators/openmsx/Config.in
```kconfig
config BR2_PACKAGE_OPENMSX
    bool "openmsx"
    select BR2_PACKAGE_SDL2
    select BR2_PACKAGE_SDL2_TTF
    select BR2_PACKAGE_LIBPNG
    select BR2_PACKAGE_LIBOGG
    select BR2_PACKAGE_LIBVORBIS
    select BR2_PACKAGE_LIBTHEORA
    select BR2_PACKAGE_LIB
    select BR2_PACKAGE_TCL
    select BR2_PACKAGE_ZLIB
    select BR2_PACKAGE_ALSA_LIB
    select BR2_PACKAGE_LIBGLEW	if BR2_PACKAGE_HAS_LIBGL
    select BR2_PACKAGE_FREETYPE
    help
      A MSX emulator that aims for perfection.

	    https://github.com/openMSX/openMSX
```

## package/batocera/emulators/retroarch/libretro/libretro-flycastvl/Config.in
```kconfig
config BR2_PACKAGE_LIBRETRO_FLYCASTVL
        bool "libretro-flycastvl"
	depends on BR2_PACKAGE_RETROARCH
	depends on BR2_INSTALL_LIBSTDCPP
	depends on BR2_GCC_ENABLE_OPENMP
	depends on (BR2_PACKAGE_HAS_LIBGLES || BR2_PACKAGE_HAS_LIBGL)
        help
          A libretro dreamcast emulator core.

	  http://www.libretro.com

comment "LIBRETRO_FLYCASTVL needs a toolchain w/ C++ and OpenGL ES or OpenGL"
	depends on !BR2_INSTALL_LIBSTDCPP || \
		(!BR2_PACKAGE_HAS_LIBGLES && !BR2_PACKAGE_HAS_LIBGL)
```

## package/batocera/emulators/retroarch/libretro/libretro-mame/Config.in
```kconfig
config BR2_PACKAGE_LIBRETRO_MAME
    bool "libretro-mame"
	depends on BR2_PACKAGE_RETROARCH
	depends on BR2_INSTALL_LIBSTDCPP
	depends on BR2_TOOLCHAIN_HAS_OPENMP
      help
        A libretro mame core for Mame.

	  http://www.libretro.com

comment "LIBRETRO_MAME needs a toolchain w/ C++"
	depends on !BR2_INSTALL_LIBSTDCPP
```

## package/batocera/emulators/retroarch/libretro/libretro-scummvm/Config.in
```kconfig
config BR2_PACKAGE_LIBRETRO_SCUMMVM
    bool "libretro-scummvm"
	depends on BR2_PACKAGE_RETROARCH
	depends on BR2_INSTALL_LIBSTDCPP
	select BR2_PACKAGE_HAS_LIBRETRO_SCUMMVM

      help
        Libretro-core version of ScummVM

	  https://github.com/scummvm/scummvm/

comment "LIBRETRO_SCUMMVM needs a toolchain w/ C++"
	depends on !BR2_INSTALL_LIBSTDCPP
```
