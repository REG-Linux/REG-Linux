## package/audio/cubeb/Config.in
```kconfig
config BR2_PACKAGE_CUBEB
	bool "cubeb"
	select BR2_PACKAGE_ALSA_LIB
	select BR2_PACKAGE_SPEEXDSP
	help
	  Cubeb is a cross-platform audio library.

	  It provides a consistent API for playing and recording audio
	  across different platforms and audio systems. Cubeb supports
	  multiple backends including ALSA, PulseAudio, JACK, and more.

	  Features:
	  - Cross-platform audio I/O
	  - Multiple backend support (ALSA, PulseAudio, JACK, etc.)
	  - Low-latency audio playback
	  - Audio stream mixing
	  - Device enumeration and selection
	  - Volume control

	  This package includes the ALSA backend (Tier-3 support).
	  For PulseAudio backend, enable BR2_PACKAGE_PULSEAUDIO.
	  For JACK backend, enable BR2_PACKAGE_JACK2.

	  https://github.com/mozilla/cubeb

if BR2_PACKAGE_CUBEB

config BR2_PACKAGE_CUBEB_BACKEND_ALSA
	bool "ALSA backend"
	default y
	help
	  Enable ALSA backend for cubeb.

	  This is the recommended backend for embedded systems without
	  a sound server (PulseAudio/PipeWire).

config BR2_PACKAGE_CUBEB_BACKEND_PULSEAUDIO
	bool "PulseAudio backend"
	select BR2_PACKAGE_PULSEAUDIO
	help
	  Enable PulseAudio backend for cubeb.

	  This provides better integration with desktop Linux systems
	  running PulseAudio or PipeWire.

config BR2_PACKAGE_CUBEB_BACKEND_JACK
	bool "JACK backend"
	select BR2_PACKAGE_JACK2
	help
	  Enable JACK backend for cubeb.

	  JACK is a professional audio server for low-latency audio
	  routing. Recommended for professional audio applications.

endif
```

## package/bluetooth/hci-uart-rtk/Config.in
```kconfig
config BR2_PACKAGE_HCI_UART_RTK
	bool "hci-uart-rtk"
	depends on BR2_LINUX_KERNEL
	help
	  Realtek Bluetooth HCI UART driver with H5 protocol
	  and BT-WiFi coexistence support. Replaces in-tree
	  hci_uart for Realtek combo chips (RTL8852BS etc).

	  This driver handles firmware loading via rtk_hciattach
	  and provides H4/H5 protocol + BT coexistence.
```

## package/boot/esos-k3/Config.in
```kconfig
config BR2_PACKAGE_ESOS_K3
    bool "esos-k3"
    depends on BR2_PACKAGE_SYSTEM_TARGET_K3
    help
        SpacemiT ESOS (Energy Service OS) firmware for the K3 RT24
        real-time coprocessor cores. Produces esos.itb for the boot
        image. Not required to boot Linux on the X100 application cores;
        brings up the RT cores (power-mgmt offload, audio DSP).
```

## package/boot/opensbi-k1/Config.in
```kconfig
config BR2_PACKAGE_OPENSBI_K1
    bool "opensbi-k1"
    depends on BR2_PACKAGE_SYSTEM_TARGET_K1
    depends on BR2_TARGET_OPENSBI
    help
        Wraps the mainline OpenSBI fw_dynamic.bin into a FIT image
        (fw_dynamic.itb) for SpacemiT K1 platforms where SPL expects
        OpenSBI in FIT format.
```

## package/boot/opensbi-k3/Config.in
```kconfig
config BR2_PACKAGE_OPENSBI_K3
    bool "opensbi-k3"
    depends on BR2_PACKAGE_SYSTEM_TARGET_K3
    depends on BR2_TARGET_OPENSBI
    help
        Wraps the mainline OpenSBI fw_dynamic.bin into a FIT image
        (fw_dynamic.itb) for SpacemiT K3 platforms where SPL expects
        OpenSBI in FIT format.
```

## package/boot/opensbi-k3/fw_dynamic.its
```
/dts-v1/;

/ {
	description = "Configuration to load OpenSBI before U-Boot";
	#address-cells = <2>;

	images {
		opensbi {
			description = "OpenSBI fw_dynamic Firmware";
			type = "firmware";
			os = "opensbi";
			arch = "riscv";
			compression = "none";
			/* K3 DDR is at 0x1_0000_0000; matches U-Boot SPL
			 * CONFIG_SPL_OPENSBI_LOAD_ADDR=0x100000000 and the vendor
			 * opensbi spacemit/fw_dynamic.its. K1 used <0 0>. */
			load = <0x1 0x0>;
			entry = <0x1 0x0>;
			data = /incbin/("fw_dynamic.bin");
			hash-1 {
				algo = "crc32";
			};
		};
	};
	configurations {
		default = "config_1";

		config_1 {
			description = "opensbi FIT config";
			firmware = "opensbi";
		};
	};
};
```

## package/boot/reglinux-shim-signed/Config.in
```kconfig
config BR2_PACKAGE_REGLINUX_SHIM_SIGNED
    bool "reglinux-shim-signed"
    help
      Microsoft-signed EFI shim binaries for Secure Boot support.
      Downloads x64 shim from Ubuntu and ia32 shim + helpers from Debian.

      Provides: shimx64.efi, mmx64.efi, fbx64.efi,
                shimia32.efi, mmia32.efi, fbia32.efi
```

## package/boot/sbsigntools/Config.in.host
```kconfig
config BR2_PACKAGE_HOST_SBSIGNTOOLS
	bool "host sbsigntools"
	help
	  Tools for signing EFI binaries for UEFI Secure Boot
	  (sbsign, sbverify, sbattach).

	  https://git.kernel.org/pub/scm/linux/kernel/git/jejb/sbsigntools.git/about/
```

## package/boot/th1520-ddr-firmware/Config.in
```kconfig
config BR2_PACKAGE_TH1520_DDR_FIRMWARE
    bool "TH1520 DDR firmware"
    depends on BR2_PACKAGE_SYSTEM_TARGET_TH1520
    help
        DDR initialization firmware for the T-Head TH1520 SoC.
        Generated from the th1520-firmware repository using Lua.
```

## package/boot/th1520-vendor-firmware/Config.in
```kconfig
config BR2_PACKAGE_TH1520_VENDOR_FIRMWARE
	bool "th1520-vendor-firmware"
	help
	  Proprietary T-Head TH1520 vendor firmware files loaded by
	  vendor U-Boot before kernel boot:
	    - light_aon_fpga.bin (AON subsystem - poweroff/reboot)
	    - light_c906_audio.bin (C906 audio DSP)
	    - str.bin (Suspend-to-RAM)
```

## package/boot/uboot-bananapi-f3/Config.in
```kconfig
config BR2_PACKAGE_UBOOT_BANANAPI_F3
    bool "uboot for BananaPi F3 / SpaceMiT K1 - built from source"
    depends on BR2_PACKAGE_SYSTEM_TARGET_K1
    select BR2_PACKAGE_OPENSBI
    help
        U-Boot bootloader for SpaceMiT K1 platforms,
        built from source with sysboot/extlinux support.
```

## package/boot/uboot-beaglev-ahead/Config.in
```kconfig
config BR2_PACKAGE_UBOOT_BEAGLEV_AHEAD
    bool "uboot for BeagleV Ahead - vendor pre-built"
    depends on BR2_PACKAGE_SYSTEM_TARGET_TH1520
    help
        Vendor U-Boot with SPL for BeagleV Ahead (T-Head TH1520 SoC).
        Pre-built binary from RevyOS releases.
```

## package/boot/uboot-k3/Config.in
```kconfig
config BR2_PACKAGE_UBOOT_K3
    bool "uboot for SpacemiT K3 - built from source"
    depends on BR2_PACKAGE_SYSTEM_TARGET_K3
    select BR2_PACKAGE_OPENSBI
    help
        U-Boot bootloader for SpacemiT K3 platforms (CoM260, Pico-ITX, ...),
        built from source with sysboot/extlinux support. A single k3_defconfig
        covers all K3 boards; the board DTB is chosen at runtime.
```

## package/boot/uboot-lichee-pi4a/Config.in
```kconfig
config BR2_PACKAGE_UBOOT_LICHEE_PI4A
    bool "uboot for Lichee Pi 4A / TH1520 - built from mainline"
    depends on BR2_PACKAGE_SYSTEM_TARGET_TH1520
    select BR2_TARGET_OPENSBI
    help
        Mainline U-Boot bootloader with SPL for Sipeed Lichee Pi 4A
        (T-Head TH1520 SoC). Supports 8GB and 16GB memory variants.
```

## package/boot/uboot-milkv-meles/Config.in
```kconfig
config BR2_PACKAGE_UBOOT_MILKV_MELES
    bool "uboot for Milk-V Meles - vendor pre-built"
    depends on BR2_PACKAGE_SYSTEM_TARGET_TH1520
    help
        Vendor U-Boot with SPL for Milk-V Meles (T-Head TH1520 SoC).
        Pre-built binaries for 4GB, 8GB, and 16GB memory variants.
```

## package/boot/uboot-odroidc5/Config.in
```kconfig
config BR2_PACKAGE_UBOOT_ODROIDC5
    bool "uboot files for ODROID C5"
    help
        uboot files for ODROID C5
```

## package/boot/uboot-orangepi-rv2/Config.in
```kconfig
config BR2_PACKAGE_UBOOT_ORANGEPI_RV2
    bool "uboot for OrangePi RV2 / SpaceMiT K1 - built from source"
    depends on BR2_PACKAGE_SYSTEM_TARGET_K1
    select BR2_PACKAGE_OPENSBI
    help
        U-Boot bootloader for OrangePi RV2 (SpaceMiT K1/X1),
        built from source with sysboot/extlinux support.
        MMC UHS disabled for RV2 hardware compatibility.
```

## package/controllers/rgvitapro-joypad/Config.in
```kconfig
config BR2_PACKAGE_RGVITAPRO_JOYPAD
	bool "rgvitapro-joypad"
	depends on BR2_LINUX_KERNEL
	help
	  RG Vita Pro GPIO joypad driver.
	  Reads D-pad, face buttons, shoulders, start/select,
	  and thumbstick clicks from the singleadc-joypad DT node.
```

## package/controllers/utils/regmsg-sdl2-probe/Config.in
```kconfig
config BR2_PACKAGE_REGMSG_SDL2_PROBE
	bool "regmsg-sdl2-probe"
	depends on BR2_PACKAGE_SDL2
	help
	  Tiny SDL2 helper that enumerates game controllers the way an
	  SDL2 emulator sees them (HIDAPI on) and prints one JSON object
	  per pad. regmsgd runs it to learn each pad's true SDL device
	  index, which differs from the kernel jsN order when HIDAPI
	  claims a pad. Lets the launcher bind SDL-index emulators
	  (DuckStation, mupen64plus) to the correct controller.

	  https://github.com/REG-Linux/regmsg
```

## package/emulators/amiberry/Config.in
```kconfig
config BR2_PACKAGE_AMIBERRY
    bool "amiberry"
    select BR2_PACKAGE_SDL3
    select BR2_PACKAGE_SDL3_IMAGE
    select BR2_PACKAGE_SDL3_TTF
    select BR2_PACKAGE_MPG123
    select BR2_PACKAGE_LIBCURL
    select BR2_PACKAGE_LIBXML2
    select BR2_PACKAGE_LIBMPEG2
    select BR2_PACKAGE_FLAC
    select BR2_PACKAGE_LIBPNG
    select BR2_PACKAGE_LIBSERIALPORT
    select BR2_PACKAGE_LIBPORTMIDI
    select BR2_PACKAGE_ZLIB
    select BR2_PACKAGE_LIBCAPSIMAGE
    select BR2_PACKAGE_LIBPCAP
    select BR2_PACKAGE_JSON_FOR_MODERN_CPP

    help
	Amiga emulator for many architectures
```

## package/emulators/azahar/Config.in
```kconfig
config BR2_PACKAGE_AZAHAR
    bool "azahar"
    depends on BR2_x86_64 || BR2_aarch64
    select BR2_PACKAGE_REGLINUX_QT6
    select BR2_PACKAGE_FMT
    select BR2_PACKAGE_BOOST
    select BR2_PACKAGE_FFMPEG
    select BR2_PACKAGE_SDL2
    select BR2_PACKAGE_FDK_AAC
    select BR2_PACKAGE_CUBEB
    select BR2_PACKAGE_OPENSSL
    select BR2_PACKAGE_LIBZIP
    select BR2_PACKAGE_LZ4
    select BR2_PACKAGE_ZSTD

    help
      Azahar is an open-source 3DS emulator project based on Citra.

      Features:
      - Nintendo 3DS emulation
      - OpenGL and Vulkan graphics backends
      - Qt6 frontend (SDL2 for input)
      - Cubeb audio backend
      - Online multiplayer support
      - Controller support via SDL2

      https://github.com/azahar-emu/azahar
```

## package/emulators/cemu/Config.in
```kconfig
config BR2_PACKAGE_CEMU
    bool "cemu"
    depends on BR2_x86_64 || BR2_aarch64
    select BR2_PACKAGE_SDL2
    select BR2_PACKAGE_FMT
    select BR2_PACKAGE_LIBCURL
    select BR2_PACKAGE_PUGIXML
    select BR2_PACKAGE_RAPIDJSON
    select BR2_PACKAGE_BOOST
    select BR2_PACKAGE_LIBZIP
    select BR2_PACKAGE_GLSLANG
    select BR2_PACKAGE_ZLIB
    select BR2_PACKAGE_ZSTD
    select BR2_PACKAGE_GLM
    select BR2_PACKAGE_LIBPNG
    select BR2_PACKAGE_LIBUSB
    select BR2_PACKAGE_WXWIDGETS
    select BR2_PACKAGE_UPOWER                   # required by some cemuhook servers
    select BR2_PACKAGE_HIDAPI                   # required for Wiimote support
    select BR2_PACKAGE_BLUEZ5_UTILS             # required for Wiimote support
    select BR2_PACKAGE_WEBP
    select BR2_PACKAGE_WEBP_DEMUX
    select BR2_PACKAGE_CUBEB                    # Audio backend
    help
      Cemu is a Wii U emulator that now runs natively on Linux.

      Features:
      - Wii U emulation (x86_64 and aarch64)
      - OpenGL and Vulkan graphics backends
      - SDL2 controller support
      - Wiimote support via HIDAPI + BlueZ
      - Cubeb audio backend
      - GameProfile support
      - CemuHook controller support

      https://cemu.info/
```

## package/emulators/dolphin-emu/Config.in
```kconfig
config BR2_PACKAGE_DOLPHIN_EMU
	bool "dolphin-emu"
	depends on BR2_x86_64 || BR2_aarch64
	select BR2_PACKAGE_LIBEVDEV
	select BR2_PACKAGE_FFMPEG
	select BR2_PACKAGE_ZLIB
	select BR2_PACKAGE_XZ
	select BR2_PACKAGE_LIBPNG
	select BR2_PACKAGE_LZO
	select BR2_PACKAGE_LIBUSB
	select BR2_PACKAGE_LIBCURL
	select BR2_PACKAGE_BLUEZ5_UTILS
	select BR2_PACKAGE_HIDAPI
	select BR2_PACKAGE_SDL2
	select BR2_PACKAGE_SDL3
	select BR2_PACKAGE_CUBEB
	select BR2_PACKAGE_LIBDRM

	help
	  Gamecube/Wii emulator

	  Dolphin is an emulator for two recent video game consoles:
	  the Nintendo GameCube and the Wii. It allows PC gamers to
	  enjoy games from these two consoles in full HD (1080p) with
	  several enhancements: compatibility with all PC controllers,
	  turbo speed, networked multiplayer, and even more.

comment "DOLPHIN_EMU needs a toolchain w/ C++, OpenGL"
	depends on !BR2_INSTALL_LIBSTDCPP || !BR2_PACKAGE_HAS_LIBGL
```
